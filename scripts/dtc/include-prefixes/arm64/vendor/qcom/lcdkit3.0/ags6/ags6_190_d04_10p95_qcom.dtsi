/* Copyright (c) 2013, The Linux Foundation. All rights reserved.
 *
 * This program is free software; you can redistribute it and/or modify
 * it under the terms of the GNU General Public License version 2 and
 * only version 2 as published by the Free Software Foundation.
 *
 * This program is distributed in the hope that it will be useful,
 * but WITHOUT ANY WARRANTY; without even the implied warranty of
 * MERCHANTABILITY or FITNESS FOR A PARTICULAR PURPOSE.  See the
 * GNU General Public License for more details.
 */

/*-------------------------------------------------------------------------
 * This file is autogenerated file using gcdb parser. Please do not edit it.
 * Update input XML file to add a new entry or update variable in this file
 * VERSION = 1.1
 *-----------------------------------------------------------------------*/
&mdss_mdp {
	dsi_ags6_190_d04_10p95_qcom: lcd_kit_ags6_190_d04_10p95_qcom {
		compatible = "190_d04_10p95";
		lcd-kit,panel-name = "190_d04 10.95' VIDEO 1200 x 1920";
		lcd-kit,panel-type = <0x01>;
		lcd-kit,panel-ldi-dsi-mode = <1>;
		lcd-kit,bl-after-frame = <0>;
		lcd-kit,vtc-line-support = <0>;
		lcd-kit,vtc-line-no-reset = <0>;
		qcom,mdss-dsi-panel-type = "dsi_video_mode";
		qcom,mdss-dsi-panel-name = "190_d04_10p95";
		qcom,mdss-pan-physical-width-dimension = <148>;
		qcom,mdss-pan-physical-height-dimension = <236>;
		qcom,dsi-ctrl-num = <0>;
		qcom,dsi-phy-num = <0>;
		qcom,panel-supply-entries = <&dsi_panel_pwr_supply>;
		qcom,mdss-dsi-virtual-channel-id = <0>;
		qcom,mdss-dsi-h-sync-pulse = <0>;
		qcom,mdss-dsi-bllp-eof-power-mode;
		qcom,mdss-dsi-bllp-power-mode;
		qcom,mdss-dsi-dma-schedule-line = <1>;
		qcom,mdss-dsi-bpp = <24>;
		qcom,mdss-dsi-color-order = "rgb_swap_rgb";
		qcom,mdss-dsi-underflow-color = <0xff>;
		qcom,mdss-dsi-border-color = <0>;
		qcom,mdss-dsi-traffic-mode = "burst_mode";
		qcom,mdss-dsi-lane-map = "lane_map_0123";
		qcom,mdss-dsi-lane-0-state;
		qcom,mdss-dsi-lane-1-state;
		qcom,mdss-dsi-lane-2-state;
		qcom,mdss-dsi-lane-3-state;
		qcom,mdss-dsi-mdp-trigger = "none";
		qcom,mdss-dsi-dma-trigger = "trigger_sw";
		qcom,mdss-dsi-te-pin-select = <0>;
		qcom,mdss-dsi-t-clk-post = <0x11>;
		qcom,mdss-dsi-t-clk-pre = <0x21>;
		qcom,mdss-dsi-tx-eot-append;
		qcom,dsi-select-clocks = "mux_byte_clk0", "mux_pixel_clk0", "src_byte_clk0", "src_pixel_clk0", "shadow_byte_clk0", "shadow_pixel_clk0";
		qcom,mdss-dsi-stream = <0>;
		qcom,mdss-dsi-lp11-init;
		qcom,sublinks-count = <2>;
		qcom,lanes-per-sublink = <2>;
		qcom,mdss-dsi-panel-hdr-color-primaries = <14500 15500 32000 17000 15500 30000 8000 3000>;
		qcom,mdss-dsi-panel-peak-brightness = <4200000>;
		qcom,mdss-dsi-panel-blackness-level = <3230>;
		qcom,dynamic-mode-switch-enabled;
		qcom,dynamic-mode-switch-type = "dynamic-resolution-switch-immediate";
		qcom,mdss-dsi-bl-pmic-control-type = "bl_ctrl_i2c_ic";
		pwms = <&pm6125_pwm 0 0>;
		qcom,bl-pmic-pwm-period-usecs = <100>;
		lcd-kit,pwrkey-long-press-support = <1>;
		qcom,esd-check-enabled;
		qcom,tp-esd-support-event;
		qcom,mdss-dsi-panel-status-command = [06 01 00 00 00 00 01 0A];
		qcom,mdss-dsi-panel-status-command-state = "dsi_lp_mode";
		qcom,mdss-dsi-panel-status-check-mode = "reg_read";
		qcom,mdss-dsi-panel-status-read-length = <1>;
		qcom,mdss-dsi-panel-status-value = <0x9C>;
		lcd-kit,power-on-stage = <7 1 1
				3 1 5
				4 1 10
				11 1 5
				5 1 10
				5 2 10
				5 1 40
				6 1 0
				8 1 0>;
		lcd-kit,lp-on-stage = <0 0 0>;
		lcd-kit,lp-off-stage = <0 0 0>;
		lcd-kit,power-off-stage = <7 0 0
				6 0 0
				8 0 0
				11 0 5
				4 0 2
				3 0 2
				2 0 1>;
		lcd-kit,pt-support = <0>;
		lcd-kit,panel-on-always-reset = <1>;
		lcd-kit,lcd-iovcc = <2 94 1800000>;
		lcd-kit,lcd-vsp = <2 65 6000000>;
		lcd-kit,lcd-vsn = <2 26 6000000>;
		lcd-kit,lcd-reset = <2 82 0>;
		lcd-kit,project-id-support = <1>;
		lcd-kit,default-project-id = "W430AY1300";
		lcd-kit,Does-lcd-poweron-tp = <1>;
		lcd-kit,sn-code-support = <0>;
		lcd-kit,oem-info-support = <0>;
		lcd-kit,oem-barcode-2d-support = <0>;
		lcd-kit,oem-barcode-2d-num-offset = <0>;
		lcd-kit,panel-getblmaxnit-type = <0>;
		lcd-kit,panel-blmaxnit-min-value = <370>;
		lcd-kit,panel-bl-maxnit-command = <0x06 0x01 0x00 0x00 0x0a 0x00 0x01 0xdb>;
		lcd-kit,panel-bl-maxnit-command-state = "dsi_lp_mode";
		lcd-kit,inversion-support = <0>;
		lcd-kit,panel-gpio-offset = <1167>;
		lcd-kit,panel-bl-max-nit = <450>;
		lcd-kit,panel-bl-min = <40>;
		lcd-kit,panel-bl-max = <3932>;
		lcd-kit,panel-bl-def = <4095>;
		lcd-kit,check-reg-support = <0>;
		lcd-kit,thp-proximity-support = <0>;
		lcd-kit,proximity-reset-delay-min = <65>;
		lcd-kit,proximity-power-off-delay-min = <210>;
		lcd-kit,lcd-power-down-vsp = <2 65 4700000>;
		lcd-kit,lcd-power-down-vsn = <2 26 4700000>;
		lcd-kit,backlight-order = <0>;
		lcd-kit,quickly-sleep-out-support = <0>;
		lcd-kit,quickly-sleep-out-interval = <102>;
		lcd-kit,fps-support = <1>;
		lcd-kit,default-fps = <60>;
		lcd-kit,panel-support-fps-list = <60 90 120>;
		lcd-kit,fps-60-cmd = "vndservice call display.qservice 25 i32 0 i32 0";
		lcd-kit,fps-90-cmd = "vndservice call display.qservice 25 i32 2 i32 0";
		lcd-kit,fps-120-cmd = "vndservice call display.qservice 25 i32 1 i32 0";
		qcom,mdss-dsi-display-timings {
			timing@0 {
				qcom,mdss-dsi-panel-width = <1200>;
				qcom,mdss-dsi-panel-height = <1920>;
				qcom,mdss-dsi-h-front-porch = <40>;
				qcom,mdss-dsi-h-back-porch = <40>;
				qcom,mdss-dsi-h-pulse-width = <4>;
				qcom,mdss-dsi-h-sync-skew = <0>;
				qcom,mdss-dsi-v-front-porch = <1960>;
				qcom,mdss-dsi-v-back-porch = <15>;
				qcom,mdss-dsi-v-pulse-width = <4>;
				qcom,mdss-dsi-panel-framerate = <60>;
				qcom,mdss-dsi-panel-phy-timings= [00 18 06 06 15 20 06
				06 07 02 04 00 15 0B];
				qcom,display-topology  = <1 1 1>;
				qcom,default-topology-index  = <0>;
				qcom,mdss-dsi-on-command = [39 01 00 00 00 00 03 F0 5A 59
		39 01 00 00 00 00 03 F1 A5 A6
		15 01 00 00 00 00 02 C0 40
		39 01 00 00 00 00 03 F0 A5 A6
		39 01 00 00 00 00 03 F1 5A 59
		15 01 00 00 00 00 02 35 00
		05 01 00 00 78 00 01 11
		05 01 00 00 14 00 01 29
		15 01 00 00 00 00 02 AC 05];
				qcom,mdss-dsi-on-command-state = "dsi_lp_mode";
				qcom,mdss-dsi-off-command = [15 01 00 00 00 00 02 AC 0A
		05 01 00 00 05 00 01 28
		05 01 00 00 6A 00 01 10];
				qcom,mdss-dsi-off-command-state = "dsi_lp_mode";
				qcom,compression-mode = "dsc";
				qcom,mdss-dsc-slice-height = <8>;
				qcom,mdss-dsc-slice-width = <600>;
				qcom,mdss-dsc-slice-per-pkt = <2>;
				qcom,mdss-dsc-bit-per-component = <8>;
				qcom,mdss-dsc-bit-per-pixel = <8>;
				qcom,mdss-dsc-block-prediction-enable;
			};
		};
    };
};