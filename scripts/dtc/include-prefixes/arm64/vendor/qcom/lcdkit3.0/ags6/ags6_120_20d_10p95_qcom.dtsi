/* Copyright (c) 2013, The Linux Foundation. All rights reserved.
 *
 * This program is free software; you can redistribute it and/or modify
 * it under the terms of the GNU General Public License version 2 and
 * only version 2 as published by the Free Software Foundation.
 *
 * This program is distributed in the hope that it will be useful,
 * but WITHOUT ANY WARRANTY; without even the implied warranty of
 * MERCHANTABILITY or FITNESS FOR A PARTICULAR PURPOSE.  See the
 * GNU General Public License for more details.
 */

/*-------------------------------------------------------------------------
 * This file is autogenerated file using gcdb parser. Please do not edit it.
 * Update input XML file to add a new entry or update variable in this file
 * VERSION = 1.1
 *-----------------------------------------------------------------------*/
&mdss_mdp {
	dsi_ags6_120_20d_10p95_qcom: lcd_kit_ags6_120_20d_10p95_qcom {
		compatible = "120_20d_10p95";
		lcd-kit,panel-name = "120_20d 10.95' VIDEO 1200 x 1920";
		lcd-kit,panel-type = <0x01>;
		lcd-kit,panel-ldi-dsi-mode = <1>;
		lcd-kit,bl-after-frame = <0>;
		lcd-kit,vtc-line-support = <0>;
		lcd-kit,vtc-line-no-reset = <0>;
		qcom,mdss-dsi-panel-type = "dsi_video_mode";
		qcom,mdss-dsi-panel-name = "120_20d_10p95";
		qcom,mdss-pan-physical-width-dimension = <148>;
		qcom,mdss-pan-physical-height-dimension = <236>;
		qcom,dsi-ctrl-num = <0>;
		qcom,dsi-phy-num = <0>;
		qcom,panel-supply-entries = <&dsi_panel_pwr_supply>;
		qcom,mdss-dsi-virtual-channel-id = <0>;
		qcom,mdss-dsi-h-sync-pulse = <0>;
		qcom,mdss-dsi-bllp-eof-power-mode;
		qcom,mdss-dsi-bllp-power-mode;
		qcom,mdss-dsi-dma-schedule-line = <1>;
		qcom,mdss-dsi-bpp = <24>;
		qcom,mdss-dsi-color-order = "rgb_swap_rgb";
		qcom,mdss-dsi-underflow-color = <0xff>;
		qcom,mdss-dsi-border-color = <0>;
		qcom,mdss-dsi-traffic-mode = "burst_mode";
		qcom,mdss-dsi-lane-map = "lane_map_0123";
		qcom,mdss-dsi-lane-0-state;
		qcom,mdss-dsi-lane-1-state;
		qcom,mdss-dsi-lane-2-state;
		qcom,mdss-dsi-lane-3-state;
		qcom,mdss-dsi-mdp-trigger = "none";
		qcom,mdss-dsi-dma-trigger = "trigger_sw";
		qcom,mdss-dsi-te-pin-select = <0>;
		qcom,mdss-dsi-t-clk-post = <0x11>;
		qcom,mdss-dsi-t-clk-pre = <0x22>;
		qcom,mdss-dsi-tx-eot-append;
		qcom,dsi-select-clocks = "mux_byte_clk0", "mux_pixel_clk0", "src_byte_clk0", "src_pixel_clk0", "shadow_byte_clk0", "shadow_pixel_clk0";
		qcom,mdss-dsi-stream = <0>;
		qcom,mdss-dsi-lp11-init;
		qcom,sublinks-count = <2>;
		qcom,lanes-per-sublink = <2>;
		qcom,mdss-dsi-panel-hdr-color-primaries = <14500 15500 32000 17000 15500 30000 8000 3000>;
		qcom,mdss-dsi-panel-peak-brightness = <4200000>;
		qcom,mdss-dsi-panel-blackness-level = <3230>;
		qcom,dynamic-mode-switch-enabled;
		qcom,dynamic-mode-switch-type = "dynamic-resolution-switch-immediate";
		qcom,mdss-dsi-bl-pmic-control-type = "bl_ctrl_i2c_ic";
		pwms = <&pm6125_pwm 0 0>;
		qcom,bl-pmic-pwm-period-usecs = <100>;
		qcom,tp-suspend-before-lcd;
		lcd-kit,pwrkey-long-press-support = <1>;
		qcom,esd-check-enabled;
		qcom,tp-esd-support-event;
		qcom,esd-gpio-detect-support;
		qcom,esd-only-gpio-detect;
		qcom,esd-detect-second-gpio;
		qcom,esd-gpio-detect-num0 = <81>;
		qcom,esd-gpio-normal-value0 = <0>;
		qcom,esd-gpio-detect-num1 = <104>;
		qcom,esd-gpio-normal-value1 = <0>;
		qcom,mdss-dsi-panel-status-command = [06 01 00 00 00 00 01 D1];
		qcom,mdss-dsi-panel-status-command-state = "dsi_lp_mode";
		qcom,mdss-dsi-panel-status-check-mode = "reg_read";
		qcom,mdss-dsi-panel-status-read-length = <1>;
		qcom,mdss-dsi-panel-status-value = <0x45>;
		lcd-kit,power-on-stage = <2 1 1
				3 1 5
				4 1 15
				11 1 5
				7 1 2
				5 2 15
				5 1 15
				5 2 15
				5 1 60>;
		lcd-kit,lp-on-stage = <6 1 0
				8 1 0>;
		lcd-kit,lp-off-stage = <0 0 0>;
		lcd-kit,hs-off-stage = <7 0 0
				8 0 50>;
		lcd-kit,power-off-stage = <5 0 3
				6 0 0
				11 0 5
				4 0 2
				3 0 5
				2 0 20>;
		lcd-kit,pt-support = <0>;
		lcd-kit,panel-on-always-reset = <1>;
		lcd-kit,panel-pt-always-keep-reset-high = <0>;
		lcd-kit,lcd-iovcc = <2 94 1800000>;
		lcd-kit,lcd-vsp = <2 65 6000000>;
		lcd-kit,lcd-vsn = <2 26 6000000>;
		lcd-kit,lcd-reset = <2 82 0>;
		lcd-kit,project-id-support = <1>;
		lcd-kit,default-project-id = "W4309Z1200";
		lcd-kit,Does-lcd-poweron-tp = <1>;
		lcd-kit,sn-code-support = <0>;
		lcd-kit,oem-info-support = <0>;
		lcd-kit,oem-barcode-2d-support = <0>;
		lcd-kit,oem-barcode-2d-num-offset = <0>;
		lcd-kit,panel-getblmaxnit-type = <0>;
		lcd-kit,panel-blmaxnit-min-value = <370>;
		lcd-kit,panel-bl-maxnit-command = <0x06 0x01 0x00 0x00 0x0a 0x00 0x01 0xdb>;
		lcd-kit,panel-bl-maxnit-command-state = "dsi_lp_mode";
		lcd-kit,inversion-support = <0>;
		lcd-kit,panel-gpio-offset = <1167>;
		lcd-kit,panel-bl-max-nit = <450>;
		lcd-kit,panel-bl-min = <40>;
		lcd-kit,panel-bl-max = <3932>;
		lcd-kit,panel-bl-def = <4095>;
		lcd-kit,check-reg-support = <0>;
		lcd-kit,thp-proximity-support = <0>;
		lcd-kit,proximity-reset-delay-min = <65>;
		lcd-kit,proximity-power-off-delay-min = <210>;
		lcd-kit,lcd-power-down-vsp = <2 65 4700000>;
		lcd-kit,lcd-power-down-vsn = <2 26 4700000>;
		lcd-kit,backlight-order = <0>;
		lcd-kit,quickly-sleep-out-support = <0>;
		lcd-kit,quickly-sleep-out-interval = <102>;
		lcd-kit,fps-support = <1>;
		lcd-kit,default-fps = <60>;
		lcd-kit,panel-support-fps-list = <60 90 120>;
		lcd-kit,fps-60-cmd = "vndservice call display.qservice 25 i32 0 i32 0";
		lcd-kit,fps-90-cmd = "vndservice call display.qservice 25 i32 2 i32 0";
		lcd-kit,fps-120-cmd = "vndservice call display.qservice 25 i32 1 i32 0";
		qcom,mdss-dsi-display-timings {
			timing@0 {
				qcom,mdss-dsi-panel-width = <1200>;
				qcom,mdss-dsi-panel-height = <1920>;
				qcom,mdss-dsi-h-front-porch = <40>;
				qcom,mdss-dsi-h-back-porch = <40>;
				qcom,mdss-dsi-h-pulse-width = <4>;
				qcom,mdss-dsi-h-sync-skew = <0>;
				qcom,mdss-dsi-v-front-porch = <2102>;
				qcom,mdss-dsi-v-back-porch = <120>;
				qcom,mdss-dsi-v-pulse-width = <2>;
				qcom,mdss-dsi-panel-framerate = <60>;
				qcom,mdss-dsi-panel-phy-timings= [00 1A 06 06 16 20 07
				06 07 02 04 00 16 0B];
				qcom,display-topology  = <1 1 1>;
				qcom,default-topology-index  = <0>;
				qcom,mdss-dsi-on-command = [15 01 00 00 00 00 02 FF 20
			15 01 00 00 00 00 02 FB 01
			15 01 00 00 00 00 02 9D 14
			15 01 00 00 00 00 02 9E 14
			15 01 00 00 00 00 02 FF 24
			15 01 00 00 00 00 02 FB 01
			15 01 00 00 00 00 02 3A 68
			15 01 00 00 00 00 02 3B 56
			15 01 00 00 00 00 02 4A 68
			15 01 00 00 00 00 02 4B 56
			15 01 00 00 00 00 02 5A 68
			15 01 00 00 00 00 02 5B 56
			15 01 00 00 00 00 02 DC 6A
			15 01 00 00 00 00 02 E0 7C
			15 01 00 00 00 00 02 E2 6A
			15 01 00 00 00 00 02 E4 6A
			15 01 00 00 00 00 02 E6 6A
			15 01 00 00 00 00 02 EA 6A
			15 01 00 00 00 00 02 EE 6A
			15 01 00 00 00 00 02 F0 6A
			39 01 00 00 00 00 06 BC 00 00 40 01 00
			15 01 00 00 00 00 02 FF 25
			15 01 00 00 00 00 02 FB 01
			15 01 00 00 00 00 02 1F 68
			15 01 00 00 00 00 02 20 56
			15 01 00 00 00 00 02 26 68
			15 01 00 00 00 00 02 27 56
			15 01 00 00 00 00 02 44 68
			15 01 00 00 00 00 02 45 68
			15 01 00 00 00 00 02 49 56
			15 01 00 00 00 00 02 4F 20
			15 01 00 00 00 00 02 50 68
			15 01 00 00 00 00 02 51 56
			15 01 00 00 00 00 02 5D 68
			15 01 00 00 00 00 02 5E 56
			15 01 00 00 00 00 02 5F 68
			15 01 00 00 00 00 02 60 56
			15 01 00 00 00 00 02 61 68
			15 01 00 00 00 00 02 62 56
			15 01 00 00 00 00 02 6C 0E
			15 01 00 00 00 00 02 6E 0E
			15 01 00 00 00 00 02 7A 11
			15 01 00 00 00 00 02 7B A0
			15 01 00 00 00 00 02 FF 26
			15 01 00 00 00 00 02 FB 01
			15 01 00 00 00 00 02 00 A1
			15 01 00 00 00 00 02 0C 0C
			15 01 00 00 00 00 02 0D 0F
			15 01 00 00 00 00 02 0F 0F
			15 01 00 00 00 00 02 13 8E
			15 01 00 00 00 00 02 14 94
			15 01 00 00 00 00 02 19 13
			15 01 00 00 00 00 02 1A 00
			15 01 00 00 00 00 02 1C 16
			15 01 00 00 00 00 02 2A 13
			15 01 00 00 00 00 02 2B 00
			15 01 00 00 00 00 02 D2 3F
			39 01 00 00 00 00 03 CD 35 3F
			39 01 00 00 00 00 03 CE 33 3F
			39 01 00 00 00 00 04 CF 01 00 20
			15 01 00 00 00 00 02 1E 7C
			15 01 00 00 00 00 02 1F 6A
			15 01 00 00 00 00 02 24 01
			15 01 00 00 00 00 02 25 6C
			15 01 00 00 00 00 02 26 22
			15 01 00 00 00 00 02 30 14
			15 01 00 00 00 00 02 31 02
			15 01 00 00 00 00 02 32 6A
			15 01 00 00 00 00 02 3A 6A
			15 01 00 00 00 00 02 C9 8B
			15 01 00 00 00 00 02 CA 4E
			15 01 00 00 00 00 02 CB 00
			15 01 00 00 00 00 02 A9 8D
			15 01 00 00 00 00 02 AA 8C
			15 01 00 00 00 00 02 AB 8B
			15 01 00 00 00 00 02 AC 8A
			15 01 00 00 00 00 02 AD 89
			15 01 00 00 00 00 02 AE 88
			15 01 00 00 00 00 02 AF 87
			15 01 00 00 00 00 02 B0 86
			15 01 00 00 00 00 02 B1 85
			15 01 00 00 00 00 02 B2 84
			15 01 00 00 00 00 02 B3 83
			15 01 00 00 00 00 02 B4 82
			15 01 00 00 00 00 02 B5 81
			15 01 00 00 00 00 02 B6 00
			15 01 00 00 00 00 02 D6 00
			15 01 00 00 00 00 02 D7 00
			15 01 00 00 00 00 02 D8 00
			15 01 00 00 00 00 02 D9 00
			15 01 00 00 00 00 02 DA 00
			15 01 00 00 00 00 02 DB 00
			15 01 00 00 00 00 02 DC 00
			15 01 00 00 00 00 02 DD 00
			15 01 00 00 00 00 02 DE 00
			15 01 00 00 00 00 02 DF 00
			15 01 00 00 00 00 02 E0 00
			15 01 00 00 00 00 02 E1 00
			15 01 00 00 00 00 02 E2 00
			15 01 00 00 00 00 02 E3 00
			15 01 00 00 00 00 02 F7 00
			15 01 00 00 00 00 02 FF 27
			15 01 00 00 00 00 02 FB 01
			15 01 00 00 00 00 02 5B 74
			15 01 00 00 00 00 02 5D 3E
			15 01 00 00 00 00 02 5F 08
			15 01 00 00 00 00 02 60 04
			15 01 00 00 00 00 02 61 70
			15 01 00 00 00 00 02 62 71
			15 01 00 00 00 00 02 64 23
			15 01 00 00 00 00 02 65 6F
			15 01 00 00 00 00 02 66 71
			15 01 00 00 00 00 02 68 23
			15 01 00 00 00 00 02 78 80
			15 01 00 00 00 00 02 79 00
			15 01 00 00 00 00 02 7A 01
			15 01 00 00 00 00 02 7B F4
			15 01 00 00 00 00 02 7C 00
			15 01 00 00 00 00 02 7D 01
			15 01 00 00 00 00 02 7E C8
			15 01 00 00 00 00 02 7F 21
			15 01 00 00 00 00 02 80 00
			15 01 00 00 00 00 02 81 00
			15 01 00 00 00 00 02 82 00
			15 01 00 00 00 00 02 83 00
			15 01 00 00 00 00 02 84 00
			15 01 00 00 00 00 02 85 00
			15 01 00 00 00 00 02 86 00
			15 01 00 00 00 00 02 87 00
			15 01 00 00 00 00 02 88 00
			15 01 00 00 00 00 02 FF 2A
			15 01 00 00 00 00 02 FB 01
			15 01 00 00 00 00 02 25 6A
			15 01 00 00 00 00 02 30 00
			15 01 00 00 00 00 02 32 00
			15 01 00 00 00 00 02 33 00
			15 01 00 00 00 00 02 34 00
			15 01 00 00 00 00 02 35 00
			15 01 00 00 00 00 02 36 00
			15 01 00 00 00 00 02 37 00
			15 01 00 00 00 00 02 FF 25
			15 01 00 00 00 00 02 FB 01
			15 01 00 00 00 00 02 13 02
			15 01 00 00 00 00 02 14 43
			15 01 00 00 00 00 02 DB 01
			15 01 00 00 00 00 02 DC C8
			15 01 00 00 00 00 02 15 00
			15 01 00 00 00 00 02 16 82
			15 01 00 00 00 00 02 DD 00
			15 01 00 00 00 00 02 DE 82
			15 01 00 00 00 00 02 FF 26
			15 01 00 00 00 00 02 FB 01
			15 01 00 00 00 00 02 8B 28
			15 01 00 00 00 00 02 8C 00
			15 01 00 00 00 00 02 8D 01
			15 01 00 00 00 00 02 8F 01
			15 01 00 00 00 00 02 91 00
			15 01 00 00 00 00 02 92 50
			15 01 00 00 00 00 02 93 00
			15 01 00 00 00 00 02 94 00
			15 01 00 00 00 00 02 96 00
			15 01 00 00 00 00 02 99 0F
			15 01 00 00 00 00 02 9A 9C
			15 01 00 00 00 00 02 9B 0E
			15 01 00 00 00 00 02 9C DC
			15 01 00 00 00 00 02 9D 0F
			15 01 00 00 00 00 02 9E 9C
			15 01 00 00 00 00 02 4C 00
			15 01 00 00 00 00 02 4D 05
			15 01 00 00 00 00 02 4E 50
			15 01 00 00 00 00 02 4F 05
			15 01 00 00 00 00 02 50 50
			15 01 00 00 00 00 02 51 05
			15 01 00 00 00 00 02 52 50
			15 01 00 00 00 00 02 82 00
			15 01 00 00 00 00 02 56 05
			15 01 00 00 00 00 02 58 50
			15 01 00 00 00 00 02 5B 05
			15 01 00 00 00 00 02 5C 50
			15 01 00 00 00 00 02 7B 05
			15 01 00 00 00 00 02 7C 50
			15 01 00 00 00 00 02 7E 05
			15 01 00 00 00 00 02 7F 50
			15 01 00 00 00 00 02 64 02
			15 01 00 00 00 00 02 65 40
			15 01 00 00 00 00 02 6E 05
			15 01 00 00 00 00 02 6F 50
			15 01 00 00 00 00 02 70 05
			15 01 00 00 00 00 02 71 50
			15 01 00 00 00 00 02 72 05
			15 01 00 00 00 00 02 73 50
			15 01 00 00 00 00 02 3F 00
			15 01 00 00 00 00 02 40 C8
			15 01 00 00 00 00 02 41 C8
			15 01 00 00 00 00 02 42 C8
			15 01 00 00 00 00 02 43 00
			15 01 00 00 00 00 02 44 C8
			15 01 00 00 00 00 02 45 05
			15 01 00 00 00 00 02 46 C8
			15 01 00 00 00 00 02 49 0C
			15 01 00 00 00 00 02 4A C8
			15 01 00 00 00 00 02 4B 00
			15 01 00 00 00 00 02 80 33
			39 01 00 00 00 00 05 82 00 C2 C2 C2
			15 01 00 00 00 00 02 FF 2A
			15 01 00 00 00 00 02 FB 01
			15 01 00 00 00 00 02 01 05
			15 01 00 00 00 00 02 02 55
			15 01 00 00 00 00 02 04 60
			15 01 00 00 00 00 02 05 05
			15 01 00 00 00 00 02 06 60
			15 01 00 00 00 00 02 0C 05
			15 01 00 00 00 00 02 0D 60
			39 01 00 00 00 00 0A B9 14 00 95 00 E0 87 B0 70 40
			15 01 00 00 00 00 02 BC 33
			15 01 00 00 00 00 02 FF 26
			15 01 00 00 00 00 02 FB 01
			15 01 00 00 00 00 02 C9 80
			15 01 00 00 00 00 02 FF 27
			15 01 00 00 00 00 02 FB 01
			15 01 00 00 00 00 02 D0 11
			15 01 00 00 00 00 02 D1 45
			15 01 00 00 00 00 02 FF 20
			15 01 00 00 00 00 02 FB 01
			15 01 00 00 00 00 02 58 03
			15 01 00 00 00 00 02 FF 10
			15 01 00 00 00 00 02 FB 01
			15 01 00 00 00 00 02 90 03
			39 01 00 00 00 00 11 91 89 A8 00 14 D2 00 02 45 01 EC 00 08 05 7A 04 94
			39 01 00 00 00 00 03 92 10 F0
			15 01 00 00 00 00 02 B2 80
			15 01 00 00 00 00 02 B3 00
			15 01 00 00 00 00 02 35 00
			15 01 00 00 00 00 02 53 24
			39 01 00 00 00 00 07 3B 03 7A 1E 04 04 00
			05 01 00 00 64 00 01 11
			05 01 00 00 0A 00 01 29];
				qcom,mdss-dsi-on-command-state = "dsi_lp_mode";
				qcom,mdss-dsi-off-command = [15 01 00 00 00 00 02 FF 10
			15 01 00 00 00 00 02 FB 01
			05 01 00 00 0A 00 01 28
			05 01 00 00 64 00 01 10];
				qcom,mdss-dsi-off-command-state = "dsi_lp_mode";
				qcom,compression-mode = "dsc";
				qcom,mdss-dsc-slice-height = <20>;
				qcom,mdss-dsc-slice-width = <600>;
				qcom,mdss-dsc-slice-per-pkt = <2>;
				qcom,mdss-dsc-bit-per-component = <8>;
				qcom,mdss-dsc-bit-per-pixel = <8>;
				qcom,mdss-dsc-block-prediction-enable;
			};
		};
    };
};