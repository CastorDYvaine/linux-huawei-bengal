/*---------------------------------------------------------------------------
 * This file is autogenerated file using huawei LCD parser. Please do not edit it.
 * Update input XML file to add a new entry or update variable in this file
 * Parser location: vendor/huawei/chipset_common/devkit/lcdkit/tools 
 *---------------------------------------------------------------------------*/


#include "ags6_120_20d_10p95_qcom.dtsi"
#include "ags6_190_d04_10p95_qcom.dtsi"
#include "ags6_290_506_10p95_qcom.dtsi"
#include "ags6_auo_otm1901a_5p2_1080p_video_default.dtsi"