/* Copyright (c) 2013, The Linux Foundation. All rights reserved.
 *
 * This program is free software; you can redistribute it and/or modify
 * it under the terms of the GNU General Public License version 2 and
 * only version 2 as published by the Free Software Foundation.
 *
 * This program is distributed in the hope that it will be useful,
 * but WITHOUT ANY WARRANTY; without even the implied warranty of
 * MERCHANTABILITY or FITNESS FOR A PARTICULAR PURPOSE.  See the
 * GNU General Public License for more details.
 */

/*-------------------------------------------------------------------------
 * This file is autogenerated file using gcdb parser. Please do not edit it.
 * Update input XML file to add a new entry or update variable in this file
 * VERSION = 1.1
 *-----------------------------------------------------------------------*/
&mdss_mdp {
	dsi_nen_190_20c_6p6_qcom: lcd_kit_nen_190_20c_6p6_qcom {
		compatible = "190_20c_6p6_1080p_video";
		lcd-kit,panel-name = "190_20c 6.6' VIDEO 1080 x 2376";
		lcd-kit,panel-type = <0x01>;
		lcd-kit,bl-after-frame = <0>;
		lcd-kit,vtc-line-no-reset = <0>;
		qcom,mdss-dsi-panel-type = "dsi_video_mode";
		qcom,mdss-dsi-panel-name = "190_20c_6p6";
		qcom,mdss-pan-physical-width-dimension = <69>;
		qcom,mdss-pan-physical-height-dimension = <154>;
		qcom,dsi-ctrl-num = <0>;
		qcom,dsi-phy-num = <0>;
		qcom,panel-supply-entries = <&dsi_panel_pwr_supply>;
		qcom,mdss-dsi-virtual-channel-id = <0>;
		qcom,mdss-dsi-h-sync-pulse = <0>;
		qcom,mdss-dsi-bllp-eof-power-mode;
		qcom,mdss-dsi-bllp-power-mode;
		qcom,mdss-dsi-dma-schedule-line = <1>;
		qcom,mdss-dsi-bpp = <24>;
		qcom,mdss-dsi-color-order = "rgb_swap_rgb";
		qcom,mdss-dsi-underflow-color = <0xff>;
		qcom,mdss-dsi-border-color = <0>;
		qcom,mdss-dsi-traffic-mode = "burst_mode";
		qcom,mdss-dsi-lane-map = "lane_map_0123";
		qcom,mdss-dsi-lane-0-state;
		qcom,mdss-dsi-lane-1-state;
		qcom,mdss-dsi-lane-2-state;
		qcom,mdss-dsi-lane-3-state;
		qcom,mdss-dsi-mdp-trigger = "none";
		qcom,mdss-dsi-dma-trigger = "trigger_sw";
		qcom,mdss-dsi-te-pin-select = <0>;
		qcom,mdss-dsi-t-clk-post = <0x0f>;
		qcom,mdss-dsi-t-clk-pre = <0x39>;
		qcom,mdss-dsi-tx-eot-append;
		qcom,dsi-select-clocks = "mux_byte_clk0", "mux_pixel_clk0", "src_byte_clk0", "src_pixel_clk0", "shadow_byte_clk0", "shadow_pixel_clk0";
		qcom,mdss-dsi-stream = <0>;
		qcom,mdss-dsi-lp11-init;
		qcom,sublinks-count = <2>;
		qcom,lanes-per-sublink = <2>;
		qcom,mdss-dsi-panel-hdr-color-primaries = <14500 15500 32000 17000 15500 30000 8000 3000>;
		qcom,mdss-dsi-panel-peak-brightness = <4200000>;
		qcom,mdss-dsi-panel-blackness-level = <3230>;
		qcom,dynamic-mode-switch-type = "dynamic-resolution-switch-immediate";
		qcom,mdss-dsi-bl-pmic-control-type = "bl_ctrl_dcs_i2c_ic";
		pwms = <&pm6125_pwm 0 0>;
		qcom,bl-pmic-pwm-period-usecs = <100>;
		qcom,esd-check-enabled;
		qcom,mdss-dsi-panel-status-command = [06 01 00 00 00 00 01 0A
			06 01 00 00 00 00 01 0C
			06 01 00 00 00 00 01 0D];
		qcom,mdss-dsi-panel-status-command-state = "dsi_lp_mode";
		qcom,mdss-dsi-panel-status-check-mode = "reg_read";
		qcom,mdss-dsi-panel-status-read-length = <1 1 1>;
		qcom,mdss-dsi-panel-status-value = <0x9C>,<0x07>,<0x00>;
		lcd-kit,power-on-stage = <11 1 0
				3 1 2
				4 1 10
				5 2 1
				5 1 5
				5 2 1
				5 1 10
				7 1 2>;
		lcd-kit,lp-on-stage = <8 1 0>;
		lcd-kit,lp-off-stage = <7 0 0>;
		lcd-kit,power-off-stage = <8 0 0
				11 0 5
				4 0 1
				3 0 2>;
		lcd-kit,only-power-off-stage = <15 0 80
				4 0 0
				3 0 6>;
		lcd-kit,pt-support = <1>;
		lcd-kit,panel-on-always-reset = <1>;
		lcd-kit,lcd-vsp = <2 65 5500000>;
		lcd-kit,lcd-vsn = <2 26 5500000>;
		lcd-kit,lcd-reset = <2 82 0>;
		lcd-kit,project-id-support = <1>;
		lcd-kit,default-project-id = "G240A7130";
		lcd-kit,sn-code-support = <1>;
		lcd-kit,oem-info-support = <1>;
		lcd-kit,oem-barcode-2d-support = <1>;
		lcd-kit,oem-barcode-2d-num-offset = <0>;
		lcd-kit,barcode-2d-cmds = <0x15 0x01 0x00 0x00 0x0a 0x00 0x02 0xFF 0x21
		0x15 0x01 0x00 0x00 0x0a 0x00 0x02 0xFA 0x00
		0x06 0x01 0x00 0x00 0x0a 0x00 0x05 0xF1 0x00 0x00 0x00 0x00
		0x15 0x01 0x00 0x00 0x0a 0x00 0x02 0xFA 0x05
		0x06 0x01 0x00 0x00 0x0a 0x00 0x05 0xF1 0x00 0x00 0x00 0x00
		0x15 0x01 0x00 0x00 0x0a 0x00 0x02 0xFA 0x0A
		0x06 0x01 0x00 0x00 0x0a 0x00 0x05 0xF1 0x00 0x00 0x00 0x00
		0x15 0x01 0x00 0x00 0x0a 0x00 0x02 0xFA 0x0F
		0x06 0x01 0x00 0x00 0x0a 0x00 0x01 0xF1
		0x15 0x01 0x00 0x00 0x0a 0x00 0x02 0xFA 0x00
		0x06 0x01 0x00 0x00 0x0a 0x00 0x05 0xF2 0x00 0x00 0x00 0x00
		0x15 0x01 0x00 0x00 0x0a 0x00 0x02 0xFF 0x10>;
		lcd-kit,barcode-2d-cmds-state = "dsi_lp_mode";
		lcd-kit,panel-getblmaxnit-type = <0>;
		lcd-kit,panel-blmaxnit-min-value = <400>;
		lcd-kit,panel-bl-maxnit-command = <0x06 0x01 0x00 0x00 0x0a 0x00 0x01 0xdb>;
		lcd-kit,panel-bl-maxnit-command-state = "dsi_lp_mode";
		lcd-kit,inversion-support = <1>;
		lcd-kit,inversion-dot-cmds = <0x15 0x01 0x00 0x00 0x00 0x00 0x02 0xFF 0x24
		0x15 0x01 0x00 0x00 0x00 0x00 0x02 0xFB 0x01
		0x15 0x01 0x00 0x00 0x00 0x00 0x02 0xCF 0x33
		0x15 0x01 0x00 0x00 0x0a 0x00 0x02 0xFF 0x10>;
		lcd-kit,inversion-column-cmds-state = "dsi_lp_mode";
		lcd-kit,inversion-column-cmds = <0x15 0x01 0x00 0x00 0x00 0x00 0x02 0xFF 0x24
		0x15 0x01 0x00 0x00 0x00 0x00 0x02 0xFB 0x01
		0x15 0x01 0x00 0x00 0x00 0x00 0x02 0xCF 0xFF
		0x15 0x01 0x00 0x00 0x0a 0x00 0x02 0xFF 0x10>;
		lcd-kit,inversion-dot-cmds-state = "dsi_lp_mode";
		lcd-kit,panel-gpio-offset = <1167>;
		lcd-kit,panel-bl-max-nit = <820>;
		lcd-kit,panel-bl-min = <4>;
		lcd-kit,panel-bl-max = <4095>;
		lcd-kit,check-reg-support = <1>;
		lcd-kit,check-reg-cmds = <0x06 0x01 0x00 0x00 0x0a 0x00 0x01 0x0a>;
		lcd-kit,check-reg-value = <0x9c>;
		lcd-kit,check-reg-cmds-state = "dsi_lp_mode";
		lcd-kit,thp-proximity-support = <1>;
		lcd-kit,proximity-reset-delay-min = <65>;
		lcd-kit,lcd-power-down-vsp = <2 65 4700000>;
		lcd-kit,lcd-power-down-vsn = <2 26 4700000>;
		lcd-kit,backlight-cmds = <0x39 0x01 0x00 0x00 0x00 0x00 0x03 0x61 0x00 0x00>;
		lcd-kit,backlight-cmds-state = "dsi_lp_mode";
		lcd-kit,backlight-order = <0>;
		lcd-kit,quickly-sleep-out-support = <1>;
		lcd-kit,quickly-sleep-out-interval = <102>;
		qcom,mdss-dsi-display-timings {
			timing@0 {
				qcom,mdss-dsi-panel-width = <1080>;
				qcom,mdss-dsi-panel-height = <2376>;
				qcom,mdss-dsi-h-front-porch = <88>;
				qcom,mdss-dsi-h-back-porch = <80>;
				qcom,mdss-dsi-h-pulse-width = <12>;
				qcom,mdss-dsi-h-sync-skew = <0>;
				qcom,mdss-dsi-v-front-porch = <64>;
				qcom,mdss-dsi-v-back-porch = <34>;
				qcom,mdss-dsi-v-pulse-width = <2>;
				qcom,mdss-dsi-panel-framerate = <60>;
				qcom,mdss-dsi-panel-phy-timings= [27 21 0a 0b 07 03 04 a0
				27 21 0a 0b 07 03 04 a0
				27 21 0a 0b 07 03 04 a0
				27 21 0a 0b 07 03 04 a0
				27 21 0a 0b 07 03 04 a0];
				qcom,display-topology  = <1 0 1>;
				qcom,default-topology-index  = <0>;
				qcom,mdss-dsi-on-command = [15 01 00 00 00 00 02 FF C0
		15 01 00 00 00 00 02 FB 01
		15 01 00 00 00 00 02 C8 07
		15 01 00 00 00 00 02 C9 07
		15 01 00 00 00 00 02 CA 07
		15 01 00 00 00 00 02 CB 07
		15 01 00 00 00 00 02 FF 25
		15 01 00 00 00 00 02 FB 01
		15 01 00 00 00 00 02 18 22
		15 01 00 00 00 00 02 FF 23
		15 01 00 00 00 00 02 FB 01
		15 01 00 00 00 00 02 00 80
		15 01 00 00 00 00 02 07 20
		15 01 00 00 00 00 02 08 01
		15 01 00 00 00 00 02 09 B5
		15 01 00 00 00 00 02 FF 2B
		15 01 00 00 00 00 02 FB 01
		15 01 00 00 00 00 02 FA 05
		15 01 00 00 00 00 06 01 00 00 00 00 00
		15 01 00 00 00 00 02 FA 03
		15 01 00 00 00 00 02 07 CF
		15 01 00 00 00 00 02 FF 10
		15 01 00 00 00 00 02 FB 01
		39 01 00 00 00 00 03 51 0F FF
		15 01 00 00 00 00 02 53 24
		39 01 00 00 00 00 03 61 00 00
		15 01 00 00 00 00 02 63 24
		15 01 00 00 00 00 02 65 01
		39 01 00 00 02 00 11 EA 18 08 64 78 BD 93 78 BE 93 78 BE 93 78 BD 94 78
		39 01 00 00 02 00 11 EB BD 93 78 BE 93 78 BE 93 78 BD 93 79 65 58 00 01
		05 01 00 00 0a 00 01 11
		05 01 00 00 01 00 01 29];
				qcom,mdss-dsi-on-command-state = "dsi_lp_mode";
				qcom,mdss-dsi-off-command = [05 01 00 00 78 00 01 28];
				qcom,mdss-dsi-off-command-state = "dsi_lp_mode";
			};
		};
    };
};