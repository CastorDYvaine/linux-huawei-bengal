/* Copyright (c) 2013, The Linux Foundation. All rights reserved.
 *
 * This program is free software; you can redistribute it and/or modify
 * it under the terms of the GNU General Public License version 2 and
 * only version 2 as published by the Free Software Foundation.
 *
 * This program is distributed in the hope that it will be useful,
 * but WITHOUT ANY WARRANTY; without even the implied warranty of
 * MERCHANTABILITY or FITNESS FOR A PARTICULAR PURPOSE.  See the
 * GNU General Public License for more details.
 */

/*-------------------------------------------------------------------------
 * This file is autogenerated file using gcdb parser. Please do not edit it.
 * Update input XML file to add a new entry or update variable in this file
 * VERSION = 1.1
 *-----------------------------------------------------------------------*/
&mdss_mdp {
	dsi_ali_290_109_6p7_qcom: lcd_kit_ali_290_109_6p7_qcom {
		compatible = "290_109_6p7";
		lcd-kit,panel-name = "290_109 6.7' VIDEO 1080 x 2388";
		lcd-kit,panel-type = <0x01>;
		lcd-kit,panel-ldi-dsi-mode = <1>;
		lcd-kit,bl-after-frame = <0>;
		lcd-kit,vtc-line-no-reset = <0>;
		qcom,mdss-dsi-panel-type = "dsi_video_mode";
		qcom,mdss-dsi-panel-name = "290_109_6p7";
		qcom,mdss-pan-physical-width-dimension = <71>;
		qcom,mdss-pan-physical-height-dimension = <156>;
		qcom,dsi-ctrl-num = <0>;
		qcom,dsi-phy-num = <0>;
		qcom,panel-supply-entries = <&dsi_panel_pwr_supply>;
		qcom,mdss-dsi-virtual-channel-id = <0>;
		qcom,mdss-dsi-h-sync-pulse = <0>;
		qcom,mdss-dsi-bllp-eof-power-mode;
		qcom,mdss-dsi-bllp-power-mode;
		qcom,mdss-dsi-dma-schedule-line = <1>;
		qcom,mdss-dsi-bpp = <24>;
		qcom,mdss-dsi-color-order = "rgb_swap_rgb";
		qcom,mdss-dsi-underflow-color = <0xff>;
		qcom,mdss-dsi-border-color = <0>;
		qcom,mdss-dsi-traffic-mode = "burst_mode";
		qcom,mdss-dsi-lane-map = "lane_map_0123";
		qcom,mdss-dsi-lane-0-state;
		qcom,mdss-dsi-lane-1-state;
		qcom,mdss-dsi-lane-2-state;
		qcom,mdss-dsi-lane-3-state;
		qcom,mdss-dsi-mdp-trigger = "none";
		qcom,mdss-dsi-dma-trigger = "trigger_sw";
		qcom,mdss-dsi-te-pin-select = <0>;
		qcom,mdss-dsi-t-clk-post = <0x0E>;
		qcom,mdss-dsi-t-clk-pre = <0x1D>;
		qcom,mdss-dsi-tx-eot-append;
		qcom,dsi-select-clocks = "mux_byte_clk0", "mux_pixel_clk0", "src_byte_clk0", "src_pixel_clk0", "shadow_byte_clk0", "shadow_pixel_clk0";
		qcom,mdss-dsi-stream = <0>;
		qcom,mdss-dsi-lp11-init;
		qcom,sublinks-count = <2>;
		qcom,lanes-per-sublink = <2>;
		qcom,mdss-dsi-panel-hdr-color-primaries = <14500 15500 32000 17000 15500 30000 8000 3000>;
		qcom,mdss-dsi-panel-peak-brightness = <4200000>;
		qcom,mdss-dsi-panel-blackness-level = <3230>;
		qcom,dynamic-mode-switch-type = "dynamic-resolution-switch-immediate";
		qcom,mdss-dsi-bl-pmic-control-type = "bl_ctrl_i2c_ic";
		pwms = <&pm6125_pwm 0 0>;
		qcom,bl-pmic-pwm-period-usecs = <100>;
		lcd-kit,power-on-stage = <11 1 1
				7 1 2
				3 1 2
				4 1 2
				5 1 5
				5 2 5
				5 1 20
				8 1 1
				6 1 0>;
		lcd-kit,lp-on-stage = <>;
		lcd-kit,lp-off-stage = <0 0 0>;
		lcd-kit,power-off-stage = <7 0 5
				8 0 5
				5 0 5
				4 0 2
				3 0 2
				11 0 2>;
		lcd-kit,only-power-off-stage = <5 0 5
				4 0 0
				3 0 6>;
		lcd-kit,pt-support = <1>;
		lcd-kit,panel-on-always-reset = <1>;
		lcd-kit,panel-pt-always-keep-reset-high = <0>;
		lcd-kit,lcd-vsp = <3 0 5500000>;
		lcd-kit,lcd-vsn = <3 0 5500000>;
		lcd-kit,lcd-reset = <2 82 0>;
		lcd-kit,project-id-support = <1>;
		lcd-kit,default-project-id = "G454CC2700";
		lcd-kit,sn-code-support = <1>;
		lcd-kit,oem-info-support = <1>;
		lcd-kit,oem-barcode-2d-support = <1>;
		lcd-kit,oem-barcode-2d-num-offset = <0>;
		lcd-kit,barcode-2d-cmds = <0x15 0x01 0x00 0x00 0x00 0x00 0x02 0xB0 0x00
                0x06 0x01 0x00 0x00 0x0a 0x00 0x19 0xBF 0x04 0x00 0x00 0x00 0x00 0x00 0x00 0x00 0x00 0x00 0x00 0x00 0x00 0x00 0x00 0x00 0x00 0x00 0x00 0x00 0x00 0x00 0x00 0x00
                0x15 0x01 0x00 0x00 0x00 0x00 0x02 0xB0 0x03>;
		lcd-kit,barcode-2d-cmds-state = "dsi_lp_mode";
		lcd-kit,panel-getblmaxnit-type = <0>;
		lcd-kit,panel-blmaxnit-min-value = <370>;
		lcd-kit,panel-bl-maxnit-command = <0x06 0x01 0x00 0x00 0x0a 0x00 0x01 0xdb>;
		lcd-kit,panel-bl-maxnit-command-state = "dsi_lp_mode";
		lcd-kit,inversion-support = <1>;
		lcd-kit,panel-gpio-offset = <1167>;
		lcd-kit,panel-bl-max-nit = <450>;
		lcd-kit,panel-bl-min = <18>;
		lcd-kit,panel-bl-max = <6000>;
		lcd-kit,panel-bl-def = <6000>;
		lcd-kit,check-reg-support = <0>;
		lcd-kit,thp-proximity-support = <1>;
		lcd-kit,proximity-reset-delay-min = <65>;
		lcd-kit,proximity-power-off-delay-min = <210>;
		lcd-kit,lcd-power-down-vsp = <3 0 4700000>;
		lcd-kit,lcd-power-down-vsn = <3 0 4700000>;
		lcd-kit,backlight-order = <0>;
		lcd-kit,quickly-sleep-out-support = <0>;
		lcd-kit,quickly-sleep-out-interval = <102>;
		lcd-kit,fps-support = <0>;
		lcd-kit,default-fps = <90>;
		lcd-kit,panel-support-fps-list = <90>;
		qcom,mdss-dsi-display-timings {
			timing@0 {
				qcom,mdss-dsi-panel-width = <1080>;
				qcom,mdss-dsi-panel-height = <2388>;
				qcom,mdss-dsi-h-front-porch = <50>;
				qcom,mdss-dsi-h-back-porch = <30>;
				qcom,mdss-dsi-h-pulse-width = <8>;
				qcom,mdss-dsi-h-sync-skew = <0>;
				qcom,mdss-dsi-v-front-porch = <64>;
				qcom,mdss-dsi-v-back-porch = <30>;
				qcom,mdss-dsi-v-pulse-width = <2>;
				qcom,mdss-dsi-panel-framerate = <90>;
				qcom,mdss-dsi-panel-phy-timings= [00 16 05 05 14 1F 06
				05 06 02 04 00 13 0A];
				qcom,display-topology  = <1 1 1>;
				qcom,default-topology-index  = <0>;
				qcom,mdss-dsi-on-command = [15 01 00 00 00 00 02 B0 00
            39 01 00 00 00 00 11 B6 30 6b 00 86 12 0a 13 1a 00 02 0a 0a 02 20 FF FF
            39 01 00 00 00 00 05 B7 51 00 00 00
            39 01 00 00 00 00 08 B8 57 3d 19 be 1e 0a 0a
            39 01 00 00 00 00 08 B9 6f 3d 28 be 3c 14 0a
            39 01 00 00 00 00 08 BA b5 33 41 be 64 23 0a
            39 01 00 00 00 00 0C BB 44 26 c3 1f 19 06 03 c0 00 00 10
            39 01 00 00 00 00 0C BC 32 4c c3 52 32 1f 03 f2 00 00 13
            39 01 00 00 00 00 0C BD 24 68 c3 aa 3f 32 03 ff 00 00 25
            39 01 00 00 00 00 0D BE 00 00 00 00 00 00 00 00 00 00 00 00
            39 01 00 00 00 00 24 C0 00 67 01 2c 14 09 54 00 0c 22 00 08 00 70 00 00 00 00 00 00 00 00 02 01 2c 01 2c 01 2c 00 00 00 00 00 00
            39 01 00 00 00 00 63 C1 30 00 00 11 00 00 00 00 22 00 05 20 00 80 fa 40 00 84 0f 00 00 00 00 00 00 00 00 00 00 00 00 00 00 00 00 00 00 00 00 00 00 01 2c 08 08 bf 07 d0 0b b8 0f a0 11 94 12 5c 1b 58 00 03 00 ff f5 84 7a a0 00 00 00 00 00 00 00 00 00 00 00 00 00 00 00 00 00 00 00 00 00 00 00 00 64 A1 00 01 00 0E 37 D0
            39 01 00 00 00 00 A0 C2 00 70 60 02 02 10 03 05 00 00 00 00 00 00 00 00 00 00 00 00 00 00 00 00 00 00 00 00 70 60 08 08 01 04 c1 00 20 04 00 00 02 08 00 00 00 00 11 00 30 04 08 00 00 00 00 00 00 00 00 00 00 00 00 00 00 00 00 00 00 00 00 00 11 00 00 00 00 00 00 00 00 00 00 00 00 00 00 00 00 00 00 00 00 00 00 00 11 00 00 00 00 00 00 00 00 00 00 00 00 00 00 00 00 00 00 00 00 00 00 00 11 00 00 00 00 00 00 00 00 00 00 00 00 00 00 00 00 00 00 00 00 00 00 00 00 00 00 00 00 00 00 00 00 00 00 00 00 00 00
            39 01 00 00 00 00 6D C3 00 00 00 00 00 00 00 00 00 00 00 00 00 00 00 00 00 00 00 00 00 00 00 00 00 00 00 00 00 00 00 00 00 00 00 00 00 00 00 00 00 00 00 00 00 00 00 00 00 00 00 00 00 00 00 00 00 00 00 00 00 00 aa aa aa 00 00 00 00 00 00 00 00 00 00 00 00 00 00 c0 00 00 00 00 00 00 00 00 00 00 00 00 00 00 00 00 00 00 00 00 00 00 00 00 00 00 00 00
            39 01 00 00 00 00 7B C4 03 0f 11 13 15 bd 00 bc 00 4f 4c 4f 00 61 5f 5d 00 00 00 61 5f 5d 00 00 02 0e 10 12 14 bd 00 bc 00 4f 4c 4f 00 61 5f 5d 00 00 00 61 5f 5d 00 00 ff ff ff ff ff ff 01 ec 38 01 ec 38 00 08 00 00 08 00 00 e0 38 00 e0 38 00 00 00 00 00 00 03 00 00 00 03 00 00 00 00 00 09 53 55 40 11 c7 40 11 c7 00 00 00 00 00 00 00 00 00 00 00 00 00 00 00 00 00 00 00 00 00 00 00 00 00
            39 01 00 00 00 00 06 C5 08 00 00 00 00
            39 01 00 00 00 00 58 C6 02 0a 08 fc ff ff ff 00 30 13 01 AF 0F 01 03 20 1E 1D 00 00 00 01 05 09 28 28 01 03 20 1E 1D 01 0b 00 00 00 1e 01 00 00 00 00 00 00 20 20 00 00 12 00 00 00 00 00 22 22 00 00 00 00 10 00 01 00 00 00 00 01 00 00 00 00 01 00 00 00 00 05 00 1f 08 FC FF FF FF 01 00
            39 01 00 00 00 00 10 CB 20 80 70 00 20 00 00 2d 41 00 00 00 00 00 ff
            15 01 00 00 00 00 02 CD 00
            39 01 00 00 00 00 24 CE 5d 40 49 53 59 5e 63 68 6e 74 7e 8a 98 a8 bb d0 e7 ff 04 00 04 04 42 40 69 5a 40 00 00 00 00 04 fa 00 00
            39 01 00 00 00 00 07 CF 89 00 80 46 61 00
            39 01 00 00 00 00 13 D0 cc 1e d5 66 09 b0 00 cf 0f 05 d4 e6 52 fe 09 09 cf 00
            39 01 00 00 00 00 3C D1 bc bc 1b b0 07 07 3b 55 55 55 55 05 77 7b 07 77 3b 78 d2 d2 04 96 10 93 22 22 22 b3 bb 80 00 bb bb 11 00 08 c0 c0 09 77 ff 11 44 11 01 11 01 44 04 44 04 77 77 77 05 05 30 33 FF
            39 01 00 00 00 00 18 D4 00 00 00 00 00 00 00 00 00 00 00 00 00 00 00 00 00 00 00 00 00 00 00
            39 01 00 00 00 00 50 D7 21 10 52 52 00 67 00 0c 00 67 04 fd 01 00 03 00 05 05 00 03 04 05 00 04 00 08 02 08 06 03 08 04 08 10 0c 0b 0a 0a 0a 07 07 06 06 00 08 08 04 05 09 00 04 04 04 04 04 04 04 02 04 04 04 04 04 04 04 04 04 04 06 06 05 05 05 00 00 00 00 00 00
            39 01 00 00 00 00 17 D9 40 99 26 ED 16 6C 16 6C 16 6C 00 14 00 14 00 14 01 0C 00 00 01 00
            39 01 00 00 00 00 05 DD 30 06 23 65
            39 01 00 00 00 00 0D DE 00 00 00 0f ff 00 00 00 00 10 00 67
            39 01 00 00 00 00 0B E6 00 00 00 00 00 00 00 00 00 00
            39 01 00 00 00 00 B7 E7 11 00 89 30 80 09 54 04 38 00 0C 02 1c 02 1c 02 00 02 0e 20 01 1F 00 07 0c 08 BB 08 7A 18 00 10 f0 03 0c 20 00 06 0b 0b 33 0e 1c 2a 38 46 54 62 69 70 77 79 7b 7d 7e 01 02 01 00 09 40 09 be 19 fc 19 fa 19 f8 1a 38 1a 78 1a b6 2a f6 2b 34 2b 74 3b 74 6b f4 00 00 00 00 00 00 11 00 89 30 80 09 54 04 38 00 0C 02 1c 02 1c 02 00 02 0e 20 01 1F 00 07 0c 08 BB 08 7A 18 00 10 f0 03 0c 20 00 06 0b 0b 33 0e 1c 2a 38 46 54 62 69 70 77 79 7b 7d 7e 01 02 01 00 09 40 09 be 19 fc 19 fa 19 f8 1a 38 1a 78 1a b6 2a f6 2b 34 2b 74 3b 74 6b f4 00 00 00 00 00 00
            39 01 00 00 00 00 05 E8 00 30 63 00
            39 01 00 00 00 00 26 EA 01 09 0f 00 10 40 00 00 09 00 03 dd 00 00 00 00 00 00 00 00 04 c2 00 12 00 50 05 00 86 00 00 00 00 00 00 00 00
            39 01 00 00 00 00 08 EB 00 00 00 00 01 00 11
            39 01 00 00 00 00 0B EC 05 f0 00 11 05 10 40 00 02 3a
            39 01 00 00 00 00 21 ED 01 01 02 02 04 04 05 05 07 07 08 08 02 00 00 00 00 00 00 00 00 00 00 d0 00 00 00 00 00 ec 10 00
            39 01 00 00 00 00 64 EE c1 3f 00 00 00 f0 03 00 00 00 00 f2 3f 00 00 00 00 00 00 00 00 00 00 00 3f 00 00 00 00 c0 00 00 c0 00 00 00 00 00 00 c0 00 00 00 00 00 00 00 00 00 00 00 03 00 00 03 1D 00 00 00 00 00 00 00 00 00 00 00 00 00 00 00 00 00 00 00 00 00 00 00 00 00 00 00 00 00 00 00 00 00 00 00 00 00 00 00 00 00 00 00
            39 01 00 00 00 00 71 EF 00 70 25 04 30 00 00 00 00 19 19 19 00 00 00 00 00 00 00 00 00 00 70 25 04 30 19 19 19 00 00 00 00 00 00 10 02 10 02 00 10 00 10 00 0a 06 00 00 00 00 00 0b 00 03 51 00 00 05 00 00 00 00 00 00 00 00 00 00 00 00 00 00 00 00 00 00 00 00 00 00 02 00 02 00 00 00 00 00 00 00 00 00 00 00 00 00 00 00 00 00 00 00 00 00 00 00 00 00 00 00 00 00
            39 01 00 00 00 00 08 F9 44 3f 00 8d bf 00 00
            39 01 00 00 00 00 05 E5 03 00 00 00
            29 01 00 00 00 00 05 D5 00 28 00 28
            15 01 00 00 00 00 02 B0 03
            05 01 00 00 50 00 01 11
            05 01 00 00 14 00 01 29];
				qcom,mdss-dsi-on-command-state = "dsi_lp_mode";
				qcom,mdss-dsi-off-command = [05 01 00 00 14 00 01 28
                05 01 00 00 78 00 01 10];
				qcom,mdss-dsi-off-command-state = "dsi_lp_mode";
				qcom,compression-mode = "dsc";
				qcom,mdss-dsc-slice-height = <12>;
				qcom,mdss-dsc-slice-width = <540>;
				qcom,mdss-dsc-slice-per-pkt = <2>;
				qcom,mdss-dsc-bit-per-component = <8>;
				qcom,mdss-dsc-bit-per-pixel = <8>;
				qcom,mdss-dsc-block-prediction-enable;
			};
		};
    };
};