/*---------------------------------------------------------------------------
 * This file is autogenerated file using huawei LCD parser. Please do not edit it.
 * Update input XML file to add a new entry or update variable in this file
 * Parser location: vendor/huawei/chipset_common/devkit/lcdkit/tools 
 *---------------------------------------------------------------------------*/


#include "bne_310_c03_6p67_qcom.dtsi"
#include "bne_350_c03_6p67_qcom.dtsi"
#include "bne_auo_otm1901a_5p2_1080p_video_default.dtsi"