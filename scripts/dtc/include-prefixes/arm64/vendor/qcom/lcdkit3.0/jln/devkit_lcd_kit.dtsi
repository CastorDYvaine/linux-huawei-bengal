/*---------------------------------------------------------------------------
 * This file is autogenerated file using huawei LCD parser. Please do not edit it.
 * Update input XML file to add a new entry or update variable in this file
 * Parser location: vendor/huawei/chipset_common/devkit/lcdkit/tools 
 *---------------------------------------------------------------------------*/


#include "jln_110_210_6p78_qcom.dtsi"
#include "jln_110_a06_6p78_qcom.dtsi"
#include "jln_190_105_6p78_qcom.dtsi"
#include "jln_190_210_6p78_qcom.dtsi"
#include "jln_auo_otm1901a_5p2_1080p_video_default.dtsi"