/*---------------------------------------------------------------------------
 * This file is autogenerated file using huawei LCD parser. Please do not edit it.
 * Update input XML file to add a new entry or update variable in this file
 * Parser location: vendor/huawei/chipset_common/devkit/lcdkit/tools 
 *---------------------------------------------------------------------------*/


#include "mao_110_a06_1_6p78_qcom.dtsi"
#include "mao_190_210_1_6p78_qcom.dtsi"
#include "mao_auo_otm1901a_5p2_1080p_video_default.dtsi"