/*---------------------------------------------------------------------------
 * This file is autogenerated file using huawei LCD parser. Please do not edit it.
 * Update input XML file to add a new entry or update variable in this file
 * Parser location: vendor/huawei/chipset_common/devkit/lcdkit/tools 
 *---------------------------------------------------------------------------*/


#include "ags5_120_601_10p36_qcom.dtsi"
#include "ags5_190_5031_10p36_qcom.dtsi"
#include "ags5_190_5032_10p36_qcom.dtsi"
#include "ags5_190_503_10p36_qcom.dtsi"
#include "ags5_190_d04_10p36_qcom.dtsi"
#include "ags5_auo_otm1901a_5p2_1080p_video_default.dtsi"