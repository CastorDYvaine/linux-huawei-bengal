&mdss_mdp {
	dsi_nt36672c_fhd_plus_120hz_video: qcom,mdss_dsi_nt36672c_fhd_plus_120hz_video {
		qcom,mdss-dsi-panel-name =
			"nt36672c 120Hz fhd plus video mode panel with DSC";
		qcom,mdss-dsi-panel-type = "dsi_video_mode";
		qcom,dsi-ctrl-num = <0>;
		qcom,dsi-phy-num = <0>;
		qcom,mdss-dsi-virtual-channel-id = <0>;
		qcom,mdss-dsi-stream = <0>;

		qcom,mdss-dsi-h-left-border = <0>;
		qcom,mdss-dsi-h-right-border = <0>;
		qcom,mdss-dsi-v-top-border = <0>;
		qcom,mdss-dsi-v-bottom-border = <0>;
		qcom,mdss-dsi-bpp = <24>;
		qcom,mdss-dsi-color-order = "rgb_swap_rgb";
		qcom,mdss-dsi-underflow-color = <0xff>;
		
		qcom,mdss-dsi-border-color = <0>;
		qcom,mdss-dsi-h-sync-pulse = <0>;
		qcom,mdss-dsi-traffic-mode = "non_burst_sync_event";  
		qcom,mdss-dsi-lane-map = "lane_map_0123";
		qcom,mdss-dsi-bllp-eof-power-mode;
		qcom,mdss-dsi-bllp-power-mode;
		qcom,mdss-dsi-tx-eot-append;
		qcom,mdss-dsi-lane-0-state;
		qcom,mdss-dsi-lane-1-state;
		qcom,mdss-dsi-lane-2-state;
		qcom,mdss-dsi-lane-3-state;
		qcom,mdss-dsi-dma-trigger = "trigger_sw";
		qcom,mdss-dsi-mdp-trigger = "none";
		qcom,mdss-dsi-lp11-init;
		qcom,mdss-dsi-bl-pmic-control-type = "bl_ctrl_external";
		qcom,mdss-dsi-reset-sequence = <1 10>, <0 10>, <1 10>;
		qcom,mdss-dsi-te-pin-select = <1>;
		qcom,mdss-dsi-te-dcs-command = <1>;
		qcom,mdss-dsi-te-check-enable;
		qcom,mdss-dsi-te-using-te-pin;
		
	    qcom,mdss-dsi-force-clock-lane-hs;   //check
		qcom,mdss-pan-physical-width-dimension = <71>;
		qcom,mdss-pan-physical-height-dimension = <157>;
		qcom,mdss-dsi-display-timings {
			timing@0 {
				qcom,mdss-dsi-panel-width = <1080>;
				qcom,mdss-dsi-panel-height = <2388>;
				qcom,mdss-dsi-h-pulse-width = <36>;
				qcom,mdss-dsi-h-back-porch = <48>;
				qcom,mdss-dsi-h-front-porch = <72>;
				
				qcom,mdss-dsi-h-sync-skew = <0>;
				qcom,mdss-dsi-v-pulse-width = <12>;
				qcom,mdss-dsi-v-back-porch = <24>;
				qcom,mdss-dsi-v-front-porch = <48>;
				qcom,mdss-dsi-panel-framerate = <60>; 
				qcom,mdss-dsi-on-command = [
				15 01 00 00 00 00 02 FF	25
				15 01 00 00 00 00 02 FB	01
				15 01 00 00 00 00 02 18	21	
				15 01 00 00 00 00 02 FF	10
				15 01 00 00 00 00 02 FB	01
				15 01 00 00 00 00 02 36	00
				39 01 00 00 00 00 06 3B	03 24 30 04 04
				15 01 00 00 00 00 02 B0	00
				15 01 00 00 00 00 02 C0	00
				15 01 00 00 00 00 02 FF	27
				15 01 00 00 00 00 02 FB	01
				15 01 00 00 00 00 02 E3	02
				15 01 00 00 00 00 02 E4	DD
				15 01 00 00 00 00 02 E9	03
				15 01 00 00 00 00 02 EA	2D	
				15 01 00 00 00 00 02 FF	2A
				15 01 00 00 00 00 02 FB	01
				15 01 00 00 00 00 02 45	0E
				15 01 00 00 00 00 02 46	40
				15 01 00 00 00 00 02 47	03
				15 01 00 00 00 00 02 4A	9F
				15 01 00 00 00 00 02 4E	0F
				15 01 00 00 00 00 02 4F	28
				15 01 00 00 00 00 02 52	0E
				15 01 00 00 00 00 02 53	FC
				15 01 00 00 00 00 02 54	24
				15 01 00 00 00 00 02 56	30
				15 01 00 00 00 00 02 57	76
				15 01 00 00 00 00 02 58	76
				15 01 00 00 00 00 02 59	76	
				15 01 00 00 00 00 02 FF	2C
				15 01 00 00 00 00 02 FB	01
				15 01 00 00 00 00 02 00	03
				15 01 00 00 00 00 02 01	03
				15 01 00 00 00 00 02 02	03
				15 01 00 00 00 00 02 03	1E
				15 01 00 00 00 00 02 04	1E
				15 01 00 00 00 00 02 05	1E
				15 01 00 00 00 00 02 0D	01
				15 01 00 00 00 00 02 0E	01
				15 01 00 00 00 00 02 16	03
				15 01 00 00 00 00 02 17	6C
				15 01 00 00 00 00 02 18	6C
				15 01 00 00 00 00 02 19	6C
				15 01 00 00 00 00 02 2D	AF
				15 01 00 00 00 00 02 2F	10
				15 01 00 00 00 00 02 30	F2
				15 01 00 00 00 00 02 32	00
				15 01 00 00 00 00 02 33	F2
				15 01 00 00 00 00 02 35	1E
				15 01 00 00 00 00 02 37	1E
				15 01 00 00 00 00 02 4D	21
				15 01 00 00 00 00 02 4E	04
				15 01 00 00 00 00 02 4F	01	
				15 01 00 00 00 00 02 FF	F0
				15 01 00 00 00 00 02 FB	01
				15 01 00 00 00 00 02 1C	01
				15 01 00 00 00 00 02 33	01
				15 01 00 00 00 00 02 5A	00	
				15 01 00 00 00 00 02 FF E0
				15 01 00 00 00 00 02 FB	01
				15 01 00 00 00 00 02 35	82	
				15 01 00 00 00 00 02 FF	C0
				15 01 00 00 00 00 02 FB	01
				15 01 00 00 00 00 02 9C	11
				15 01 00 00 00 00 02 9D	11	
				15 01 00 00 00 00 02 FF	D0
				15 01 00 00 00 00 02 FB	01
				15 01 00 00 00 00 02 53	22
				15 01 00 00 00 00 02 54	02	
				15 01 00 00 00 00 02 FF	10
				15 01 00 00 78 00 02 11 00
				15 01 00 00 32 00 02 29 00];
				qcom,mdss-dsi-off-command = [
						15 01 00 00 32 00 02 28 00
						15 01 00 00 96 00 02 10 00];
				qcom,mdss-dsi-on-command-state = "dsi_lp_mode";
				qcom,mdss-dsi-off-command-state = "dsi_lp_mode";
			};
		};
	};
};
