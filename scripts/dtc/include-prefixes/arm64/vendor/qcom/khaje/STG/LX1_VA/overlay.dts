/dts-v1/;
/plugin/;

#include "../common/common.dtsi"
#include "huawei-wifi.dtsi"
#include "huawei-nfc.dtsi"
#include "huawei-camera.dtsi"

/ {
    model = "Huawei Technologies, Inc. STG-LX1";
    huawei,board-id = <8317>;
};

&huawei_lcd_panel {
	compatible = "huawei,lcd_panel_type";
	/* auto_key_info @ name: product_id type: uint32 default: 0 */
	product_id = <14001>;
	/* auto_key_info @ name: product_type type: uint32 default: 0 */
	product_type = <0>;
	detect_type = <2>;
	/* auto_key_info @ name: gpio_id[2] type: int default: 0 */
	gpio_id = <52 37>;
	/* auto_key_info @ name: lcd_kit_power_ctrl type: uint32 default: 0 */
	lcd_kit_power_ctrl = <1>;
	/* auto_key_info @ name: lcd_kit_bias_iic_ctrl type: uint32 default: 0 */
	lcd_kit_bias_iic_ctrl = <1>;
	/* auto_key_info @ name: tp_reset_gpio type: uint32 default: 0 */
	tp_reset_gpio = <86>;
	support_lcd_type = "LCD_KIT";
};

&sde_dsi {
	qcom,dsi-default-panel = <&dsi_stg_auo_otm1901a_5p2_1080p_video_default>;
};

&rootparam {
    /* auto_key_info @ name: boardid type: uint32 default: 0 */
    qcom,boardid = <8 3 1 7>;
    qcom,board_name = "STG_LX1_VA";
    qcom,product_name = "STG-LX1";
    hardware_version = "HL2STGM";
    huawei,modem_id = <0xFD470100 0x0>;
};
