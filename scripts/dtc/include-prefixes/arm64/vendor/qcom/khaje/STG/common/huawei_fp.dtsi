/* fingerprint panel config */
&soc {
    huawei_fingerprint {
                compatible = "fpc,fingerprint";
                interrupt-parent = <&tlmm>;
                interrupts = <25 0x2008>;
                avdd-supply = <&L5A>;
                fingerprint,avdd = "avdd";
                fingerprint,avdd-min-uv = <3000000>;
                fingerprint,avdd-max-uv = <3000000>;
                fingerprint,navigation_adjust1 = <0>;
                fingerprint,navigation_adjust2 = <90>;
                fingerprint,reset_gpio = <&tlmm 84 0x0>;
                fingerprint,irq_gpio = <&tlmm 25 0x2008>;
                status = "ok";
        };
};


&fingerprint {
    fingerprint,product = "julia";
};

&sdhc_2 {
    status = "disabled";
};
