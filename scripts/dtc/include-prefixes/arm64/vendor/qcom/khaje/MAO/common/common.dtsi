#include "../../common/common.dtsi"
#include "huawei-lcd.dtsi"
#include "huawei_bt.dtsi"
#include "huawei-tp.dtsi"
#include "huawei_audio.dtsi"
#include "huawei_charger_40W.dtsi"
#include "huawei-sensor.dtsi"
#include "huawei_fp.dtsi"
#include "huawei_board_detect.dtsi"

