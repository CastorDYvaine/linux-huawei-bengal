/dts-v1/;
/plugin/;

#include "../common/common.dtsi"
#include "huawei-charger.dtsi"
#include "huawei-lcd.dtsi"
#include "huawei-camera.dtsi"
#include "huawei-wifi.dtsi"

/ {
    model = "Huawei Technologies, Inc. JLN-AL00";
    huawei,board-id = <8510>;
};

&rootparam {
    /* auto_key_info @ name: boardid type: uint32 default: 0 */
    qcom,boardid = <8 5 1 0>;
    qcom,board_name = "JLN_AL00_VE";
    qcom,product_name = "JLN-AL00";
    hardware_version = "HL1JLNM";
    huawei,modem_id = <0xFD440200 0x0>;
};
