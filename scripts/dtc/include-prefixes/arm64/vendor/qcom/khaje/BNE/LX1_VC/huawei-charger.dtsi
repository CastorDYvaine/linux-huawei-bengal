&huawei_batt_info {
    shield_ct_sign = <1>;
};

&direct_charge_ic {
	/* ic_index  path_index  max_ibat  ibat_sample_point  vbat_sample_point */
	ic_para1 =
		"0", "0", "5000", "0", "0",
		"1", "-1", "0", "1", "0";
	ic_para2 =
		"0", "0", "7000", "0", "0",
		"1", "1", "6000", "1", "1";
	mode_para =
		"lvc_mode", "ic_para1",
		"sc_mode", "ic_para2";
        use_coul_ibat = <1>;
	status = "ok";
};

&direct_charger_sc{
	current_ratio =
		"3", "8", "16", "2", "-1",
		"3", "8", "16", "1", "8000",
		"0", "8", "16", "0", "0";
};
