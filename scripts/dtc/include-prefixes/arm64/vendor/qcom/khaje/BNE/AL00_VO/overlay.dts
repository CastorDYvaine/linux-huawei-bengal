/dts-v1/;
/plugin/;

#include "../common/common.dtsi"
#include "huawei-charger.dtsi"
#include "huawei-lcd.dtsi"
#include "huawei-camera.dtsi"
#include "huawei-nfc.dtsi"
#include "huawei-wifi.dtsi"
#include "../AL00_VN/huawei-thp.dtsi"
#include "huawei-storage.dtsi"

/ {
    model = "Huawei Technologies, Inc. BNE-AL00";
    huawei,board-id = <8567>;
};

&rootparam {
    /* auto_key_info @ name: boardid type: uint32 default: 0 */
    qcom,boardid = <8 5 6 7>;
    qcom,board_name = "BON_AL00_VO";
    qcom,product_name = "BNE-AL00";
    hardware_version = "HL1BNEMA";
    huawei,modem_id = <0xFD460600 0x0>;
};
