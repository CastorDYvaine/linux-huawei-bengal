&huawei_batt_info {
	shield_ct_sign = <1>;
};

&charging_core {
	temp_para =
		"-32767","1","-1","0","4100","0",
		"1","5","-1","1200","4496","0",
		"5","13","-1","1200","4496","3",
		"13","45","-1","-1","4496","3",
		"45","50","-1","1400","4100","3",
		"50","32767","-1","0","4100","0";
	status = "ok";
};

&direct_charger_sc{
	bat_para =
		"default", "13", "23", "volt_para",
		"default", "23", "45", "volt_para1",
		"CAE", "13", "23", "volt_para",
		"CAE", "23", "45", "volt_para1",
		"CBL", "13", "23", "volt_para",
		"CBL", "23", "45", "volt_para1",
		"CGL", "13", "23", "volt_para",
		"CGL", "23", "45", "volt_para1";
	temp_para =
		"-32767", "13", "0",
		"13", "46", "12000",
		"46", "32767", "0";
};
