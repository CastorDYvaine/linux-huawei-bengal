/dts-v1/;
/plugin/;

#include "../common/common.dtsi"
#include "huawei-charger.dtsi"
#include "huawei-lcd.dtsi"
#include "huawei-wifi.dtsi"

/ {
    model = "Huawei Technologies, Inc. CTR-AL00";
    huawei,board-id = <8551>;
};

&rootparam {
    /* auto_key_info @ name: boardid type: uint32 default: 0 */
    qcom,boardid = <8 5 5 1>;
    qcom,board_name = "CTR_AL00_VD";
    qcom,product_name = "CTR-AL00";
    hardware_version = "HL1CTRM";
    huawei,modem_id = <0xFD450800 0x0>;
};
