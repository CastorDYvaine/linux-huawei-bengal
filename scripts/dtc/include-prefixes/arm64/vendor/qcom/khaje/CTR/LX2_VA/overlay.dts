/dts-v1/;
/plugin/;

#include "../common/common.dtsi"
#include "huawei-charger.dtsi"
#include "huawei-lcd.dtsi"
#include "huawei-wifi.dtsi"
#include "huawei_audio.dtsi"

/ {
    model = "Huawei Technologies, Inc. CTR-LX2";
    huawei,board-id = <8522>;
};

&rootparam {
    /* auto_key_info @ name: boardid type: uint32 default: 0 */
    qcom,boardid = <8 5 2 2>;
    qcom,board_name = "CTR_LX2_VA";
    qcom,product_name = "CTR-LX2";
    hardware_version = "LLDM599";
    huawei,modem_id = <0xFD450200 0x0>;
};
