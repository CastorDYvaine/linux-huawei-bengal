/dts-v1/;
/plugin/;

#include "../common/common.dtsi"
#include "huawei-charger.dtsi"
#include "huawei-lcd.dtsi"
#include "huawei-wifi.dtsi"

/ {
    model = "Huawei Technologies, Inc. CTR-LX2";
    huawei,board-id = <8526>;
};

&rootparam {
    /* auto_key_info @ name: boardid type: uint32 default: 0 */
    qcom,boardid = <8 5 2 6>;
    qcom,board_name = "CTR_LX2_VB";
    qcom,product_name = "CTR-LX2";
    hardware_version = "LLDM599";
    huawei,modem_id = <0xFD450600 0x0>;
};
