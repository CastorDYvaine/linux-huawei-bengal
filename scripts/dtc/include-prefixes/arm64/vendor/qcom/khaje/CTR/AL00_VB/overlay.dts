/dts-v1/;
/plugin/;

#include "../common/common.dtsi"
#include "huawei-charger.dtsi"
#include "huawei-lcd.dtsi"
#include "huawei-wifi.dtsi"

/ {
    model = "Huawei Technologies, Inc. CTR-AL00";
    huawei,board-id = <8524>;
};

&rootparam {
    /* auto_key_info @ name: boardid type: uint32 default: 0 */
    qcom,boardid = <8 5 2 4>;
    qcom,board_name = "CTR_AL00_VB";
    qcom,product_name = "CTR-AL00";
    hardware_version = "LLDM599";
    huawei,modem_id = <0xFD450400 0x0>;
};
