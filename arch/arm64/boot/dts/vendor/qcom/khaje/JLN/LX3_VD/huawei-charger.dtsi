&huawei_batt_info {
         shield_ct_sign = <1>;
};

&direct_charger_sc{
	volt_para =
		"4150", "8000", "6000",
		"4250", "6000", "4800",
		"4300", "4800", "4000",
		"4450", "4000", "2800",
		"4460", "2800", "400";
	volt_para1 =
		"4180", "12400", "10000",
		"4250", "10000", "8000",
		"4300", "8000", "6050",
		"4380", "6050", "4850",
		"4450", "4850", "4050",
		"4460", "4050", "800";
	volt_para2 =
		"4180", "12400", "10000",
		"4250", "10000", "8000",
		"4300", "8000", "6050",
		"4380", "6050", "4850",
		"4450", "4850", "4050",
		"4460", "4050", "1150";
	bat_para =
		"default", "10", "20", "volt_para",
		"default", "20", "45", "volt_para1",
		"CAE", "10", "20", "volt_para",
		"CAE", "20", "35", "volt_para1",
		"CAE", "35", "45", "volt_para2";
};
