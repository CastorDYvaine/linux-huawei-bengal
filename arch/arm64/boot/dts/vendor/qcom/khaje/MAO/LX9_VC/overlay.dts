/dts-v1/;
/plugin/;

#include "../common/common.dtsi"
#include "huawei-charger.dtsi"
#include "huawei-lcd.dtsi"
#include "huawei-wifi.dtsi"
#include "huawei_audio.dtsi"
#include "huawei-camera.dtsi"

/ {
    model = "Huawei Technologies, Inc. MAO-LX9";
    huawei,board-id = <8466>;
};

&rootparam {
    /* auto_key_info @ name: boardid type: uint32 default: 0 */
    qcom,boardid = <8 4 6 6>;
    qcom,board_name = "MAO_LX9_VC";
    qcom,product_name = "MAO-LX9";
    hardware_version = "LLDM555";
    huawei,modem_id = <0xFD480100 0x0>;
};
