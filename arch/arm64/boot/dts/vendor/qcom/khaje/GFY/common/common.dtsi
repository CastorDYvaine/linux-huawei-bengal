#include "../../common/common.dtsi"
#include "huawei_charger_22p5W.dtsi"
#include "huawei-lcd.dtsi"
#include "huawei_fp.dtsi"
#include "huawei-tp.dtsi"
#include "huawei-sensor.dtsi"
#include "huawei_audio.dtsi"
#include "huawei_fac.dtsi"
#include "huawei-camera.dtsi"
#include "huawei-bt.dtsi"
