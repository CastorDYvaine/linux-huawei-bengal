/dts-v1/;
/plugin/;

#include "../common/common.dtsi"
#include "huawei-wifi.dtsi"
#include "huawei-nfc.dtsi"
#include "huawei-charger.dtsi"

/ {
    model = "Huawei Technologies, Inc. GFY-LX1";
    huawei,board-id = <8400>;
};

&rootparam {
    /* auto_key_info @ name: boardid type: uint32 default: 0 */
    qcom,boardid = <8 4 0 0>;
    qcom,board_name = "GFY_LX1_VC";
    qcom,product_name = "GFY-LX1";
    hardware_version = "HL1GFYM";
    huawei,modem_id = <0xFD4A0100 0x0>;
};
