/dts-v1/;
/plugin/;

#include "../common/common.dtsi"
#include "huawei-wifi.dtsi"

/ {
    model = "Huawei Technologies, Inc. ALI-AL00";
    huawei,board-id = <8404>;
};

&rootparam {
    /* auto_key_info @ name: boardid type: uint32 default: 0 */
    qcom,boardid = <8 4 0 4>;
    qcom,board_name = "ALA_AL00_VA";
    qcom,product_name = "ALI-AL00";
    hardware_version = "HL1ALAM";
    huawei,modem_id = <0xFD4B0000 0x0>;
};
