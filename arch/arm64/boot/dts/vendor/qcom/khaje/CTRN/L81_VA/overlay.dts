/dts-v1/;
/plugin/;

#include "../common/common.dtsi"
#include "huawei-wifi.dtsi"
#include "huawei-charger.dtsi"
#include "huawei-nfc.dtsi"

/ {
    model = "Huawei Technologies, Inc. CTR-L81";
    huawei,board-id = <8334>;
};

&rootparam {
    /* auto_key_info @ name: boardid type: uint32 default: 0 */
    qcom,boardid = <8 3 3 4>;
    qcom,board_name = "CTR_L81_VA";
    qcom,product_name = "CTR-L81";
    hardware_version = "HL2CTRM";
    huawei,modem_id = <0xFD490300 0x0>;
};

