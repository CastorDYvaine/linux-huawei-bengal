/dts-v1/;
/plugin/;

#include "../common/common.dtsi"
#include "huawei-wifi.dtsi"
#include "huawei-nfc.dtsi"
#include "huawei-charger.dtsi"
#include "huawei-camera.dtsi"
#include "huawei-storage.dtsi"

/ {
    model = "Huawei Technologies, Inc. STG-AL00";
    huawei,board-id = <8330>;
};

&huawei_lcd_panel {
	compatible = "huawei,lcd_panel_type";
	/* auto_key_info @ name: product_id type: uint32 default: 0 */
	product_id = <14001>;
	/* auto_key_info @ name: product_type type: uint32 default: 0 */
	product_type = <0>;
	detect_type = <2>;
	/* auto_key_info @ name: gpio_id[2] type: int default: 0 */
	gpio_id = <52 37>;
	/* auto_key_info @ name: lcd_kit_power_ctrl type: uint32 default: 0 */
	lcd_kit_power_ctrl = <1>;
	/* auto_key_info @ name: lcd_kit_bias_iic_ctrl type: uint32 default: 0 */
	lcd_kit_bias_iic_ctrl = <1>;
	/* auto_key_info @ name: tp_reset_gpio type: uint32 default: 0 */
	tp_reset_gpio = <86>;
	support_lcd_type = "LCD_KIT";
};

&sde_dsi {
	qcom,dsi-default-panel = <&dsi_stg_auo_otm1901a_5p2_1080p_video_default>;
};

&rootparam {
    /* auto_key_info @ name: boardid type: uint32 default: 0 */
    qcom,boardid = <8 3 3 0>;
    qcom,board_name = "STG_AL00_VJ";
    qcom,product_name = "STG-AL00";
    hardware_version = "HL1STGM";
    huawei,modem_id = <0xFD470000 0x0>;
};
