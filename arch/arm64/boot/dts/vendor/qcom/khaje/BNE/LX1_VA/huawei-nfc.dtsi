&qupv3_se1_i2c {
        status = "ok";    // ok
        nfc@28 {
                compatible = "qcom,nq-pn547";
                status = "ok";
                reg = <0x28>;
                nxp,nfc_int = <&tlmm 69 0x00>;
                nxp,nfc_ven = <&tlmm 70 0x00>;
                nxp,nfc_firm = <&tlmm 31 0x00>;
                nfc_nxp_conf_name = "libnfc-nxp.conf";
                nfc_brcm_conf_name = "libnfc-brcm.conf";
                nfc_card_num = <0x1>;
                nfc_chip_type = "pn553";
                nfc_single_channel = "true";
        };
};
