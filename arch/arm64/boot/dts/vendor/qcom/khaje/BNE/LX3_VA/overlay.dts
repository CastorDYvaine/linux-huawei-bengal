/dts-v1/;
/plugin/;

#include "../common/common.dtsi"
#include "huawei-charger.dtsi"
#include "huawei-lcd.dtsi"
#include "huawei-camera.dtsi"
#include "huawei-wifi.dtsi"
#include "huawei_audio.dtsi"
#include "../common/huawei-tp.dtsi"

/ {
    model = "Huawei Technologies, Inc. JLN-AL00";
    huawei,board-id = <8532>;
};

&rootparam {
    /* auto_key_info @ name: boardid type: uint32 default: 0 */
    qcom,boardid = <8 5 3 2>;
    qcom,board_name = "BNE_LX3_VA";
    qcom,product_name = "BNE-LX3";
    hardware_version = "HL1BNEM";
    huawei,modem_id = <0xFD460200 0x0>;
};
