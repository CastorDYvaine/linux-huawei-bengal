/dts-v1/;
/plugin/;

#include "../common/common.dtsi"
#include "huawei-charger.dtsi"
#include "huawei-lcd.dtsi"
#include "huawei-camera.dtsi"
#include "huawei-nfc.dtsi"
#include "huawei-wifi.dtsi"
#include "../AL00_VN/huawei-thp.dtsi"

/ {
    model = "Huawei Technologies, Inc. BNE-LX1";
    huawei,board-id = <8570>;
};

&rootparam {
    /* auto_key_info @ name: boardid type: uint32 default: 0 */
    qcom,boardid = <8 5 7 0>;
    qcom,board_name = "BNE_LX1_VF";
    qcom,product_name = "BNE-LX1";
    hardware_version = "HL1BNEM";
    huawei,modem_id = <0xFD460300 0x0>;
};
