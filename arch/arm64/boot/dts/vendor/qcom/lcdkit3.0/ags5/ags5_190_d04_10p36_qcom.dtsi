/* Copyright (c) 2013, The Linux Foundation. All rights reserved.
 *
 * This program is free software; you can redistribute it and/or modify
 * it under the terms of the GNU General Public License version 2 and
 * only version 2 as published by the Free Software Foundation.
 *
 * This program is distributed in the hope that it will be useful,
 * but WITHOUT ANY WARRANTY; without even the implied warranty of
 * MERCHANTABILITY or FITNESS FOR A PARTICULAR PURPOSE.  See the
 * GNU General Public License for more details.
 */

/*-------------------------------------------------------------------------
 * This file is autogenerated file using gcdb parser. Please do not edit it.
 * Update input XML file to add a new entry or update variable in this file
 * VERSION = 1.1
 *-----------------------------------------------------------------------*/
&mdss_mdp {
	dsi_ags5_190_d04_10p36_qcom: lcd_kit_ags5_190_d04_10p36_qcom {
		compatible = "190_d04_10p36";
		lcd-kit,panel-name = "190_d04 10.36' VIDEO 1200 x 2000";
		lcd-kit,panel-type = <0x01>;
		lcd-kit,vtc-line-cmds = <0x39 0x01 0x00 0x00 0x00 0x00 0x04 0xB9 0x83 0x10 0x2E
		0x15 0x01 0x00 0x00 0x00 0x00 0x02 0xE9 0xCF
		0x15 0x01 0x00 0x00 0x00 0x00 0x02 0xB2 0x57
		0x15 0x01 0x00 0x00 0x00 0x00 0x02 0xE9 0x00
		0x15 0x01 0x00 0x00 0x00 0x00 0x02 0xE9 0xCD
		0x15 0x01 0x00 0x00 0x00 0x00 0x02 0xBB 0x01
		0x15 0x01 0x00 0x00 0x00 0x00 0x02 0xE9 0x00
		0x39 0x01 0x00 0x00 0x00 0x00 0x2F 0xE0 0x00 0x05 0x0F 0x17 0x1F 0x36 0x46 0x4B 0x55 0x52 0x6B 0x71 0x76 0x84 0x84 0x8A 0x8E 0xA2 0xA2 0x53 0x5A 0x66 0x70 0x00 0x05 0x0F 0x17 0x1F 0x36 0x56 0x5F 0x63 0x60 0x79 0x7B 0x81 0x8E 0x8E 0x94 0x9E 0xAC 0xAC 0x53 0x5A 0x66 0x70
		0x15 0x01 0x00 0x00 0x00 0x00 0x02 0xCC 0x0E
		0x39 0x01 0x00 0x00 0x00 0x00 0x06 0xCB 0x00 0x13 0x08 0x02 0x3E
		0x15 0x01 0x00 0x00 0x00 0x00 0x02 0xBD 0x02
		0x39 0x01 0x00 0x00 0x00 0x00 0x06 0xCB 0x00 0x03 0x00 0x01 0x8F
		0x15 0x01 0x00 0x00 0x00 0x00 0x02 0xBD 0x00
		0x39 0x01 0x00 0x00 0x00 0x00 0x04 0xB9 0x00 0x00 0x00
		0x05 0x01 0x00 0x00 0x0A 0x00 0x01 0x11
		0x05 0x01 0x00 0x00 0x1E 0x00 0x01 0x29>;
		lcd-kit,vtc-line-cmds-state  = "dsi_lp_mode";
		lcd-kit,panel-ldi-dsi-mode = <1>;
		lcd-kit,bl-after-frame = <0>;
		lcd-kit,vtc-line-support = <0>;
		lcd-kit,vtc-line-no-reset = <0>;
		qcom,mdss-dsi-panel-type = "dsi_video_mode";
		qcom,mdss-dsi-panel-name = "190_d04_10p36";
		qcom,mdss-pan-physical-width-dimension = <136>;
		qcom,mdss-pan-physical-height-dimension = <226>;
		qcom,dsi-ctrl-num = <0>;
		qcom,dsi-phy-num = <0>;
		qcom,panel-supply-entries = <&dsi_panel_pwr_supply>;
		qcom,mdss-dsi-virtual-channel-id = <0>;
		qcom,mdss-dsi-h-sync-pulse = <0>;
		qcom,mdss-dsi-bllp-eof-power-mode;
		qcom,mdss-dsi-bllp-power-mode;
		qcom,mdss-dsi-dma-schedule-line = <1>;
		qcom,mdss-dsi-bpp = <24>;
		qcom,mdss-dsi-color-order = "rgb_swap_rgb";
		qcom,mdss-dsi-underflow-color = <0xff>;
		qcom,mdss-dsi-border-color = <0>;
		qcom,mdss-dsi-traffic-mode = "burst_mode";
		qcom,mdss-dsi-lane-map = "lane_map_0123";
		qcom,mdss-dsi-lane-0-state;
		qcom,mdss-dsi-lane-1-state;
		qcom,mdss-dsi-lane-2-state;
		qcom,mdss-dsi-lane-3-state;
		qcom,mdss-dsi-mdp-trigger = "none";
		qcom,mdss-dsi-dma-trigger = "trigger_sw";
		qcom,mdss-dsi-te-pin-select = <0>;
		qcom,mdss-dsi-t-clk-post = <0x0E>;
		qcom,mdss-dsi-t-clk-pre = <0x1C>;
		qcom,mdss-dsi-tx-eot-append;
		qcom,dsi-select-clocks = "mux_byte_clk0", "mux_pixel_clk0", "src_byte_clk0", "src_pixel_clk0", "shadow_byte_clk0", "shadow_pixel_clk0";
		qcom,ulps-enabled;
		qcom,suspend-ulps-enabled;
		qcom,mdss-dsi-stream = <0>;
		qcom,mdss-dsi-lp11-init;
		qcom,sublinks-count = <2>;
		qcom,lanes-per-sublink = <2>;
		qcom,mdss-dsi-panel-hdr-color-primaries = <14500 15500 32000 17000 15500 30000 8000 3000>;
		qcom,mdss-dsi-panel-peak-brightness = <4200000>;
		qcom,mdss-dsi-panel-blackness-level = <3230>;
		qcom,dynamic-mode-switch-type = "dynamic-resolution-switch-immediate";
		qcom,mdss-dsi-bl-pmic-control-type = "bl_ctrl_i2c_ic";
		pwms = <&pm6125_pwm 0 0>;
		qcom,bl-pmic-pwm-period-usecs = <100>;
		qcom,esd-check-enabled;
		qcom,mdss-dsi-panel-status-command = [14 01 00 00 00 00 01 0A];
		qcom,mdss-dsi-panel-status-command-state = "dsi_lp_mode";
		qcom,mdss-dsi-panel-status-check-mode = "reg_read";
		qcom,mdss-dsi-panel-status-read-length = <1>;
		qcom,mdss-dsi-panel-status-value = <0x9C>;
		lcd-kit,power-on-stage = <3 1 5
				4 1 5
				11 1 10
				5 1 2
				5 2 2
				5 1 55
				6 1 0>;
		lcd-kit,lp-on-stage = <7 1 0
                            8 1 0>;
		lcd-kit,lp-off-stage = <0 0 0>;
		lcd-kit,power-off-stage = <7 0 0
				6 0 0
				8 0 0
				11 0 1
				4 0 5
				3 0 5>;
		lcd-kit,pt-support = <1>;
		lcd-kit,panel-on-always-reset = <1>;
		lcd-kit,lcd-iovcc = <2 94 1800000>;
		lcd-kit,lcd-vsp = <2 65 6000000>;
		lcd-kit,lcd-vsn = <2 26 6000000>;
		lcd-kit,lcd-reset = <2 82 0>;
		lcd-kit,project-id-support = <1>;
		lcd-kit,default-project-id = "W347AY1300";
		lcd-kit,Does-lcd-poweron-tp = <1>;
		lcd-kit,sn-code-support = <0>;
		lcd-kit,oem-info-support = <1>;
		lcd-kit,oem-barcode-2d-support = <0>;
		lcd-kit,oem-barcode-2d-num-offset = <0>;
		lcd-kit,panel-getblmaxnit-type = <0>;
		lcd-kit,panel-blmaxnit-min-value = <370>;
		lcd-kit,panel-bl-maxnit-command = <0x06 0x01 0x00 0x00 0x0a 0x00 0x01 0xdb>;
		lcd-kit,panel-bl-maxnit-command-state = "dsi_lp_mode";
		lcd-kit,inversion-support = <1>;
		lcd-kit,inversion-dot-cmds = <0x39 0x01 0x00 0x00 0x00 0x00 0x04 0xFF 0x78 0x07 0x02
		0x15 0x01 0x00 0x00 0x00 0x00 0x02 0x5F 0x24
		0x39 0x01 0x00 0x00 0x00 0x00 0x04 0xFF 0x78 0x07 0x00>;
		lcd-kit,inversion-column-cmds-state = "dsi_lp_mode";
		lcd-kit,inversion-column-cmds = <0x39 0x01 0x00 0x00 0x00 0x00 0x04 0xFF 0x78 0x07 0x02
		0x15 0x01 0x00 0x00 0x00 0x00 0x02 0x5F 0x20
		0x39 0x01 0x00 0x00 0x00 0x00 0x04 0xFF 0x78 0x07 0x00>;
		lcd-kit,inversion-dot-cmds-state = "dsi_lp_mode";
		lcd-kit,panel-gpio-offset = <1167>;
		lcd-kit,panel-bl-max-nit = <450>;
		lcd-kit,panel-bl-min = <50>;
		lcd-kit,panel-bl-max = <3932>;
		lcd-kit,panel-bl-def = <4095>;
		lcd-kit,check-reg-support = <0>;
		lcd-kit,check-reg-cmds = <0x39 0x01 0x00 0x00 0x00 0x00 0x04 0xFF 0x78 0x07 0x00
		0x06 0x01 0x00 0x00 0x0a 0x00 0x01 0x0a>;
		lcd-kit,check-reg-value = <0x9c>;
		lcd-kit,check-reg-cmds-state = "dsi_lp_mode";
		lcd-kit,thp-proximity-support = <1>;
		lcd-kit,proximity-reset-delay-min = <65>;
		lcd-kit,proximity-power-off-delay-min = <210>;
		lcd-kit,lcd-power-down-vsp = <2 65 4700000>;
		lcd-kit,lcd-power-down-vsn = <2 26 4700000>;
		lcd-kit,backlight-order = <0>;
		lcd-kit,quickly-sleep-out-support = <0>;
		lcd-kit,quickly-sleep-out-interval = <102>;
		lcd-kit,fps-support = <1>;
		lcd-kit,default-fps = <60>;
		lcd-kit,panel-support-fps-list = <60>;
		qcom,mdss-dsi-display-timings {
			timing@0 {
				qcom,mdss-dsi-panel-width = <1200>;
				qcom,mdss-dsi-panel-height = <2000>;
				qcom,mdss-dsi-h-front-porch = <72>;
				qcom,mdss-dsi-h-back-porch = <72>;
				qcom,mdss-dsi-h-pulse-width = <4>;
				qcom,mdss-dsi-h-sync-skew = <0>;
				qcom,mdss-dsi-v-front-porch = <38>;
				qcom,mdss-dsi-v-back-porch = <32>;
				qcom,mdss-dsi-v-pulse-width = <4>;
				qcom,mdss-dsi-panel-framerate = <60>;
				qcom,mdss-dsi-panel-phy-timings= [00 22 08 09 19 23 09
				09 09 02 04 00 1C 0E];
				qcom,display-topology  = <1 0 1>;
				qcom,default-topology-index  = <0>;
				qcom,mdss-dsi-on-command = [39 01 00 00 00 00 03 F0 5A 59
                39 01 00 00 00 00 03 F1 A5 A6
                39 01 00 00 00 00 21 B2 05 04 03 02 33 33 09 03 66 00 72 00 72 00 72 00 72 80 80 80 80 00 00 00 00 00 00 00 55 11 00 00
                39 01 00 00 00 00 21 B3 72 05 01 10 81 93 00 00 72 00 00 11 34 01 01 01 01 00 00 00 00 00 00 00 03 06 80 80 01 00 00 00
                39 01 00 00 00 00 21 B4 0D 1F 09 1D 56 26 00 00 00 91 A2 33 44 26 00 00 02 13 20 30 05 90 23 20 40 11 10 20 00 00 00 00
                39 01 00 00 00 00 21 DF 88 01 C4 00 0A 00 04 00 00 00 00 00 00 00 00 00 00 00 00 00 00 00 00 00 00 00 00 00 00 00 00 00
                39 01 00 00 00 00 21 B5 10 12 0C 0E 00 30 2E 26 00 24 22 83 83 83 83 83 83 83 83 83 83 83 00 0F 01 55 55 50 FF FF FC 00
                39 01 00 00 00 00 21 B6 11 13 0D 0F 00 30 2E 26 00 25 23 83 83 83 83 83 83 83 83 83 83 83 00 0F 01 55 51 50 FF FF FC 00
                39 01 00 00 00 00 21 B7 00 0C C1 55 55 50 FF FF FD 55 55 50 FF FF FD 55 55 50 FF FF FD 55 55 50 00 0F 01 55 55 50 00 00
                39 01 00 00 00 00 21 B8 00 0C C1 55 55 50 FF FF FD 55 55 50 FF FF FD 55 55 50 FF FF FD 55 55 50 00 0F 01 55 55 50 00 00
                39 01 00 00 00 00 21 C5 0E 13 10 56 5D 38 04 05 06 04 19 00 B4 2C 2B 2B BB 9C 20 00 02 00 80 08 0A 06 13 64 FF 03 20 FF
                39 01 00 00 00 00 03 F1 5A 59
                39 01 00 00 00 00 03 F0 A5 A6
                15 01 00 00 00 00 02 35 00
		05 01 00 00 64 00 01 11
		05 01 00 00 14 00 01 29
		39 01 00 00 00 00 03 AC 05 00];
				qcom,mdss-dsi-on-command-state = "dsi_lp_mode";
				qcom,mdss-dsi-off-command = [39 01 00 00 00 00 03 AC 0A 00
		05 01 00 00 14 00 01 28
		05 01 00 00 78 00 01 10];
				qcom,mdss-dsi-off-command-state = "dsi_lp_mode";
			};
		};
    };
};