/* Copyright (c) 2013, The Linux Foundation. All rights reserved.
 *
 * This program is free software; you can redistribute it and/or modify
 * it under the terms of the GNU General Public License version 2 and
 * only version 2 as published by the Free Software Foundation.
 *
 * This program is distributed in the hope that it will be useful,
 * but WITHOUT ANY WARRANTY; without even the implied warranty of
 * MERCHANTABILITY or FITNESS FOR A PARTICULAR PURPOSE.  See the
 * GNU General Public License for more details.
 */

/*-------------------------------------------------------------------------
 * This file is autogenerated file using gcdb parser. Please do not edit it.
 * Update input XML file to add a new entry or update variable in this file
 * VERSION = 1.1
 *-----------------------------------------------------------------------*/
&mdss_mdp {
	dsi_ags5_120_601_10p36_qcom: lcd_kit_ags5_120_601_10p36_qcom {
		compatible = "120_601_10p36";
		lcd-kit,panel-name = "120_601 10.36' VIDEO 1200 x 2000";
		lcd-kit,panel-type = <0x01>;
		lcd-kit,vtc-line-cmds = <0x05 0x01 0x00 0x00 0x78 0x00 0x01 0x11
		0x05 0x01 0x00 0x00 0x32 0x00 0x01 0x29>;
		lcd-kit,vtc-line-cmds-state  = "dsi_lp_mode";
		lcd-kit,panel-ldi-dsi-mode = <1>;
		lcd-kit,bl-after-frame = <0>;
		lcd-kit,vtc-line-support = <0>;
		lcd-kit,vtc-line-no-reset = <0>;
		qcom,mdss-dsi-panel-type = "dsi_video_mode";
		qcom,mdss-dsi-panel-name = "120_601_10p36";
		qcom,mdss-pan-physical-width-dimension = <136>;
		qcom,mdss-pan-physical-height-dimension = <226>;
		qcom,dsi-ctrl-num = <0>;
		qcom,dsi-phy-num = <0>;
		qcom,panel-supply-entries = <&dsi_panel_pwr_supply>;
		qcom,mdss-dsi-virtual-channel-id = <0>;
		qcom,mdss-dsi-h-sync-pulse = <0>;
		qcom,mdss-dsi-bllp-eof-power-mode;
		qcom,mdss-dsi-bllp-power-mode;
		qcom,mdss-dsi-dma-schedule-line = <1>;
		qcom,mdss-dsi-bpp = <24>;
		qcom,mdss-dsi-color-order = "rgb_swap_rgb";
		qcom,mdss-dsi-underflow-color = <0xff>;
		qcom,mdss-dsi-border-color = <0>;
		qcom,mdss-dsi-traffic-mode = "burst_mode";
		qcom,mdss-dsi-lane-map = "lane_map_0123";
		qcom,mdss-dsi-lane-0-state;
		qcom,mdss-dsi-lane-1-state;
		qcom,mdss-dsi-lane-2-state;
		qcom,mdss-dsi-lane-3-state;
		qcom,mdss-dsi-mdp-trigger = "none";
		qcom,mdss-dsi-dma-trigger = "trigger_sw";
		qcom,mdss-dsi-te-pin-select = <0>;
		qcom,mdss-dsi-t-clk-post = <0x0E>;
		qcom,mdss-dsi-t-clk-pre = <0x1C>;
		qcom,mdss-dsi-tx-eot-append;
		qcom,dsi-select-clocks = "mux_byte_clk0", "mux_pixel_clk0", "src_byte_clk0", "src_pixel_clk0", "shadow_byte_clk0", "shadow_pixel_clk0";
		qcom,mdss-dsi-stream = <0>;
		qcom,mdss-dsi-lp11-init;
		qcom,sublinks-count = <2>;
		qcom,lanes-per-sublink = <2>;
		qcom,mdss-dsi-panel-hdr-color-primaries = <14500 15500 32000 17000 15500 30000 8000 3000>;
		qcom,mdss-dsi-panel-peak-brightness = <4200000>;
		qcom,mdss-dsi-panel-blackness-level = <3230>;
		qcom,dynamic-mode-switch-type = "dynamic-resolution-switch-immediate";
		qcom,mdss-dsi-bl-pmic-control-type = "bl_ctrl_i2c_ic";
		pwms = <&pm6125_pwm 0 0>;
		qcom,bl-pmic-pwm-period-usecs = <100>;
		qcom,esd-check-enabled;
		qcom,tp-esd-support-event;
		qcom,mdss-dsi-panel-status-command = [06 01 00 00 00 00 01 0A];
		qcom,mdss-dsi-panel-status-command-state = "dsi_lp_mode";
		qcom,mdss-dsi-panel-status-check-mode = "reg_read";
		qcom,mdss-dsi-panel-status-read-length = <1>;
		qcom,mdss-dsi-panel-status-value = <0x9C>;
		lcd-kit,power-on-stage = <2 1 5
				3 1 10
				4 1 5
				11 1 1
				7 1 2
				5 1 5
				5 2 3
				5 1 40>;
		lcd-kit,lp-on-stage = <6 1 0
				8 1 0>;
		lcd-kit,lp-off-stage = <7 0 0
				6 0 0
				8 0 2>;
		lcd-kit,power-off-stage = <5 0 3
				11 0 5
				4 0 2
				3 0 5
				2 0 0>;
		lcd-kit,pt-support = <1>;
		lcd-kit,panel-on-always-reset = <1>;
		lcd-kit,panel-pt-always-keep-reset-high = <0>;
		lcd-kit,lcd-iovcc = <2 94 1800000>;
		lcd-kit,lcd-vsp = <2 65 6000000>;
		lcd-kit,lcd-vsn = <2 26 6000000>;
		lcd-kit,lcd-reset = <2 82 0>;
		lcd-kit,project-id-support = <1>;
		lcd-kit,default-project-id = "W347AV1200";
		lcd-kit,Does-lcd-poweron-tp = <1>;
		lcd-kit,sn-code-support = <0>;
		lcd-kit,oem-info-support = <1>;
		lcd-kit,oem-barcode-2d-support = <0>;
		lcd-kit,oem-barcode-2d-num-offset = <0>;
		lcd-kit,barcode-2d-cmds = <0x39 0x01 0x00 0x00 0x00 0x00 0x04 0xFF 0x78 0x07 0x0B
		0x06 0x01 0x00 0x00 0x00 0x00 0x01 0x10
		0x06 0x01 0x00 0x00 0x00 0x00 0x01 0x11
		0x06 0x01 0x00 0x00 0x00 0x00 0x01 0x12
		0x06 0x01 0x00 0x00 0x00 0x00 0x01 0x13
		0x06 0x01 0x00 0x00 0x00 0x00 0x01 0x14
		0x06 0x01 0x00 0x00 0x00 0x00 0x01 0x15
		0x06 0x01 0x00 0x00 0x00 0x00 0x01 0x16
		0x06 0x01 0x00 0x00 0x00 0x00 0x01 0x17
		0x06 0x01 0x00 0x00 0x00 0x00 0x01 0x18
		0x06 0x01 0x00 0x00 0x00 0x00 0x01 0x19
		0x06 0x01 0x00 0x00 0x00 0x00 0x01 0x1A
		0x06 0x01 0x00 0x00 0x00 0x00 0x01 0x1B
		0x06 0x01 0x00 0x00 0x00 0x00 0x01 0x1C
		0x06 0x01 0x00 0x00 0x00 0x00 0x01 0x1D
		0x06 0x01 0x00 0x00 0x00 0x00 0x01 0x1E
		0x06 0x01 0x00 0x00 0x00 0x00 0x01 0x1F
		0x06 0x01 0x00 0x00 0x00 0x00 0x01 0x20
		0x06 0x01 0x00 0x00 0x00 0x00 0x01 0x21
		0x06 0x01 0x00 0x00 0x00 0x00 0x01 0x22
		0x06 0x01 0x00 0x00 0x00 0x00 0x01 0x23
		0x06 0x01 0x00 0x00 0x00 0x00 0x01 0x24
		0x39 0x01 0x00 0x00 0x00 0x00 0x04 0xFF 0x78 0x07 0x00>;
		lcd-kit,barcode-2d-cmds-state = "dsi_lp_mode";
		lcd-kit,panel-getblmaxnit-type = <0>;
		lcd-kit,panel-blmaxnit-min-value = <370>;
		lcd-kit,panel-bl-maxnit-command = <0x06 0x01 0x00 0x00 0x0a 0x00 0x01 0xdb>;
		lcd-kit,panel-bl-maxnit-command-state = "dsi_lp_mode";
		lcd-kit,inversion-support = <0>;
		lcd-kit,inversion-dot-cmds = <0x39 0x01 0x00 0x00 0x00 0x00 0x04 0xFF 0x78 0x07 0x02
		0x15 0x01 0x00 0x00 0x00 0x00 0x02 0x5F 0x24
		0x39 0x01 0x00 0x00 0x00 0x00 0x04 0xFF 0x78 0x07 0x00>;
		lcd-kit,inversion-column-cmds-state = "dsi_lp_mode";
		lcd-kit,inversion-column-cmds = <0x39 0x01 0x00 0x00 0x00 0x00 0x04 0xFF 0x78 0x07 0x02
		0x15 0x01 0x00 0x00 0x00 0x00 0x02 0x5F 0x20
		0x39 0x01 0x00 0x00 0x00 0x00 0x04 0xFF 0x78 0x07 0x00>;
		lcd-kit,inversion-dot-cmds-state = "dsi_lp_mode";
		lcd-kit,panel-gpio-offset = <1167>;
		lcd-kit,panel-bl-max-nit = <450>;
		lcd-kit,panel-bl-min = <50>;
		lcd-kit,panel-bl-max = <3932>;
		lcd-kit,panel-bl-def = <4095>;
		lcd-kit,check-reg-support = <0>;
		lcd-kit,thp-proximity-support = <1>;
		lcd-kit,proximity-reset-delay-min = <65>;
		lcd-kit,proximity-power-off-delay-min = <210>;
		lcd-kit,lcd-power-down-vsp = <2 65 4700000>;
		lcd-kit,lcd-power-down-vsn = <2 26 4700000>;
		lcd-kit,backlight-order = <0>;
		lcd-kit,quickly-sleep-out-support = <0>;
		lcd-kit,quickly-sleep-out-interval = <102>;
		lcd-kit,fps-support = <0>;
		lcd-kit,default-fps = <60>;
		lcd-kit,panel-support-fps-list = <60>;
		qcom,mdss-dsi-display-timings {
			timing@0 {
				qcom,mdss-dsi-panel-width = <1200>;
				qcom,mdss-dsi-panel-height = <2000>;
				qcom,mdss-dsi-h-front-porch = <6>;
				qcom,mdss-dsi-h-back-porch = <11>;
				qcom,mdss-dsi-h-pulse-width = <5>;
				qcom,mdss-dsi-h-sync-skew = <0>;
				qcom,mdss-dsi-v-front-porch = <271>;
				qcom,mdss-dsi-v-back-porch = <10>;
				qcom,mdss-dsi-v-pulse-width = <6>;
				qcom,mdss-dsi-panel-framerate = <60>;
				qcom,mdss-dsi-panel-phy-timings= [00 22 08 09 19 23 09
				09 09 02 04 00 1C 0E];
				qcom,display-topology  = <1 0 1>;
				qcom,default-topology-index  = <0>;
				qcom,mdss-dsi-on-command = [05 01 00 00 78 00 01 11
		05 01 00 00 32 00 01 29
		15 01 00 00 00 00 02 00 00
		39 01 00 00 00 00 04 FF 82 01 01
		15 01 00 00 00 00 02 00 80
		39 01 00 00 00 00 03 FF 82 01
		15 01 00 00 00 00 02 00 88
		15 01 00 00 00 00 02 B0 07
		15 01 00 00 00 00 02 00 00
		15 01 00 00 00 00 02 FA 02
		15 01 00 00 00 00 02 00 00
		39 01 00 00 00 00 04 FF 00 00 00
		15 01 00 00 00 00 02 00 80
		39 01 00 00 00 00 03 FF 00 00];
				qcom,mdss-dsi-on-command-state = "dsi_lp_mode";
				qcom,mdss-dsi-off-command = [15 01 00 00 00 00 02 00 00
		39 01 00 00 00 00 04 FF 82 01 01
		15 01 00 00 00 00 02 00 80
		39 01 00 00 00 00 03 FF 82 01
		15 01 00 00 00 00 02 00 00
		15 01 00 00 00 00 02 FA 5A
		15 01 00 00 00 00 02 00 88
		15 01 00 00 00 00 02 B0 01
		05 01 00 00 28 00 01 28
		05 01 00 00 64 00 01 10];
				qcom,mdss-dsi-off-command-state = "dsi_lp_mode";
			};
		};
    };
};