/* Copyright (c) 2013, The Linux Foundation. All rights reserved.
 *
 * This program is free software; you can redistribute it and/or modify
 * it under the terms of the GNU General Public License version 2 and
 * only version 2 as published by the Free Software Foundation.
 *
 * This program is distributed in the hope that it will be useful,
 * but WITHOUT ANY WARRANTY; without even the implied warranty of
 * MERCHANTABILITY or FITNESS FOR A PARTICULAR PURPOSE.  See the
 * GNU General Public License for more details.
 */

/*-------------------------------------------------------------------------
 * This file is autogenerated file using gcdb parser. Please do not edit it.
 * Update input XML file to add a new entry or update variable in this file
 * VERSION = 1.1
 *-----------------------------------------------------------------------*/
&mdss_mdp {
	dsi_jul_110_208_6p78_qcom: lcd_kit_jul_110_208_6p78_qcom {
		compatible = "110_208_6p78";
		lcd-kit,panel-name = "110_208 6.78' VIDEO 1080 x 2388";
		lcd-kit,panel-type = <0x01>;
		lcd-kit,bl-after-frame = <0>;
		lcd-kit,vtc-line-no-reset = <0>;
		qcom,mdss-dsi-panel-type = "dsi_video_mode";
		qcom,mdss-dsi-panel-name = "110_208_6p78";
		qcom,mdss-pan-physical-width-dimension = <69>;
		qcom,mdss-pan-physical-height-dimension = <154>;
		qcom,dsi-ctrl-num = <0>;
		qcom,dsi-phy-num = <0>;
		qcom,panel-supply-entries = <&dsi_panel_pwr_supply>;
		qcom,mdss-dsi-virtual-channel-id = <0>;
		qcom,mdss-dsi-h-sync-pulse = <0>;
		qcom,mdss-dsi-bllp-eof-power-mode;
		qcom,mdss-dsi-bllp-power-mode;
		qcom,mdss-dsi-dma-schedule-line = <1>;
		qcom,mdss-dsi-bpp = <24>;
		qcom,mdss-dsi-color-order = "rgb_swap_rgb";
		qcom,mdss-dsi-underflow-color = <0xff>;
		qcom,mdss-dsi-border-color = <0>;
		qcom,mdss-dsi-traffic-mode = "burst_mode";
		qcom,mdss-dsi-lane-map = "lane_map_0123";
		qcom,mdss-dsi-lane-0-state;
		qcom,mdss-dsi-lane-1-state;
		qcom,mdss-dsi-lane-2-state;
		qcom,mdss-dsi-lane-3-state;
		qcom,mdss-dsi-mdp-trigger = "none";
		qcom,mdss-dsi-dma-trigger = "trigger_sw";
		qcom,mdss-dsi-te-pin-select = <0>;
		qcom,mdss-dsi-t-clk-post = <0x0f>;
		qcom,mdss-dsi-t-clk-pre = <0x39>;
		qcom,mdss-dsi-tx-eot-append;
		qcom,dsi-select-clocks = "mux_byte_clk0", "mux_pixel_clk0", "src_byte_clk0", "src_pixel_clk0", "shadow_byte_clk0", "shadow_pixel_clk0";
		qcom,mdss-dsi-stream = <0>;
		qcom,mdss-dsi-lp11-init;
		qcom,sublinks-count = <2>;
		qcom,lanes-per-sublink = <2>;
		qcom,mdss-dsi-panel-hdr-color-primaries = <14500 15500 32000 17000 15500 30000 8000 3000>;
		qcom,mdss-dsi-panel-peak-brightness = <4200000>;
		qcom,mdss-dsi-panel-blackness-level = <3230>;
		qcom,dynamic-mode-switch-type = "dynamic-resolution-switch-immediate";
		qcom,mdss-dsi-bl-pmic-control-type = "bl_ctrl_i2c_ic";
		pwms = <&pm6125_pwm 0 0>;
		qcom,bl-pmic-pwm-period-usecs = <100>;
		qcom,mdss-dsi-panel-status-command = [06 01 00 00 00 00 01 0A];
		qcom,mdss-dsi-panel-status-command-state = "dsi_lp_mode";
		qcom,mdss-dsi-panel-status-check-mode = "reg_read";
		qcom,mdss-dsi-panel-status-read-length = <1 1 1>;
		qcom,mdss-dsi-panel-status-value = <0x9C>;
		lcd-kit,power-on-stage = <11 1 0
				3 1 2
				4 1 10
				5 2 1
				5 1 5
				5 2 1
				5 1 10
				7 1 2>;
		lcd-kit,lp-on-stage = <8 1 0>;
		lcd-kit,lp-off-stage = <7 0 0>;
		lcd-kit,power-off-stage = <8 0 0
				11 0 5
				4 0 1
				3 0 2>;
		lcd-kit,only-power-off-stage = <15 0 80
				4 0 0
				3 0 6>;
		lcd-kit,pt-support = <1>;
		lcd-kit,panel-on-always-reset = <1>;
		lcd-kit,lcd-vsp = <2 65 5500000>;
		lcd-kit,lcd-vsn = <2 26 5500000>;
		lcd-kit,lcd-reset = <2 82 0>;
		lcd-kit,project-id-support = <1>;
		lcd-kit,default-project-id = "B2429M1100";
		lcd-kit,sn-code-support = <1>;
		lcd-kit,oem-info-support = <1>;
		lcd-kit,oem-barcode-2d-support = <1>;
		lcd-kit,oem-barcode-2d-num-offset = <0>;
		lcd-kit,barcode-2d-cmds = <0x15 0x01 0x00 0x00 0x0a 0x00 0x02 0xFF 0x21
		0x15 0x01 0x00 0x00 0x0a 0x00 0x02 0xFA 0x00
		0x06 0x01 0x00 0x00 0x0a 0x00 0x05 0xF1 0x00 0x00 0x00 0x00
		0x15 0x01 0x00 0x00 0x0a 0x00 0x02 0xFA 0x05
		0x06 0x01 0x00 0x00 0x0a 0x00 0x05 0xF1 0x00 0x00 0x00 0x00
		0x15 0x01 0x00 0x00 0x0a 0x00 0x02 0xFA 0x0A
		0x06 0x01 0x00 0x00 0x0a 0x00 0x05 0xF1 0x00 0x00 0x00 0x00
		0x15 0x01 0x00 0x00 0x0a 0x00 0x02 0xFA 0x0F
		0x06 0x01 0x00 0x00 0x0a 0x00 0x01 0xF1
		0x15 0x01 0x00 0x00 0x0a 0x00 0x02 0xFA 0x00
		0x06 0x01 0x00 0x00 0x0a 0x00 0x05 0xF2 0x00 0x00 0x00 0x00
		0x15 0x01 0x00 0x00 0x0a 0x00 0x02 0xFF 0x10>;
		lcd-kit,barcode-2d-cmds-state = "dsi_lp_mode";
		lcd-kit,panel-getblmaxnit-type = <0>;
		lcd-kit,panel-blmaxnit-min-value = <370>;
		lcd-kit,panel-bl-maxnit-command = <0x06 0x01 0x00 0x00 0x0a 0x00 0x01 0xdb>;
		lcd-kit,panel-bl-maxnit-command-state = "dsi_lp_mode";
		lcd-kit,inversion-support = <0>;
		lcd-kit,inversion-dot-cmds = <0x15 0x01 0x00 0x00 0x00 0x00 0x02 0xFF 0x24
		0x15 0x01 0x00 0x00 0x00 0x00 0x02 0xFB 0x01
		0x15 0x01 0x00 0x00 0x00 0x00 0x02 0xCF 0x33
		0x15 0x01 0x00 0x00 0x0a 0x00 0x02 0xFF 0x10>;
		lcd-kit,inversion-column-cmds-state = "dsi_lp_mode";
		lcd-kit,inversion-column-cmds = <0x15 0x01 0x00 0x00 0x00 0x00 0x02 0xFF 0x24
		0x15 0x01 0x00 0x00 0x00 0x00 0x02 0xFB 0x01
		0x15 0x01 0x00 0x00 0x00 0x00 0x02 0xCF 0xFF
		0x15 0x01 0x00 0x00 0x0a 0x00 0x02 0xFF 0x10>;
		lcd-kit,inversion-dot-cmds-state = "dsi_lp_mode";
		lcd-kit,panel-gpio-offset = <1167>;
		lcd-kit,panel-bl-max-nit = <450>;
		lcd-kit,panel-bl-min = <18>;
		lcd-kit,panel-bl-max = <6000>;
		lcd-kit,check-reg-support = <1>;
		lcd-kit,check-reg-cmds = <0x06 0x01 0x00 0x00 0x0a 0x00 0x01 0x0a>;
		lcd-kit,check-reg-value = <0x9c>;
		lcd-kit,check-reg-cmds-state = "dsi_lp_mode";
		lcd-kit,thp-proximity-support = <1>;
		lcd-kit,proximity-reset-delay-min = <65>;
		lcd-kit,lcd-power-down-vsp = <2 65 4700000>;
		lcd-kit,lcd-power-down-vsn = <2 26 4700000>;
		lcd-kit,backlight-order = <0>;
		lcd-kit,quickly-sleep-out-support = <1>;
		lcd-kit,quickly-sleep-out-interval = <102>;
		qcom,mdss-dsi-display-timings {
			timing@0 {
				qcom,mdss-dsi-panel-width = <1080>;
				qcom,mdss-dsi-panel-height = <2388>;
				qcom,mdss-dsi-h-front-porch = <36>;
				qcom,mdss-dsi-h-back-porch = <52>;
				qcom,mdss-dsi-h-pulse-width = <16>;
				qcom,mdss-dsi-h-sync-skew = <0>;
				qcom,mdss-dsi-v-front-porch = <48>;
				qcom,mdss-dsi-v-back-porch = <36>;
				qcom,mdss-dsi-v-pulse-width = <12>;
				qcom,mdss-dsi-panel-framerate = <60>;
				qcom,mdss-dsi-panel-phy-timings= [26 21 09 0b 06 03 04 a0
				26 21 09 0b 06 03 04 a0
				26 21 09 0b 06 03 04 a0
				26 21 09 0b 06 03 04 a0
				26 21 09 0b 06 03 04 a0];
				qcom,display-topology  = <1 0 1>;
				qcom,default-topology-index  = <0>;
				qcom,mdss-dsi-on-command = [15 01 00 00 00 00 02 FF 25
		15 01 00 00 00 00 02 FB 01
		15 01 00 00 00 00 02 18 21
		15 01 00 00 00 00 02 FF 10
		15 01 00 00 00 00 02 FB 01
		15 01 00 00 00 00 02 36 00
		39 01 00 00 00 00 06 3B 03 24 30 04 04
		15 01 00 00 00 00 02 B0 00
		15 01 00 00 00 00 02 C0 00
		15 01 00 00 00 00 02 FF 27
		15 01 00 00 00 00 02 FB 01
		15 01 00 00 00 00 02 E3 02
		15 01 00 00 00 00 02 E4 DD
		15 01 00 00 00 00 02 E9 03
		15 01 00 00 00 00 02 EA 2D
		15 01 00 00 00 00 02 FF 2A
		15 01 00 00 00 00 02 FB 01
		15 01 00 00 00 00 02 45 0E
		15 01 00 00 00 00 02 46 40
		15 01 00 00 00 00 02 47 03
		15 01 00 00 00 00 02 4A 9F
		15 01 00 00 00 00 02 4E 0F
		15 01 00 00 00 00 02 4F 28
		15 01 00 00 00 00 02 52 0E
		15 01 00 00 00 00 02 53 FC
		15 01 00 00 00 00 02 54 24
		15 01 00 00 00 00 02 56 30
		15 01 00 00 00 00 02 57 76
		15 01 00 00 00 00 02 58 76
		15 01 00 00 00 00 02 59 76
		15 01 00 00 00 00 02 FF 2C
		15 01 00 00 00 00 02 FB 01
		15 01 00 00 00 00 02 00 03
		15 01 00 00 00 00 02 01 03
		15 01 00 00 00 00 02 02 03
		15 01 00 00 00 00 02 03 1E
		15 01 00 00 00 00 02 04 1E
		15 01 00 00 00 00 02 05 1E
		15 01 00 00 00 00 02 0D 01
		15 01 00 00 00 00 02 0E 01
		15 01 00 00 00 00 02 16 03
		15 01 00 00 00 00 02 17 6C
		15 01 00 00 00 00 02 18 6C
		15 01 00 00 00 00 02 19 6C
		15 01 00 00 00 00 02 2D AF
		15 01 00 00 00 00 02 2F 10
		15 01 00 00 00 00 02 30 F2
		15 01 00 00 00 00 02 32 00
		15 01 00 00 00 00 02 33 F2
		15 01 00 00 00 00 02 35 1E
		15 01 00 00 00 00 02 37 1E
		15 01 00 00 00 00 02 4D 21
		15 01 00 00 00 00 02 4E 04
		15 01 00 00 00 00 02 4F 01
		15 01 00 00 00 00 02 FF F0
		15 01 00 00 00 00 02 FB 01
		15 01 00 00 00 00 02 1C 01
		15 01 00 00 00 00 02 33 01
		15 01 00 00 00 00 02 5A 00
		15 01 00 00 00 00 02 FF E0
		15 01 00 00 00 00 02 FB 01
		15 01 00 00 00 00 02 35 82
		15 01 00 00 00 00 02 FF C0
		15 01 00 00 00 00 02 FB 01
		15 01 00 00 00 00 02 9C 11
		15 01 00 00 00 00 02 9D 11
		15 01 00 00 00 00 02 FF D0
		15 01 00 00 00 00 02 FB 01
		15 01 00 00 00 00 02 53 22
		15 01 00 00 00 00 02 54 02
		15 01 00 00 00 00 02 FF 10
		05 01 00 00 78 00 01 11
		05 01 00 00 0a 00 01 29];
				qcom,mdss-dsi-on-command-state = "dsi_lp_mode";
				qcom,mdss-dsi-off-command = [05 01 00 00 14 00 01 28
		05 01 00 00 32 00 01 10];
				qcom,mdss-dsi-off-command-state = "dsi_lp_mode";
			};
		};
    };
};