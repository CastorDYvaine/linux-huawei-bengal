/*---------------------------------------------------------------------------
 * This file is autogenerated file using huawei LCD parser. Please do not edit it.
 * Update input XML file to add a new entry or update variable in this file
 * Parser location: vendor/huawei/chipset_common/devkit/lcdkit/tools 
 *---------------------------------------------------------------------------*/


#include "stg_110_108_6p9_qcom.dtsi"
#include "stg_290_210_6p9_qcom.dtsi"
#include "stg_290_d07_6p9_qcom.dtsi"
#include "stg_auo_otm1901a_5p2_1080p_video_default.dtsi"