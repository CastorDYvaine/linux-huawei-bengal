/* Copyright (c) 2013, The Linux Foundation. All rights reserved.
 *
 * This program is free software; you can redistribute it and/or modify
 * it under the terms of the GNU General Public License version 2 and
 * only version 2 as published by the Free Software Foundation.
 *
 * This program is distributed in the hope that it will be useful,
 * but WITHOUT ANY WARRANTY; without even the implied warranty of
 * MERCHANTABILITY or FITNESS FOR A PARTICULAR PURPOSE.  See the
 * GNU General Public License for more details.
 */

/*-------------------------------------------------------------------------
 * This file is autogenerated file using gcdb parser. Please do not edit it.
 * Update input XML file to add a new entry or update variable in this file
 * VERSION = 1.1
 *-----------------------------------------------------------------------*/
&mdss_mdp {
	dsi_grf3_190_503_10p1_qcom: lcd_kit_grf3_190_503_10p1_qcom {
		compatible = "190_503_10p1";
		lcd-kit,panel-name = "190_503 10.1' VIDEO 1200 x 1920";
		lcd-kit,panel-type = <0x01>;
		lcd-kit,bl-after-frame = <0>;
		lcd-kit,vtc-line-no-reset = <0>;
		qcom,mdss-dsi-panel-type = "dsi_video_mode";
		qcom,mdss-pan-physical-width-dimension = <136>;
		qcom,mdss-pan-physical-height-dimension = <217>;
		qcom,dsi-ctrl-num = <0>;
		qcom,dsi-phy-num = <0>;
		qcom,panel-supply-entries = <&dsi_panel_pwr_supply>;
		qcom,mdss-dsi-virtual-channel-id = <0>;
		qcom,mdss-dsi-h-sync-pulse = <0>;
		qcom,mdss-dsi-bllp-eof-power-mode;
		qcom,mdss-dsi-bllp-power-mode;
		qcom,mdss-dsi-dma-schedule-line = <1>;
		qcom,mdss-dsi-bpp = <24>;
		qcom,mdss-dsi-color-order = "rgb_swap_rgb";
		qcom,mdss-dsi-underflow-color = <0xff>;
		qcom,mdss-dsi-border-color = <0>;
		qcom,mdss-dsi-traffic-mode = "burst_mode";
		qcom,mdss-dsi-lane-map = "lane_map_0123";
		qcom,mdss-dsi-lane-0-state;
		qcom,mdss-dsi-lane-1-state;
		qcom,mdss-dsi-lane-2-state;
		qcom,mdss-dsi-lane-3-state;
		qcom,mdss-dsi-mdp-trigger = "none";
		qcom,mdss-dsi-dma-trigger = "trigger_sw";
		qcom,mdss-dsi-te-pin-select = <0>;
		qcom,mdss-dsi-t-clk-post = <0x0e>;
		qcom,mdss-dsi-t-clk-pre = <0x34>;
		qcom,mdss-dsi-tx-eot-append;
		qcom,dsi-select-clocks = "mux_byte_clk0", "mux_pixel_clk0", "src_byte_clk0", "src_pixel_clk0", "shadow_byte_clk0", "shadow_pixel_clk0";
		qcom,mdss-dsi-stream = <0>;
		qcom,mdss-dsi-lp11-init;
		qcom,sublinks-count = <2>;
		qcom,lanes-per-sublink = <2>;
		qcom,mdss-dsi-panel-hdr-color-primaries = <14500 15500 32000 17000 15500 30000 8000 3000>;
		qcom,mdss-dsi-panel-peak-brightness = <4200000>;
		qcom,mdss-dsi-panel-blackness-level = <3230>;
		qcom,dynamic-mode-switch-type = "dynamic-resolution-switch-immediate";
		qcom,mdss-dsi-bl-pmic-control-type = "bl_ctrl_i2c_ic";
		pwms = <&pm6125_pwm 0 0>;
		qcom,bl-pmic-pwm-period-usecs = <100>;
		qcom,esd-check-enabled;
		qcom,mdss-dsi-panel-status-command = [14 01 00 00 00 00 01 0A
			06 01 00 00 00 00 04 09 00 00 00
			14 01 00 00 00 00 01 45];
		qcom,mdss-dsi-panel-status-command-state = "dsi_lp_mode";
		qcom,mdss-dsi-panel-status-check-mode = "reg_read";
		qcom,mdss-dsi-panel-status-read-length = <1 4 1>;
		qcom,mdss-dsi-panel-status-value = <0x9D>,<0x80 0x73 0x04 0x00>,<0x07>;
		lcd-kit,power-on-stage = <2 1 1
				7 1 1
				11 1 1
				3 1 5
				4 1 5
				5 1 2
				5 2 2
				5 1 55
				6 1 0
				8 1 0>;
		lcd-kit,lp-on-stage = <0 0 0>;
		lcd-kit,lp-off-stage = <7 0 0
				6 0 0>;
		lcd-kit,power-off-stage = <8 0 0
				5 0 2
				11 0 5
				4 0 2
				3 0 2
				2 0 0>;
		lcd-kit,pt-support = <1>;
		lcd-kit,panel-on-always-reset = <1>;
		lcd-kit,lcd-iovcc = <2 93 1800000>;
		lcd-kit,lcd-vsp = <2 65 5800000>;
		lcd-kit,lcd-vsn = <2 26 5800000>;
		lcd-kit,lcd-reset = <2 82 0>;
		lcd-kit,project-id-support = <1>;
		lcd-kit,default-project-id = "W1899L1300";
		lcd-kit,Does-lcd-poweron-tp = <1>;
		lcd-kit,sn-code-support = <0>;
		lcd-kit,oem-info-support = <0>;
		lcd-kit,oem-barcode-2d-support = <0>;
		lcd-kit,oem-barcode-2d-num-offset = <0>;
		lcd-kit,panel-getblmaxnit-type = <0>;
		lcd-kit,panel-blmaxnit-min-value = <370>;
		lcd-kit,panel-bl-maxnit-command = <0x06 0x01 0x00 0x00 0x0a 0x00 0x01 0xdb>;
		lcd-kit,panel-bl-maxnit-command-state = "dsi_lp_mode";
		lcd-kit,inversion-support = <1>;
		lcd-kit,inversion-dot-cmds = <0x15 0x01 0x00 0x00 0x00 0x00 0x02 0xFF 0x24
		0x15 0x01 0x00 0x00 0x00 0x00 0x02 0xFB 0x01
		0x15 0x01 0x00 0x00 0x00 0x00 0x02 0xCF 0x33
		0x15 0x01 0x00 0x00 0x0a 0x00 0x02 0xFF 0x10>;
		lcd-kit,cabc-support = <1>;
		lcd-kit,cabc-off-cmds = <0x15 0x01 0x00 0x00 0x05 0x00 0x02 0x55 0x00>;
		lcd-kit,cabc-off-cmds-state = "dsi_lp_mode";
		lcd-kit,cabc-ui-cmds = <0x39 0x01 0x00 0x00 0x00 0x00 0x04 0xB9 0x83 0x10 0x2E
			0x39 0x01 0x00 0x00 0x00 0x00 0x03 0x51 0x0F 0xFF
			0x39 0x01 0x00 0x00 0x00 0x00 0x03 0x5E 0x00 0x04
			0x15 0x01 0x00 0x00 0x00 0x00 0x02 0x53 0x24
			0x39 0x01 0x00 0x00 0x00 0x00 0x05 0xC9 0x04 0x45 0x74 0x00
			0x15 0x01 0x00 0x00 0x05 0x00 0x02 0x55 0x01
			0x39 0x01 0x00 0x00 0x00 0x00 0x18 0xE4 0x2D 0x41 0x2C 0x32 0x4B 0x66 0x7F 0x99 0xB2 0xCD 0xE3 0xFF 0xFF 0xFF 0x03 0x1E 0x1E 0x1E 0x1E 0x00 0x20 0x00 0x01>;
		lcd-kit,cabc-ui-cmds-state = "dsi_lp_mode";
		lcd-kit,cabc-still-cmds = <>;
		lcd-kit,cabc-still-cmds-state = "dsi_lp_mode";
		lcd-kit,cabc-moving-cmds = <>;
		lcd-kit,cabc-moving-cmds-state = "dsi_lp_mode";
		lcd-kit,inversion-column-cmds-state = "dsi_lp_mode";
		lcd-kit,inversion-column-cmds = <0x15 0x01 0x00 0x00 0x00 0x00 0x02 0xFF 0x24
		0x15 0x01 0x00 0x00 0x00 0x00 0x02 0xFB 0x01
		0x15 0x01 0x00 0x00 0x00 0x00 0x02 0xCF 0xFF
		0x15 0x01 0x00 0x00 0x0a 0x00 0x02 0xFF 0x10>;
		lcd-kit,inversion-dot-cmds-state = "dsi_lp_mode";
		lcd-kit,panel-gpio-offset = <1167>;
		lcd-kit,panel-bl-max-nit = <450>;
		lcd-kit,panel-bl-min = <75>;
		lcd-kit,panel-bl-max = <7100>;
		lcd-kit,check-reg-support = <1>;
		lcd-kit,check-reg-cmds = <0x14 0x01 0x00 0x00 0x0a 0x00 0x01 0x0a>;
		lcd-kit,check-reg-value = <0x9d>;
		lcd-kit,check-reg-cmds-state = "dsi_lp_mode";
		lcd-kit,thp-proximity-support = <0>;
		lcd-kit,proximity-reset-delay-min = <65>;
		lcd-kit,lcd-power-down-vsp = <2 65 4700000>;
		lcd-kit,lcd-power-down-vsn = <2 26 4700000>;
		lcd-kit,backlight-order = <0>;
		lcd-kit,quickly-sleep-out-support = <0>;
		lcd-kit,quickly-sleep-out-interval = <0>;
		qcom,mdss-dsi-display-timings {
			timing@0 {
				qcom,mdss-dsi-panel-width = <1200>;
				qcom,mdss-dsi-panel-height = <1920>;
				qcom,mdss-dsi-h-front-porch = <40>;
				qcom,mdss-dsi-h-back-porch = <28>;
				qcom,mdss-dsi-h-pulse-width = <8>;
				qcom,mdss-dsi-h-sync-skew = <0>;
				qcom,mdss-dsi-v-front-porch = <124>;
				qcom,mdss-dsi-v-back-porch = <38>;
				qcom,mdss-dsi-v-pulse-width = <8>;
				qcom,mdss-dsi-panel-framerate = <60>;
				qcom,mdss-dsi-panel-phy-timings= [24 23 08 08 08 02 04 a0
				24 23 08 08 08 02 04 a0
				24 23 08 08 08 02 04 a0
				24 23 08 08 08 02 04 a0
				24 20 08 08 08 02 04 a0];
				qcom,display-topology  = <1 0 1>;
				qcom,default-topology-index  = <0>;
				qcom,mdss-dsi-on-command = [39 01 00 00 00 00 04 B9 83 10 2E
		15 01 00 00 00 00 02 E9 CD
		15 01 00 00 00 00 02 BB 01
		15 01 00 00 00 00 02 E9 00
		39 01 00 00 01 00 2D D5 18 18 18 18 2D 2D 21 20 25 24 18 18 39 39 2E 2E 03 02 03 02 01 00 01 00 07 06 07 06 05 04 05 04 18 18 18 18 18 18 18 18 18 18 18 18
		39 01 00 00 01 00 2D D6 18 18 18 18 18 18 20 21 24 25 2D 2D 39 39 2E 2E 04 05 04 05 06 07 06 07 00 01 00 01 02 03 02 03 18 18 18 18 18 18 18 18 18 18 18 18
		39 01 00 00 00 00 11 B4 7E 64 7E 64 7E 64 68 50 01 8E 01 58 00 FF 00 FF
		39 01 00 00 01 00 2C D3 00 00 00 00 01 04 00 14 0C 27 27 22 29 29 29 04 04 32 10 27 00 27 32 17 C0 07 C0 32 10 24 00 24 00 00 23 44 7A 68 24 43 7A 68 0F
		39 01 00 00 00 00 05 D1 67 0C FF 05
		39 01 00 00 00 00 12 B1 10 FA AF AF 2B 2B C1 75 39 36 36 36 36 22 21 15 00
		39 01 00 00 00 00 03 D2 2B 2B
		15 01 00 00 00 00 02 BD 01
		39 01 00 00 00 00 05 B1 01 9B 01 31
		15 01 00 00 00 00 02 BD 00
		39 01 00 00 00 00 11 B2 00 B0 47 80 00 2C 7E 2D 00 00 00 00 15 20 D7 00
		15 01 00 00 00 00 02 BD 03
		15 01 00 00 00 00 02 B2 80
		15 01 00 00 00 00 02 BD 00
		39 01 00 00 01 00 2F E0 00 04 0C 13 19 2A 41 47 4F 4C 68 70 79 8B 8B 95 9F B2 B2 57 5F 69 76 00 04 0C 13 19 2A 41 47 4F 4C 68 70 79 8B 8B 95 9F B2 B2 57 5F 69 76
		39 01 00 00 00 00 0F C0 23 23 22 11 A2 1F 00 80 00 00 08 00 63 63
		15 01 00 00 00 00 02 CC 0E
		15 01 00 00 00 00 02 C6 F9
		15 01 00 00 00 00 02 C7 30
		39 01 00 00 00 00 07 C8 00 04 04 00 00 82
		39 01 00 00 00 00 09 BA 70 03 A8 83 F2 00 C0 0D
		39 01 00 00 00 00 04 BF FC 85 80
		39 01 00 00 00 00 04 D0 07 04 05
		39 01 00 00 00 00 06 CB 00 13 08 02 3E
		15 01 00 00 00 00 02 BD 01
		39 01 00 00 00 00 0B CB 80 36 12 16 C0 28 40 84 02 34
		39 01 00 00 00 00 0C D3 01 00 7C 00 00 11 10 00 0E 00 01
		15 01 00 00 00 00 02 BD 02
		39 01 00 00 00 00 06 CB 00 03 00 01 8F
		39 01 00 00 01 00 07 B4 4E 00 33 11 33 88
		39 01 00 00 00 00 04 BF F2 00 02
		39 01 00 00 00 00 0D D8 FF FF FF FF FF F0 FF FF FF FF FF F0
		15 01 00 00 00 00 02 BD 03
		39 01 00 00 00 00 19 D8 AA AA AA AA 00 00 AA AA AA AA 00 00 55 55 55 55 00 00 55 55 55 55 00 00
		15 01 00 00 00 00 02 BD 00
		39 01 00 00 00 00 18 E7 12 13 02 02 4B 4B 0F 0F 19 1C 26 74 28 6B 01 27 00 00 00 00 17 00 68
		15 01 00 00 00 00 02 BD 01
		39 01 00 00 00 00 08 E7 02 0C 01 88 0E BC 0F
		15 01 00 00 00 00 02 BD 02
		39 01 00 00 01 00 1D E7 FF 01 FD 01 00 00 22 00 00 00 00 00 00 00 00 00 00 00 00 00 00 00 00 00 81 00 02 40
		15 01 00 00 00 00 02 BD 00
		39 01 00 00 00 00 03 E1 06 02
		39 01 00 00 00 00 04 B9 00 00 00
		05 01 00 00 78 00 01 11
		05 01 00 00 14 00 01 29];
				qcom,mdss-dsi-on-command-state = "dsi_lp_mode";
				qcom,mdss-dsi-off-command = [05 01 00 00 32 00 01 28
				05 01 00 00 78 00 01 10];
				qcom,mdss-dsi-off-command-state = "dsi_lp_mode";
			};
		};
    };
};