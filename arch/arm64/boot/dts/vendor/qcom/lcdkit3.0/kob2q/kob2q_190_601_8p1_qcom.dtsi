/* Copyright (c) 2013, The Linux Foundation. All rights reserved.
 *
 * This program is free software; you can redistribute it and/or modify
 * it under the terms of the GNU General Public License version 2 and
 * only version 2 as published by the Free Software Foundation.
 *
 * This program is distributed in the hope that it will be useful,
 * but WITHOUT ANY WARRANTY; without even the implied warranty of
 * MERCHANTABILITY or FITNESS FOR A PARTICULAR PURPOSE.  See the
 * GNU General Public License for more details.
 */

/*-------------------------------------------------------------------------
 * This file is autogenerated file using gcdb parser. Please do not edit it.
 * Update input XML file to add a new entry or update variable in this file
 * VERSION = 1.1
 *-----------------------------------------------------------------------*/
&mdss_mdp {
	dsi_kob2q_190_601_8p1_qcom: lcd_kit_kob2q_190_601_8p1_qcom {
		compatible = "190_601_8p1";
		lcd-kit,panel-name = "190_601 8.1' VIDEO TFT 800 x 1280";
		lcd-kit,panel-type = <0x1>;
		lcd-kit,panel-xres = <800>;
		lcd-kit,panel-yres = <1280>;
		lcd-kit,panel-on-cmds = [15 01 00 00 78 01 02 11 00
			39 01 00 00 0a 00 03 50 5A 09
			15 01 00 00 0a 00 02 88 00
			39 01 00 00 0a 00 03 50 5A 0C
			15 01 00 00 0a 00 02 80 F9
			39 01 00 00 0a 00 03 50 00 2F
			15 01 00 00 0a 01 02 29 00];
		lcd-kit,panel-on-cmds-state = "dsi_lp_mode";
		lcd-kit,panel-off-cmds = [15 01 00 00 0a 01 02 28 00
			15 01 00 00 96 01 02 10 00
			15 01 00 00 0a 01 02 04 5A
			15 01 00 00 96 01 02 05 5A];
		lcd-kit,panel-off-cmds-state = "dsi_hs_mode";
		lcd-kit,backlight-cmds = [];
		lcd-kit,backlight-cmds-state = "dsi_lp_mode";
		lcd-kit,tp-color-cmds = [];
		lcd-kit,effect-on-cmds = [];
		lcd-kit,cabc-off-cmds = [39 01 00 00 0a 00 03 50 5A 23
			15 01 00 00 0a 00 02 95 00
			39 01 00 00 0a 00 03 50 00 2f];
		lcd-kit,cabc-off-cmds-state = "dsi_hs_mode";
		lcd-kit,cabc-ui-cmds = [39 01 00 00 0a 00 03 50 5A 23
			15 01 00 00 0a 00 02 95 01
			39 01 00 00 0a 00 03 50 00 2f];
		lcd-kit,cabc-ui-cmds-state = "dsi_hs_mode";
		lcd-kit,cabc-still-cmds = [];
		lcd-kit,cabc-still-cmds-state = "dsi_hs_mode";
		lcd-kit,cabc-moving-cmds = [39 01 00 00 0a 00 03 50 5A 23
			15 01 00 00 0a 00 02 95 03
			39 01 00 00 0a 00 03 50 00 2f];
		lcd-kit,cabc-moving-cmds-state = "dsi_hs_mode";
		lcd-kit,bl-after-frame = <0>;
		lcd-kit,vtc-line-no-reset = <0>;
		qcom,mdss-dsi-panel-type = "dsi_video_mode";
		qcom,mdss-dsi-panel-name = "190_601_8p1";
		qcom,mdss-pan-physical-width-dimension = <108>;
		qcom,mdss-pan-physical-height-dimension = <173>;
		qcom,dsi-ctrl-num = <0>;
		qcom,dsi-phy-num = <0>;
		qcom,panel-supply-entries = <&dsi_panel_pwr_supply>;
		qcom,mdss-dsi-virtual-channel-id = <0>;
		qcom,mdss-dsi-h-sync-pulse = <0>;
		qcom,mdss-dsi-bllp-eof-power-mode;
		qcom,mdss-dsi-bllp-power-mode;
		qcom,mdss-dsi-dma-schedule-line = <1>;
		qcom,mdss-dsi-bpp = <24>;
		qcom,mdss-dsi-color-order = "rgb_swap_rgb";
		qcom,mdss-dsi-underflow-color = <0xff>;
		qcom,mdss-dsi-border-color = <0>;
		qcom,mdss-dsi-traffic-mode = "burst_mode";
		qcom,mdss-dsi-lane-map = "lane_map_0123";
		qcom,mdss-dsi-lane-0-state;
		qcom,mdss-dsi-lane-1-state;
		qcom,mdss-dsi-lane-2-state;
		qcom,mdss-dsi-lane-3-state;
		qcom,mdss-dsi-mdp-trigger = "none";
		qcom,mdss-dsi-dma-trigger = "trigger_sw";
		qcom,mdss-dsi-te-pin-select = <0>;
		qcom,mdss-dsi-t-clk-post = <0x0a>;
		qcom,mdss-dsi-t-clk-pre = <0x1f>;
		qcom,mdss-dsi-tx-eot-append;
		qcom,dsi-select-clocks = "mux_byte_clk0", "mux_pixel_clk0", "src_byte_clk0", "src_pixel_clk0", "shadow_byte_clk0", "shadow_pixel_clk0";
		qcom,mdss-dsi-stream = <0>;
		qcom,mdss-dsi-lp11-init;
		qcom,sublinks-count = <2>;
		qcom,lanes-per-sublink = <2>;
		qcom,mdss-dsi-panel-hdr-color-primaries = <14500 15500 32000 17000 15500 30000 8000 3000>;
		qcom,mdss-dsi-panel-peak-brightness = <4200000>;
		qcom,mdss-dsi-panel-blackness-level = <3230>;
		qcom,dynamic-mode-switch-type = "dynamic-resolution-switch-immediate";
		qcom,mdss-dsi-bl-pmic-control-type = "bl_ctrl_i2c_ic";
		pwms = <&pm6125_pwm 0 0>;
		qcom,bl-pmic-pwm-period-usecs = <100>;
		lcd-kit,power-on-stage = <2 1 5
				9 1 2
				7 1 2
				5 1 2
				8 0 5
				5 0 5
				7 1 2
				5 1 40
				6 1 0
				8 1 0>;
		lcd-kit,lp-on-stage = <0 0 0>;
		lcd-kit,lp-off-stage = <0 0 0>;
		lcd-kit,power-off-stage = <6 0 0
				8 0 2
				5 0 2
				9 0 2
				2 0 0>;
		lcd-kit,pt-support = <1>;
		lcd-kit,panel-on-always-reset = <1>;
		lcd-kit,lcd-iovcc = <2 86 1800000>;
		lcd-kit,lcd-vdd = <2 26 1800000>;
		lcd-kit,lcd-reset = <2 82 0>;
		lcd-kit,project-id-support = <1>;
		lcd-kit,default-project-id = "W171751300";
		lcd-kit,sn-code-support = <0>;
		lcd-kit,oem-info-support = <0>;
		lcd-kit,oem-barcode-2d-support = <0>;
		lcd-kit,oem-barcode-2d-num-offset = <0>;
		lcd-kit,panel-getblmaxnit-type = <0>;
		lcd-kit,panel-blmaxnit-min-value = <370>;
		lcd-kit,panel-bl-maxnit-command = <0x06 0x01 0x00 0x00 0x0a 0x00 0x01 0xdb>;
		lcd-kit,panel-bl-maxnit-command-state = "dsi_lp_mode";
		lcd-kit,inversion-support = <1>;
		lcd-kit,panel-gpio-offset = <1167>;
		lcd-kit,panel-bl-max-nit = <450>;
		lcd-kit,panel-bl-min = <75>;
		lcd-kit,panel-bl-max = <7100>;
		lcd-kit,check-reg-support = <1>;
		lcd-kit,thp-proximity-support = <0>;
		lcd-kit,proximity-reset-delay-min = <65>;
		lcd-kit,backlight-order = <0>;
		lcd-kit,quickly-sleep-out-support = <0>;
		lcd-kit,quickly-sleep-out-interval = <0>;
		qcom,mdss-dsi-display-timings {
			timing@0 {
				qcom,mdss-dsi-panel-width = <800>;
				qcom,mdss-dsi-panel-height = <1280>;
				qcom,mdss-dsi-h-front-porch = <68>;
				qcom,mdss-dsi-h-back-porch = <66>;
				qcom,mdss-dsi-h-pulse-width = <14>;
				qcom,mdss-dsi-h-sync-skew = <0>;
				qcom,mdss-dsi-v-front-porch = <101>;
				qcom,mdss-dsi-v-back-porch = <77>;
				qcom,mdss-dsi-v-pulse-width = <8>;
				qcom,mdss-dsi-panel-framerate = <60>;
				qcom,mdss-dsi-panel-phy-timings= [1F 1B 05 06 03 02 04 a0
				1F 1B 05 06 03 02 04 a0
				1F 1B 05 06 03 02 04 a0
				1F 1B 05 06 03 02 04 a0
				1F 10 04 06 03 02 04 a0];
				qcom,display-topology  = <1 0 1>;
				qcom,default-topology-index  = <0>;
			};
		};
    };
};