/*---------------------------------------------------------------------------
 * This file is autogenerated file using huawei LCD parser. Please do not edit it.
 * Update input XML file to add a new entry or update variable in this file
 * Parser location: vendor/huawei/chipset_common/devkit/lcdkit/tools 
 *---------------------------------------------------------------------------*/


#include "ctrn_290_105_6p7_qcom.dtsi"
#include "ctrn_330_105_6p7_qcom.dtsi"
#include "ctrn_330_a07_6p7_qcom.dtsi"
#include "ctrn_auo_otm1901a_5p2_1080p_video_default.dtsi"