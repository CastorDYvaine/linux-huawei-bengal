/* Copyright (c) 2013, The Linux Foundation. All rights reserved.
 *
 * This program is free software; you can redistribute it and/or modify
 * it under the terms of the GNU General Public License version 2 and
 * only version 2 as published by the Free Software Foundation.
 *
 * This program is distributed in the hope that it will be useful,
 * but WITHOUT ANY WARRANTY; without even the implied warranty of
 * MERCHANTABILITY or FITNESS FOR A PARTICULAR PURPOSE.  See the
 * GNU General Public License for more details.
 */

/*-------------------------------------------------------------------------
 * This file is autogenerated file using gcdb parser. Please do not edit it.
 * Update input XML file to add a new entry or update variable in this file
 * VERSION = 1.1
 *-----------------------------------------------------------------------*/
&mdss_mdp {
	dsi_jln_110_210_6p78_qcom: lcd_kit_jln_110_210_6p78_qcom {
		compatible = "110_210_6p78";
		lcd-kit,panel-name = "110_210 6.78' VIDEO 1080 x 2388";
		lcd-kit,panel-type = <0x01>;
		lcd-kit,panel-ldi-dsi-mode = <1>;
		lcd-kit,bl-after-frame = <0>;
		lcd-kit,vtc-line-no-reset = <0>;
		qcom,mdss-dsi-panel-type = "dsi_video_mode";
		qcom,mdss-dsi-panel-name = "110_210_6p78";
		qcom,mdss-pan-physical-width-dimension = <71>;
		qcom,mdss-pan-physical-height-dimension = <157>;
		qcom,dsi-ctrl-num = <0>;
		qcom,dsi-phy-num = <0>;
		qcom,panel-supply-entries = <&dsi_panel_pwr_supply>;
		qcom,mdss-dsi-virtual-channel-id = <0>;
		qcom,mdss-dsi-h-sync-pulse = <0>;
		qcom,mdss-dsi-bllp-eof-power-mode;
		qcom,mdss-dsi-bllp-power-mode;
		qcom,mdss-dsi-dma-schedule-line = <1>;
		qcom,mdss-dsi-bpp = <24>;
		qcom,mdss-dsi-color-order = "rgb_swap_rgb";
		qcom,mdss-dsi-underflow-color = <0xff>;
		qcom,mdss-dsi-border-color = <0>;
		qcom,mdss-dsi-traffic-mode = "burst_mode";
		qcom,mdss-dsi-lane-map = "lane_map_0123";
		qcom,mdss-dsi-lane-0-state;
		qcom,mdss-dsi-lane-1-state;
		qcom,mdss-dsi-lane-2-state;
		qcom,mdss-dsi-lane-3-state;
		qcom,mdss-dsi-mdp-trigger = "none";
		qcom,mdss-dsi-dma-trigger = "trigger_sw";
		qcom,mdss-dsi-te-pin-select = <0>;
		qcom,mdss-dsi-t-clk-post = <0x0D>;
		qcom,mdss-dsi-t-clk-pre = <0x1A>;
		qcom,mdss-dsi-tx-eot-append;
		qcom,dsi-select-clocks = "mux_byte_clk0", "mux_pixel_clk0", "src_byte_clk0", "src_pixel_clk0", "shadow_byte_clk0", "shadow_pixel_clk0";
		qcom,mdss-dsi-stream = <0>;
		qcom,mdss-dsi-lp11-init;
		qcom,sublinks-count = <2>;
		qcom,lanes-per-sublink = <2>;
		qcom,mdss-dsi-panel-hdr-color-primaries = <14500 15500 32000 17000 15500 30000 8000 3000>;
		qcom,mdss-dsi-panel-peak-brightness = <4200000>;
		qcom,mdss-dsi-panel-blackness-level = <3230>;
		qcom,dynamic-mode-switch-type = "dynamic-resolution-switch-immediate";
		qcom,mdss-dsi-bl-pmic-control-type = "bl_ctrl_i2c_ic";
		pwms = <&pm6125_pwm 0 0>;
		qcom,bl-pmic-pwm-period-usecs = <100>;
		qcom,esd-check-enabled;
		qcom,mdss-dsi-panel-status-command = [06 01 00 00 00 00 01 0A
				06 01 00 00 00 00 02 C2 00];
		qcom,mdss-dsi-panel-status-command-state = "dsi_lp_mode";
		qcom,mdss-dsi-panel-status-check-mode = "reg_read";
		qcom,mdss-dsi-panel-status-read-length = <1 2>;
		qcom,mdss-dsi-panel-status-value = <0x9C>,<0x10 0xF0>;
		lcd-kit,power-on-stage = <11 1 0
				3 1 5
				4 1 10
				5 2 1
				5 1 5
				5 2 1
				5 1 10
				7 1 2>;
		lcd-kit,lp-on-stage = <8 1 0>;
		lcd-kit,lp-off-stage = <7 0 0>;
		lcd-kit,power-off-stage = <8 0 0
				11 0 5
				4 0 5
				3 0 2>;
		lcd-kit,only-power-off-stage = <15 0 80
				4 0 5
				3 0 6>;
		lcd-kit,pt-support = <1>;
		lcd-kit,panel-on-always-reset = <1>;
		lcd-kit,lcd-vsp = <2 65 5500000>;
		lcd-kit,lcd-vsn = <2 26 5500000>;
		lcd-kit,lcd-reset = <2 82 0>;
		lcd-kit,project-id-support = <1>;
		lcd-kit,default-project-id = "B2429M1100";
		lcd-kit,sn-code-support = <1>;
		lcd-kit,oem-info-support = <1>;
		lcd-kit,oem-barcode-2d-support = <1>;
		lcd-kit,oem-barcode-2d-num-offset = <0>;
		lcd-kit,barcode-2d-cmds = <0x15 0x01 0x00 0x00 0x0a 0x00 0x02 0xFF 0x21
		0x15 0x01 0x00 0x00 0x0a 0x00 0x02 0xFA 0x00
		0x06 0x01 0x00 0x00 0x0a 0x00 0x05 0xF1 0x00 0x00 0x00 0x00
		0x15 0x01 0x00 0x00 0x0a 0x00 0x02 0xFA 0x05
		0x06 0x01 0x00 0x00 0x0a 0x00 0x05 0xF1 0x00 0x00 0x00 0x00
		0x15 0x01 0x00 0x00 0x0a 0x00 0x02 0xFA 0x0A
		0x06 0x01 0x00 0x00 0x0a 0x00 0x05 0xF1 0x00 0x00 0x00 0x00
		0x15 0x01 0x00 0x00 0x0a 0x00 0x02 0xFA 0x0F
		0x06 0x01 0x00 0x00 0x0a 0x00 0x01 0xF1
		0x15 0x01 0x00 0x00 0x0a 0x00 0x02 0xFA 0x00
		0x06 0x01 0x00 0x00 0x0a 0x00 0x05 0xF2 0x00 0x00 0x00 0x00
		0x15 0x01 0x00 0x00 0x0a 0x00 0x02 0xFF 0x10>;
		lcd-kit,barcode-2d-cmds-state = "dsi_lp_mode";
		lcd-kit,panel-getblmaxnit-type = <0>;
		lcd-kit,panel-blmaxnit-min-value = <370>;
		lcd-kit,panel-bl-maxnit-command = <0x06 0x01 0x00 0x00 0x0a 0x00 0x01 0xdb>;
		lcd-kit,panel-bl-maxnit-command-state = "dsi_lp_mode";
		lcd-kit,inversion-support = <1>;
		lcd-kit,inversion-dot-cmds = <0x15 0x01 0x00 0x00 0x00 0x00 0x02 0xFF 0x24
		0x15 0x01 0x00 0x00 0x00 0x00 0x02 0xFB 0x01
		0x15 0x01 0x00 0x00 0x00 0x00 0x02 0xCF 0x33
		0x15 0x01 0x00 0x00 0x0a 0x00 0x02 0xFF 0x10>;
		lcd-kit,inversion-column-cmds-state = "dsi_lp_mode";
		lcd-kit,inversion-column-cmds = <0x15 0x01 0x00 0x00 0x00 0x00 0x02 0xFF 0x24
		0x15 0x01 0x00 0x00 0x00 0x00 0x02 0xFB 0x01
		0x15 0x01 0x00 0x00 0x00 0x00 0x02 0xCF 0xFF
		0x15 0x01 0x00 0x00 0x0a 0x00 0x02 0xFF 0x10>;
		lcd-kit,inversion-dot-cmds-state = "dsi_lp_mode";
		lcd-kit,panel-gpio-offset = <1167>;
		lcd-kit,panel-bl-max-nit = <450>;
		lcd-kit,panel-bl-min = <18>;
		lcd-kit,panel-bl-max = <6000>;
		lcd-kit,panel-bl-def = <6000>;
		lcd-kit,check-reg-support = <0>;
		lcd-kit,check-reg-cmds = <0x06 0x01 0x00 0x00 0x0a 0x00 0x01 0x0a>;
		lcd-kit,check-reg-value = <0x9c>;
		lcd-kit,check-reg-cmds-state = "dsi_lp_mode";
		lcd-kit,thp-proximity-support = <1>;
		lcd-kit,proximity-reset-delay-min = <65>;
		lcd-kit,proximity-power-off-delay-min = <170>;
		lcd-kit,lcd-power-down-vsp = <2 65 4700000>;
		lcd-kit,lcd-power-down-vsn = <2 26 4700000>;
		lcd-kit,backlight-order = <0>;
		lcd-kit,quickly-sleep-out-support = <1>;
		lcd-kit,quickly-sleep-out-interval = <102>;
		lcd-kit,fps-support = <1>;
		lcd-kit,default-fps = <60>;
		lcd-kit,panel-support-fps-list = <60 90>;
		qcom,mdss-dsi-display-timings {
			timing@0 {
				qcom,mdss-dsi-panel-width = <1080>;
				qcom,mdss-dsi-panel-height = <2388>;
				qcom,mdss-dsi-h-front-porch = <250>;
				qcom,mdss-dsi-h-back-porch = <52>;
				qcom,mdss-dsi-h-pulse-width = <16>;
				qcom,mdss-dsi-h-sync-skew = <0>;
				qcom,mdss-dsi-v-front-porch = <48>;
				qcom,mdss-dsi-v-back-porch = <36>;
				qcom,mdss-dsi-v-pulse-width = <12>;
				qcom,mdss-dsi-panel-framerate = <90>;
				qcom,mdss-dsi-panel-phy-timings= [00 1F 08 07 18 22 08
				08 08 02 04 00 1A 0D];
				qcom,display-topology  = <1 1 1>;
				qcom,default-topology-index  = <0>;
				qcom,mdss-dsi-on-command = [15 01 00 00 00 00 02 FF 25
		15 01 00 00 00 00 02 FB 01
		15 01 00 00 00 00 02 18 22
		15 01 00 00 00 00 02 FF 10
		15 01 00 00 00 00 02 FB 01
		15 01 00 00 00 00 02 36 00
		39 01 00 00 00 00 06 3B 03 24 30 04 04
		15 01 00 00 00 00 02 B0 00
		15 01 00 00 00 00 02 C0 03
		39 01 00 00 00 00 11 C1 89 28 00 0C 02 00 02 0E 01 1F 00 07 08 BB 08 7A
		39 01 00 00 00 00 03 C2 10 F0
		15 01 00 00 00 00 02 FF 20
		15 01 00 00 00 00 02 FB 01
		15 01 00 00 00 00 02 18 66
		15 01 00 00 00 00 02 F3 64
		15 01 00 00 00 00 02 F5 64
		15 01 00 00 00 00 02 F7 64
		15 01 00 00 00 00 02 F9 64
		15 01 00 00 00 00 02 FF 27
		15 01 00 00 00 00 02 FB 01
		15 01 00 00 00 00 02 E5 01
		15 01 00 00 00 00 02 E6 EB
		15 01 00 00 00 00 02 EB 02
		15 01 00 00 00 00 02 EC 20
		15 01 00 00 00 00 02 FF 2A
		15 01 00 00 00 00 02 FB 01
		15 01 00 00 00 00 02 27 80
		15 01 00 00 00 00 02 28 E3
		15 01 00 00 00 00 02 2A AA
		15 01 00 00 00 00 02 31 C9
		15 01 00 00 00 00 02 33 31
		15 01 00 00 00 00 02 34 E5
		15 01 00 00 00 00 02 36 02
		15 01 00 00 00 00 02 37 DE
		15 01 00 00 00 00 02 39 FC
		15 01 00 00 00 00 02 3A 0A
		15 01 00 00 00 00 02 7A 0E
		15 01 00 00 00 00 02 7B 40
		15 01 00 00 00 00 02 7C 03
		15 01 00 00 00 00 02 7F 9F
		15 01 00 00 00 00 02 83 0F
		15 01 00 00 00 00 02 84 28
		15 01 00 00 00 00 02 87 0E
		15 01 00 00 00 00 02 88 FC
		15 01 00 00 00 00 02 89 24
		15 01 00 00 00 00 02 8B 30
		15 01 00 00 00 00 02 8C 46
		15 01 00 00 00 00 02 8D 46
		15 01 00 00 00 00 02 8E 46
		15 01 00 00 00 00 02 FF 2C
		15 01 00 00 00 00 02 FB 01
		15 01 00 00 00 00 02 56 11
		15 01 00 00 00 00 02 58 11
		15 01 00 00 00 00 02 59 11
		15 01 00 00 00 00 02 61 01
		15 01 00 00 00 00 02 62 01
		15 01 00 00 00 00 02 6B 42
		15 01 00 00 00 00 02 6C 42
		15 01 00 00 00 00 02 6D 42
		15 01 00 00 00 00 02 80 AF
		15 01 00 00 00 00 02 81 10
		15 01 00 00 00 00 02 82 F2
		15 01 00 00 00 00 02 84 00
		15 01 00 00 00 00 02 85 F2
		15 01 00 00 00 00 02 87 12
		15 01 00 00 00 00 02 89 12
		15 01 00 00 00 00 02 9D 11
		15 01 00 00 00 00 02 9E 04
		15 01 00 00 00 00 02 9F 01
		15 01 00 00 00 00 02 FF 2B
		15 01 00 00 00 00 02 FB 01
		15 01 00 00 00 00 02 B7 1B
		15 01 00 00 00 00 02 B8 1B
		15 01 00 00 00 00 02 C0 06
		15 01 00 00 00 00 02 FF 2A
		15 01 00 00 00 00 02 FB 01
		15 01 00 00 00 00 02 95 80
		15 01 00 00 00 00 02 96 89
		15 01 00 00 00 00 02 97 06
		15 01 00 00 00 00 02 98 B8
		15 01 00 00 00 00 02 9A 04
		15 01 00 00 00 00 02 9B 02
		15 01 00 00 00 00 02 9C 08
		15 01 00 00 00 00 02 9D 48
		15 01 00 00 00 00 02 9F 28
		15 01 00 00 00 00 02 A0 8B
		15 01 00 00 00 00 02 A3 A2
		15 01 00 00 00 00 02 A4 86
		15 01 00 00 00 00 02 A5 3A
		15 01 00 00 00 00 02 A6 9E
		15 01 00 00 00 00 02 A7 08
		15 01 00 00 00 00 02 FF F0
		15 01 00 00 00 00 02 FB 01
		15 01 00 00 00 00 02 D2 50
		15 01 00 00 00 00 02 84 08
		15 01 00 00 00 00 02 85 0C
		15 01 00 00 00 00 02 FF 25
		15 01 00 00 00 00 02 FB 01
		15 01 00 00 00 00 02 BD 01
		15 01 00 00 00 00 02 91 1F
		15 01 00 00 00 00 02 92 0F
		15 01 00 00 00 00 02 93 01
		15 01 00 00 00 00 02 94 18
		15 01 00 00 00 00 02 95 03
		15 01 00 00 00 00 02 96 01
		15 01 00 00 00 00 02 FF 10
		05 01 00 00 0a 00 01 11
		05 01 00 00 00 00 01 29];
				qcom,mdss-dsi-on-command-state = "dsi_lp_mode";
				qcom,mdss-dsi-off-command = [05 01 00 00 78 00 01 28];
				qcom,mdss-dsi-off-command-state = "dsi_lp_mode";
				qcom,compression-mode = "dsc";
				qcom,mdss-dsc-slice-height = <12>;
				qcom,mdss-dsc-slice-width = <540>;
				qcom,mdss-dsc-slice-per-pkt = <2>;
				qcom,mdss-dsc-bit-per-component = <8>;
				qcom,mdss-dsc-bit-per-pixel = <8>;
				qcom,mdss-dsc-block-prediction-enable;
			};
		};
    };
};