/* Copyright (c) 2013, The Linux Foundation. All rights reserved.
 *
 * This program is free software; you can redistribute it and/or modify
 * it under the terms of the GNU General Public License version 2 and
 * only version 2 as published by the Free Software Foundation.
 *
 * This program is distributed in the hope that it will be useful,
 * but WITHOUT ANY WARRANTY; without even the implied warranty of
 * MERCHANTABILITY or FITNESS FOR A PARTICULAR PURPOSE.  See the
 * GNU General Public License for more details.
 */

/*-------------------------------------------------------------------------
 * This file is autogenerated file using gcdb parser. Please do not edit it.
 * Update input XML file to add a new entry or update variable in this file
 * VERSION = 1.1
 *-----------------------------------------------------------------------*/
&mdss_mdp {
	dsi_kon_320_a03_6p6_qcom: lcd_kit_kon_320_a03_6p6_qcom {
		compatible = "320_a03_6p6";
		lcd-kit,panel-name = "320_a03 6.6' VIDEO 720 x 1600";
		lcd-kit,panel-type = <0x01>;
		lcd-kit,bl-after-frame = <0>;
		lcd-kit,vtc-line-no-reset = <0>;
		qcom,mdss-dsi-panel-type = "dsi_video_mode";
		qcom,mdss-dsi-panel-name = "320_a03_6p6";
		qcom,mdss-pan-physical-width-dimension = <69>;
		qcom,mdss-pan-physical-height-dimension = <154>;
		qcom,dsi-ctrl-num = <0>;
		qcom,dsi-phy-num = <0>;
		qcom,panel-supply-entries = <&dsi_panel_pwr_supply>;
		qcom,mdss-dsi-virtual-channel-id = <0>;
		qcom,mdss-dsi-h-sync-pulse = <0>;
		qcom,mdss-dsi-bllp-eof-power-mode;
		qcom,mdss-dsi-bllp-power-mode;
		qcom,mdss-dsi-dma-schedule-line = <1>;
		qcom,mdss-dsi-bpp = <24>;
		qcom,mdss-dsi-color-order = "rgb_swap_rgb";
		qcom,mdss-dsi-underflow-color = <0xff>;
		qcom,mdss-dsi-border-color = <0>;
		qcom,mdss-dsi-traffic-mode = "burst_mode";
		qcom,mdss-dsi-lane-map = "lane_map_0123";
		qcom,mdss-dsi-lane-0-state;
		qcom,mdss-dsi-lane-1-state;
		qcom,mdss-dsi-lane-2-state;
		qcom,mdss-dsi-mdp-trigger = "none";
		qcom,mdss-dsi-dma-trigger = "trigger_sw";
		qcom,mdss-dsi-te-pin-select = <0>;
		qcom,mdss-dsi-t-clk-post = <0x0f>;
		qcom,mdss-dsi-t-clk-pre = <0x37>;
		qcom,mdss-dsi-tx-eot-append;
		qcom,dsi-select-clocks = "mux_byte_clk0", "mux_pixel_clk0", "src_byte_clk0", "src_pixel_clk0", "shadow_byte_clk0", "shadow_pixel_clk0";
		qcom,mdss-dsi-stream = <0>;
		qcom,mdss-dsi-lp11-init;
		qcom,sublinks-count = <2>;
		qcom,lanes-per-sublink = <2>;
		qcom,mdss-dsi-panel-hdr-color-primaries = <14500 15500 32000 17000 15500 30000 8000 3000>;
		qcom,mdss-dsi-panel-peak-brightness = <4200000>;
		qcom,mdss-dsi-panel-blackness-level = <3230>;
		qcom,dynamic-mode-switch-type = "dynamic-resolution-switch-immediate";
		qcom,mdss-dsi-bl-pmic-control-type = "bl_ctrl_i2c_ic";
		pwms = <&pm6125_pwm 0 0>;
		qcom,bl-pmic-pwm-period-usecs = <100>;
		qcom,esd-check-enabled;
		qcom,mdss-dsi-panel-status-command = [06 01 00 00 00 00 01 0A];
		qcom,mdss-dsi-panel-status-command-state = "dsi_lp_mode";
		qcom,mdss-dsi-panel-status-check-mode = "reg_read";
		qcom,mdss-dsi-panel-status-read-length = <1>;
		qcom,mdss-dsi-panel-status-value = <0x9C>;
		lcd-kit,power-on-stage = <2 1 2
				3 1 2
				4 1 2
				5 1 5
				5 2 1
				5 1 10
				7 1 0>;
		lcd-kit,lp-on-stage = <6 1 0
				8 1 0>;
		lcd-kit,lp-off-stage = <7 0 0
				8 0 1>;
		lcd-kit,power-off-stage = <6 0 0
				4 0 1
				3 0 2>;
		lcd-kit,only-power-off-stage = <0 0 0>;
		lcd-kit,pt-support = <1>;
		lcd-kit,panel-on-always-reset = <1>;
		lcd-kit,lcd-iovcc = <0 4 1800000 1800000 1800000 62000 80>;
		lcd-kit,lcd-vsp = <1 137 5500000 4600000 6000000 100000 100>;
		lcd-kit,lcd-vsn = <1 138 5500000 4600000 6000000 100000 100>;
		lcd-kit,lcd-reset = <2 82 0>;
		lcd-kit,lcd-iovcc-name = "vddio";
		lcd-kit,lcd-vsp-name = "lab";
		lcd-kit,lcd-vsn-name = "ibb";
		lcd-kit,project-id-support = <1>;
		lcd-kit,default-project-id = "GPIKA6330";
		lcd-kit,Does-lcd-poweron-tp = <1>;
		lcd-kit,sn-code-support = <1>;
		lcd-kit,oem-info-support = <1>;
		lcd-kit,oem-barcode-2d-support = <1>;
		lcd-kit,oem-barcode-2d-num-offset = <0>;
		lcd-kit,barcode-2d-cmds = <0x29 0x01 0x00 0x00 0x00 0x00 0x04 0xFF 0x98 0x82 0x0D
		0x06 0x01 0x00 0x00 0x00 0x00 0x01 0x00
		0x06 0x01 0x00 0x00 0x00 0x00 0x01 0x01
		0x06 0x01 0x00 0x00 0x00 0x00 0x01 0x02
		0x06 0x01 0x00 0x00 0x00 0x00 0x01 0x03
		0x06 0x01 0x00 0x00 0x00 0x00 0x01 0x04
		0x06 0x01 0x00 0x00 0x00 0x00 0x01 0x05
		0x06 0x01 0x00 0x00 0x00 0x00 0x01 0x06
		0x06 0x01 0x00 0x00 0x00 0x00 0x01 0x07
		0x06 0x01 0x00 0x00 0x00 0x00 0x01 0x08
		0x06 0x01 0x00 0x00 0x00 0x00 0x01 0x09
		0x06 0x01 0x00 0x00 0x00 0x00 0x01 0x0a
		0x06 0x01 0x00 0x00 0x00 0x00 0x01 0x0b
		0x06 0x01 0x00 0x00 0x00 0x00 0x01 0x0c
		0x06 0x01 0x00 0x00 0x00 0x00 0x01 0x0d
		0x06 0x01 0x00 0x00 0x00 0x00 0x01 0x0e
		0x06 0x01 0x00 0x00 0x00 0x00 0x01 0x0f
		0x06 0x01 0x00 0x00 0x00 0x00 0x01 0x10
		0x06 0x01 0x00 0x00 0x00 0x00 0x01 0x11
		0x06 0x01 0x00 0x00 0x00 0x00 0x01 0x12
		0x06 0x01 0x00 0x00 0x00 0x00 0x01 0x13
		0x06 0x01 0x00 0x00 0x00 0x00 0x01 0x14
		0x29 0x01 0x00 0x00 0x00 0x00 0x04 0xFF 0x98 0x82 0x00>;
		lcd-kit,barcode-2d-cmds-state = "dsi_lp_mode";
		lcd-kit,panel-getblmaxnit-type = <0>;
		lcd-kit,panel-blmaxnit-min-value = <400>;
		lcd-kit,panel-bl-maxnit-command = <0x06 0x01 0x00 0x00 0x0a 0x00 0x01 0xdb>;
		lcd-kit,panel-bl-maxnit-command-state = "dsi_lp_mode";
		lcd-kit,inversion-support = <1>;
		lcd-kit,inversion-dot-cmds = <0x29 0x01 0x00 0x00 0x00 0x00 0x04 0xFF 0x98 0x82 0x02
		0x15 0x01 0x00 0x00 0x00 0x00 0x02 0x44 0x23
		0x29 0x01 0x00 0x00 0x00 0x00 0x04 0xFF 0x98 0x82 0x00>;
		lcd-kit,inversion-column-cmds-state = "dsi_lp_mode";
		lcd-kit,inversion-column-cmds = <0x29 0x01 0x00 0x00 0x00 0x00 0x04 0xFF 0x98 0x82 0x02
		0x15 0x01 0x00 0x00 0x00 0x00 0x02 0x44 0x28
		0x29 0x01 0x00 0x00 0x00 0x00 0x04 0xFF 0x98 0x82 0x00>;
		lcd-kit,inversion-dot-cmds-state = "dsi_lp_mode";
		lcd-kit,panel-gpio-offset = <1167>;
		lcd-kit,panel-bl-max-nit = <450>;
		lcd-kit,panel-bl-min = <25>;
		lcd-kit,panel-bl-max = <10000>;
		lcd-kit,check-reg-support = <1>;
		lcd-kit,check-reg-cmds = <0x06 0x01 0x00 0x00 0x00 0x00 0x01 0x0A>;
		lcd-kit,check-reg-value = <0x9C>;
		lcd-kit,check-reg-cmds-state = "dsi_lp_mode";
		lcd-kit,thp-proximity-support = <0>;
		lcd-kit,proximity-reset-delay-min = <65>;
		lcd-kit,backlight-order = <0>;
		lcd-kit,quickly-sleep-out-support = <0>;
		lcd-kit,quickly-sleep-out-interval = <0>;
		qcom,mdss-dsi-display-timings {
			timing@0 {
				qcom,mdss-dsi-panel-width = <720>;
				qcom,mdss-dsi-panel-height = <1600>;
				qcom,mdss-dsi-h-front-porch = <230>;
				qcom,mdss-dsi-h-back-porch = <242>;
				qcom,mdss-dsi-h-pulse-width = <36>;
				qcom,mdss-dsi-h-sync-skew = <0>;
				qcom,mdss-dsi-v-front-porch = <248>;
				qcom,mdss-dsi-v-back-porch = <16>;
				qcom,mdss-dsi-v-pulse-width = <2>;
				qcom,mdss-dsi-panel-framerate = <60>;
				qcom,mdss-dsi-panel-phy-timings= [26 21 09 0B 06 02 04 a0
				26 21 09 0B 06 02 04 a0
				26 21 09 0B 06 02 04 a0
				26 21 09 0B 06 02 04 a0
				26 20 0A 0B 06 02 04 a0];
				qcom,display-topology  = <1 0 1>;
				qcom,default-topology-index  = <0>;
				qcom,mdss-dsi-on-command = [39 01 00 00 00 00 04 FF 98 82 00
		39 01 00 00 00 00 03 51 00 00
		15 01 00 00 00 00 02 53 24
		39 01 00 00 00 00 03 68 03 01
		15 01 00 00 00 00 02 35 00
		05 01 00 00 40 00 01 11
		05 01 00 00 14 00 01 29];
				qcom,mdss-dsi-on-command-state = "dsi_lp_mode";
				qcom,mdss-dsi-off-command = [05 01 00 00 14 00 01 28
		05 01 00 00 78 00 01 10];
				qcom,mdss-dsi-off-command-state = "dsi_lp_mode";
			};
		};
    };
};