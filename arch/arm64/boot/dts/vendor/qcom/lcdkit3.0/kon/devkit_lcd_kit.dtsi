/*---------------------------------------------------------------------------
 * This file is autogenerated file using huawei LCD parser. Please do not edit it.
 * Update input XML file to add a new entry or update variable in this file
 * Parser location: vendor/huawei/chipset_common/devkit/lcdkit/tools 
 *---------------------------------------------------------------------------*/


#include "kon_250_a03_6p6_qcom.dtsi"
#include "kon_250_d00_6p6_qcom.dtsi"
#include "kon_320_a03_6p6_b6_qcom.dtsi"
#include "kon_320_a03_6p6_qcom.dtsi"
#include "kon_330_a03_6p6_qcom.dtsi"
#include "kon_auo_otm1901a_5p2_1080p_video_default.dtsi"