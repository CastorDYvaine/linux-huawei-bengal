/* Copyright (c) 2013, The Linux Foundation. All rights reserved.
 *
 * This program is free software; you can redistribute it and/or modify
 * it under the terms of the GNU General Public License version 2 and
 * only version 2 as published by the Free Software Foundation.
 *
 * This program is distributed in the hope that it will be useful,
 * but WITHOUT ANY WARRANTY; without even the implied warranty of
 * MERCHANTABILITY or FITNESS FOR A PARTICULAR PURPOSE.  See the
 * GNU General Public License for more details.
 */

/*-------------------------------------------------------------------------
 * This file is autogenerated file using gcdb parser. Please do not edit it.
 * Update input XML file to add a new entry or update variable in this file
 * VERSION = 1.1
 *-----------------------------------------------------------------------*/
&mdss_mdp {
	dsi_grf_190_604_9p7_qcom: lcd_kit_grf_190_604_9p7_qcom {
		compatible = "190_604_9p7";
		lcd-kit,panel-name = "190_604 9.7' VIDEO 800 x 1280";
		lcd-kit,panel-type = <0x01>;
		lcd-kit,bl-after-frame = <0>;
		lcd-kit,vtc-line-no-reset = <0>;
		qcom,mdss-dsi-panel-type = "dsi_video_mode";
		qcom,mdss-pan-physical-width-dimension = <131>;
		qcom,mdss-pan-physical-height-dimension = <209>;
		qcom,dsi-ctrl-num = <0>;
		qcom,dsi-phy-num = <0>;
		qcom,panel-supply-entries = <&dsi_panel_pwr_supply>;
		qcom,mdss-dsi-virtual-channel-id = <0>;
		qcom,mdss-dsi-h-sync-pulse = <0>;
		qcom,mdss-dsi-bllp-eof-power-mode;
		qcom,mdss-dsi-bllp-power-mode;
		qcom,mdss-dsi-dma-schedule-line = <1>;
		qcom,mdss-dsi-bpp = <24>;
		qcom,mdss-dsi-color-order = "rgb_swap_rgb";
		qcom,mdss-dsi-underflow-color = <0xff>;
		qcom,mdss-dsi-border-color = <0>;
		qcom,mdss-dsi-traffic-mode = "burst_mode";
		qcom,mdss-dsi-lane-map = "lane_map_0123";
		qcom,mdss-dsi-lane-0-state;
		qcom,mdss-dsi-lane-1-state;
		qcom,mdss-dsi-lane-2-state;
		qcom,mdss-dsi-lane-3-state;
		qcom,mdss-dsi-mdp-trigger = "none";
		qcom,mdss-dsi-dma-trigger = "trigger_sw";
		qcom,mdss-dsi-te-pin-select = <0>;
		qcom,mdss-dsi-t-clk-post = <0x0c>;
		qcom,mdss-dsi-t-clk-pre = <0x29>;
		qcom,mdss-dsi-tx-eot-append;
		qcom,dsi-select-clocks = "mux_byte_clk0", "mux_pixel_clk0", "src_byte_clk0", "src_pixel_clk0", "shadow_byte_clk0", "shadow_pixel_clk0";
		qcom,mdss-dsi-stream = <0>;
		qcom,sublinks-count = <2>;
		qcom,lanes-per-sublink = <2>;
		qcom,mdss-dsi-panel-hdr-color-primaries = <14500 15500 32000 17000 15500 30000 8000 3000>;
		qcom,mdss-dsi-panel-peak-brightness = <4200000>;
		qcom,mdss-dsi-panel-blackness-level = <3230>;
		qcom,dynamic-mode-switch-type = "dynamic-resolution-switch-immediate";
		qcom,mdss-dsi-bl-pmic-control-type = "bl_ctrl_i2c_ic";
		pwms = <&pm6125_pwm 0 0>;
		qcom,bl-pmic-pwm-period-usecs = <100>;
		lcd-kit,power-on-stage = <2 1 2
				7 1 2
				11 1 1
				3 1 4
				4 1 4
				5 1 4
				5 0 1
				5 1 40>;
		lcd-kit,lp-on-stage = <6 1 0
				8 1 0>;
		lcd-kit,lp-off-stage = <7 0 0
				6 0 0
				8 0 0>;
		lcd-kit,power-off-stage = <5 0 3
				11 0 5
				4 0 2
				3 0 3
				2 0 0>;
		lcd-kit,pt-support = <1>;
		lcd-kit,panel-on-always-reset = <1>;
		lcd-kit,lcd-iovcc = <2 93 1800000>;
		lcd-kit,lcd-vsp = <2 65 6000000>;
		lcd-kit,lcd-vsn = <2 26 6000000>;
		lcd-kit,lcd-reset = <2 82 0>;
		lcd-kit,project-id-support = <1>;
		lcd-kit,default-project-id = "W171AG130";
		lcd-kit,Does-lcd-poweron-tp = <1>;
		lcd-kit,sn-code-support = <0>;
		lcd-kit,oem-info-support = <0>;
		lcd-kit,oem-barcode-2d-support = <0>;
		lcd-kit,oem-barcode-2d-num-offset = <0>;
		lcd-kit,panel-getblmaxnit-type = <0>;
		lcd-kit,panel-blmaxnit-min-value = <370>;
		lcd-kit,panel-bl-maxnit-command = <0x06 0x01 0x00 0x00 0x0a 0x00 0x01 0xdb>;
		lcd-kit,panel-bl-maxnit-command-state = "dsi_lp_mode";
		lcd-kit,inversion-support = <1>;
		lcd-kit,inversion-dot-cmds = <0x15 0x01 0x00 0x00 0x00 0x00 0x02 0xFF 0x24
		0x15 0x01 0x00 0x00 0x00 0x00 0x02 0xFB 0x01
		0x15 0x01 0x00 0x00 0x00 0x00 0x02 0xCF 0x33
		0x15 0x01 0x00 0x00 0x0a 0x00 0x02 0xFF 0x10>;
		lcd-kit,inversion-column-cmds-state = "dsi_lp_mode";
		lcd-kit,inversion-column-cmds = <0x15 0x01 0x00 0x00 0x00 0x00 0x02 0xFF 0x24
		0x15 0x01 0x00 0x00 0x00 0x00 0x02 0xFB 0x01
		0x15 0x01 0x00 0x00 0x00 0x00 0x02 0xCF 0xFF
		0x15 0x01 0x00 0x00 0x0a 0x00 0x02 0xFF 0x10>;
		lcd-kit,inversion-dot-cmds-state = "dsi_lp_mode";
		lcd-kit,panel-gpio-offset = <1167>;
		lcd-kit,panel-bl-max-nit = <450>;
		lcd-kit,panel-bl-min = <75>;
		lcd-kit,panel-bl-max = <7100>;
		lcd-kit,check-reg-support = <1>;
		lcd-kit,thp-proximity-support = <0>;
		lcd-kit,proximity-reset-delay-min = <65>;
		lcd-kit,lcd-power-down-vsp = <2 65 4700000>;
		lcd-kit,lcd-power-down-vsn = <2 26 4700000>;
		lcd-kit,backlight-order = <0>;
		lcd-kit,quickly-sleep-out-support = <0>;
		lcd-kit,quickly-sleep-out-interval = <0>;
		qcom,mdss-dsi-display-timings {
			timing@0 {
				qcom,mdss-dsi-panel-width = <800>;
				qcom,mdss-dsi-panel-height = <1280>;
				qcom,mdss-dsi-h-front-porch = <248>;
				qcom,mdss-dsi-h-back-porch = <248>;
				qcom,mdss-dsi-h-pulse-width = <6>;
				qcom,mdss-dsi-h-sync-skew = <0>;
				qcom,mdss-dsi-v-front-porch = <240>;
				qcom,mdss-dsi-v-back-porch = <10>;
				qcom,mdss-dsi-v-pulse-width = <6>;
				qcom,mdss-dsi-panel-framerate = <60>;
				qcom,mdss-dsi-panel-phy-timings= [21 1D 07 08 04 02 04 a0
				21 1D 07 08 04 02 04 a0
				21 1D 07 08 04 02 04 a0
				21 1D 07 08 04 02 04 a0
				21 16 06 07 04 02 04 a0];
				qcom,display-topology  = <1 0 1>;
				qcom,default-topology-index  = <0>;
				qcom,mdss-dsi-on-command = [15 01 00 00 00 00 02 00 00
		39 01 00 00 00 00 04 FF 82 01 01
		15 01 00 00 00 00 02 00 80
		39 01 00 00 00 00 03 FF 82 01
		15 01 00 00 00 00 02 00 E6
		15 01 00 00 00 00 02 C0 50
		15 01 00 00 00 00 02 00 93
		15 01 00 00 00 00 02 C5 84
		15 01 00 00 00 00 02 00 97
		15 01 00 00 00 00 02 C5 84
		15 01 00 00 00 00 02 00 9E
		15 01 00 00 00 00 02 C5 0A
		15 01 00 00 00 00 02 00 9A
		15 01 00 00 00 00 02 C5 C3
		15 01 00 00 00 00 02 00 9C
		15 01 00 00 00 00 02 C5 C3
		15 01 00 00 00 00 02 00 B6
		39 01 00 00 00 00 03 C5 75 75
		15 01 00 00 00 00 02 00 B8
		39 01 00 00 00 00 03 C5 39 39
		15 01 00 00 00 00 02 00 00
		39 01 00 00 00 00 03 D8 D2 D2
		15 01 00 00 00 00 02 00 82
		15 01 00 00 00 00 02 C5 95
		15 01 00 00 00 00 02 00 83
		15 01 00 00 00 00 02 C5 07
		15 01 00 00 00 00 02 00 80
		15 01 00 00 00 00 02 A4 8C
		15 01 00 00 00 00 02 00 A0
		15 01 00 00 00 00 02 F3 10
		15 01 00 00 00 00 02 00 A1
		39 01 00 00 00 00 03 B3 03 20
		15 01 00 00 00 00 02 00 A3
		39 01 00 00 00 00 03 B3 05 00
		15 01 00 00 00 00 02 00 A5
		39 01 00 00 00 00 03 B3 00 13
		15 01 00 00 00 00 02 00 D0
		15 01 00 00 00 00 02 C1 30
		15 01 00 00 00 00 02 00 80
		39 01 00 00 00 00 08 CB 33 33 30 33 30 33 30
		15 01 00 00 00 00 02 00 87
		15 01 00 00 00 00 02 CB 33
		15 01 00 00 00 00 02 00 88
		39 01 00 00 00 00 09 CB 33 33 33 33 33 30 33 33
		15 01 00 00 00 00 02 00 90
		39 01 00 00 00 00 08 CB 30 33 33 33 30 30 33
		15 01 00 00 00 00 02 00 97
		15 01 00 00 00 00 02 CB 33
		15 01 00 00 00 00 02 00 98
		39 01 00 00 00 00 09 CB C4 04 04 04 04 04 04 04
		15 01 00 00 00 00 02 00 A0
		39 01 00 00 00 00 09 CB 04 04 04 04 04 04 04 04
		15 01 00 00 00 00 02 00 A8
		39 01 00 00 00 00 09 CB 04 04 04 04 04 04 04 04
		15 01 00 00 00 00 02 00 B0
		39 01 00 00 00 00 08 CB 00 00 00 00 00 00 00
		15 01 00 00 00 00 02 00 B7
		15 01 00 00 00 00 02 CB 00
		15 01 00 00 00 00 02 00 B8
		39 01 00 00 00 00 09 CB 00 00 00 00 00 00 00 00
		15 01 00 00 00 00 02 00 C0
		39 01 00 00 00 00 08 CB 00 00 00 00 00 00 00
		15 01 00 00 00 00 02 00 C7
		15 01 00 00 00 00 02 CB 00
		15 01 00 00 00 00 02 00 80
		39 01 00 00 00 00 09 CC 00 00 0A 0A 20 20 2A 2A
		15 01 00 00 00 00 02 00 88
		39 01 00 00 00 00 09 CC 02 02 29 29 01 01 16 16
		15 01 00 00 00 00 02 00 90
		39 01 00 00 00 00 07 CC 15 15 14 14 13 13
		15 01 00 00 00 00 02 00 80
		39 01 00 00 00 00 09 CD 00 00 09 09 1F 1F 2A 2A
		15 01 00 00 00 00 02 00 88
		39 01 00 00 00 00 09 CD 02 02 29 29 01 01 1A 1A
		15 01 00 00 00 00 02 00 90
		39 01 00 00 00 00 07 CD 19 19 18 18 17 17
		15 01 00 00 00 00 02 00 A0
		39 01 00 00 00 00 09 CC 00 00 09 09 1F 1F 2A 2A
		15 01 00 00 00 00 02 00 A8
		39 01 00 00 00 00 09 CC 02 02 29 29 01 01 17 17
		15 01 00 00 00 00 02 00 B0
		39 01 00 00 00 00 07 CC 18 18 19 19 1A 1A
		15 01 00 00 00 00 02 00 A0
		39 01 00 00 00 00 09 CD 00 00 0A 0A 20 20 2A 2A
		15 01 00 00 00 00 02 00 A8
		39 01 00 00 00 00 09 CD 02 02 29 29 01 01 13 13
		15 01 00 00 00 00 02 00 B0
		39 01 00 00 00 00 07 CD 14 14 15 15 16 16
		15 01 00 00 00 00 02 00 81
		15 01 00 00 00 00 02 C2 40
		15 01 00 00 00 00 02 00 98
		39 01 00 00 00 00 05 C2 89 03 10 9A
		15 01 00 00 00 00 02 00 9C
		39 01 00 00 00 00 05 C2 88 03 10 9A
		15 01 00 00 00 00 02 00 B0
		39 01 00 00 00 00 05 C2 11 04 B1 A8
		15 01 00 00 00 00 02 00 B4
		39 01 00 00 00 00 05 C2 12 04 B1 A8
		15 01 00 00 00 00 02 00 A0
		39 01 00 00 00 00 05 C3 02 00 0D 18
		15 01 00 00 00 00 02 00 A8
		39 01 00 00 00 00 05 C3 12 00 0C 17
		15 01 00 00 00 00 02 00 80
		39 01 00 00 00 00 09 C3 82 0D 23 10 A5 00 02 07
		15 01 00 00 00 00 02 00 88
		39 01 00 00 00 00 09 C3 80 0D 23 10 A5 00 02 07
		15 01 00 00 00 00 02 00 90
		39 01 00 00 00 00 09 C3 86 11 23 10 A5 00 02 07
		15 01 00 00 00 00 02 00 98
		39 01 00 00 00 00 09 C3 84 11 23 10 A5 00 02 07
		15 01 00 00 00 00 02 00 C0
		39 01 00 00 00 00 09 CD 83 0D 23 10 A5 00 02 07
		15 01 00 00 00 00 02 00 C8
		39 01 00 00 00 00 09 CD 81 0D 23 10 A5 00 02 07
		15 01 00 00 00 00 02 00 D0
		39 01 00 00 00 00 09 CD 87 11 23 10 A5 00 02 07
		15 01 00 00 00 00 02 00 D8
		39 01 00 00 00 00 09 CD 85 11 23 10 A5 00 02 07
		15 01 00 00 00 00 02 00 80
		39 01 00 00 00 00 07 C0 00 D6 00 FF 00 10
		15 01 00 00 00 00 02 00 90
		39 01 00 00 00 00 07 C0 00 D6 00 FF 00 10
		15 01 00 00 00 00 02 00 A0
		39 01 00 00 00 00 07 C0 01 AC 00 FF 00 10
		15 01 00 00 00 00 02 00 B0
		39 01 00 00 00 00 06 C0 00 D6 00 FF 10
		15 01 00 00 00 00 02 00 A3
		39 01 00 00 00 00 04 C1 28 28 04
		15 01 00 00 00 00 02 00 80
		15 01 00 00 00 00 02 CE 00
		15 01 00 00 00 00 02 00 90
		15 01 00 00 00 00 02 CE 00
		15 01 00 00 00 00 02 00 D0
		39 01 00 00 00 00 09 CE 01 00 1A 01 01 00 A8 00
		15 01 00 00 00 00 02 00 E0
		15 01 00 00 00 00 02 CE 00
		15 01 00 00 00 00 02 00 F0
		15 01 00 00 00 00 02 CE 00
		15 01 00 00 00 00 02 00 B0
		39 01 00 00 00 00 05 CF 00 00 5A 5E
		15 01 00 00 00 00 02 00 B5
		39 01 00 00 00 00 05 CF 02 02 A0 A4
		15 01 00 00 00 00 02 00 C0
		39 01 00 00 00 00 05 CF 04 04 DC E0
		15 01 00 00 00 00 02 00 C5
		39 01 00 00 00 00 05 CF 00 05 08 00
		15 01 00 00 00 00 02 00 90
		15 01 00 00 00 00 02 C4 88
		15 01 00 00 00 00 02 00 92
		15 01 00 00 00 00 02 C4 C0
		15 01 00 00 00 00 02 00 A8
		15 01 00 00 00 00 02 C5 A2
		15 01 00 00 00 00 02 00 CB
		15 01 00 00 00 00 02 C5 01
		15 01 00 00 00 00 02 00 FD
		15 01 00 00 00 00 02 CB 82
		15 01 00 00 00 00 02 00 9F
		15 01 00 00 00 00 02 C5 40
		15 01 00 00 00 00 02 00 91
		15 01 00 00 00 00 02 C5 4C
		15 01 00 00 00 00 02 00 D7
		15 01 00 00 00 00 02 CE 01
		15 01 00 00 00 00 02 00 98
		15 01 00 00 00 00 02 C5 27
		15 01 00 00 00 00 02 00 8C
		39 01 00 00 00 00 03 CF 40 40
		15 01 00 00 00 00 02 00 9A
		15 01 00 00 00 00 02 F5 35
		15 01 00 00 00 00 02 00 A2
		15 01 00 00 00 00 02 F5 1F
		15 01 00 00 00 00 02 00 A0
		15 01 00 00 00 00 02 C1 E0
		15 01 00 00 00 00 02 1C 00
		15 01 00 00 00 00 02 00 C9
		15 01 00 00 00 00 02 CE 00
		15 01 00 00 00 00 02 00 94
		15 01 00 00 00 00 02 C5 45
		15 01 00 00 00 00 02 00 98
		15 01 00 00 00 00 02 C5 57
		15 01 00 00 00 00 02 00 9B
		15 01 00 00 00 00 02 C5 55
		15 01 00 00 00 00 02 00 9D
		15 01 00 00 00 00 02 C5 55
		15 01 00 00 00 00 02 00 00
		39 01 00 00 00 00 11 E1 05 0D 1F 31 3C 48 5A 68 6B 78 7B 90 73 60 61 56
		15 01 00 00 00 00 02 00 10
		39 01 00 00 00 00 09 E1 4F 44 35 2D 25 17 06 00
		15 01 00 00 00 00 02 00 00
		39 01 00 00 00 00 11 E2 05 0D 1F 31 3C 48 5A 68 6B 78 7B 90 73 60 61 56
		15 01 00 00 00 00 02 00 10
		39 01 00 00 00 00 09 E2 4F 44 35 2D 25 17 06 00
		05 01 00 00 78 00 01 11
		05 01 00 00 0a 00 01 29
		15 01 00 00 00 00 02 35 00];
				qcom,mdss-dsi-on-command-state = "dsi_lp_mode";
				qcom,mdss-dsi-off-command = [15 01 00 00 0a 00 02 28 00
			15 01 00 00 96 00 02 10 00];
				qcom,mdss-dsi-off-command-state = "dsi_lp_mode";
			};
		};
    };
};