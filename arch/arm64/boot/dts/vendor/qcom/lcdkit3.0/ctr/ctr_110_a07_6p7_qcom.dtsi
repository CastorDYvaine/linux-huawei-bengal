/* Copyright (c) 2013, The Linux Foundation. All rights reserved.
 *
 * This program is free software; you can redistribute it and/or modify
 * it under the terms of the GNU General Public License version 2 and
 * only version 2 as published by the Free Software Foundation.
 *
 * This program is distributed in the hope that it will be useful,
 * but WITHOUT ANY WARRANTY; without even the implied warranty of
 * MERCHANTABILITY or FITNESS FOR A PARTICULAR PURPOSE.  See the
 * GNU General Public License for more details.
 */

/*-------------------------------------------------------------------------
 * This file is autogenerated file using gcdb parser. Please do not edit it.
 * Update input XML file to add a new entry or update variable in this file
 * VERSION = 1.1
 *-----------------------------------------------------------------------*/
&mdss_mdp {
	dsi_ctr_110_a07_6p7_qcom: lcd_kit_ctr_110_a07_6p7_qcom {
		compatible = "110_a07_6p7";
		lcd-kit,panel-name = "110_a07 6.7' VIDEO 1080 x 2388";
		lcd-kit,panel-type = <0x01>;
		lcd-kit,panel-ldi-dsi-mode = <1>;
		lcd-kit,bl-after-frame = <0>;
		lcd-kit,vtc-line-no-reset = <0>;
		qcom,mdss-dsi-panel-type = "dsi_video_mode";
		qcom,mdss-dsi-panel-name = "110_a07_6p7";
		qcom,mdss-pan-physical-width-dimension = <71>;
		qcom,mdss-pan-physical-height-dimension = <157>;
		qcom,dsi-ctrl-num = <0>;
		qcom,dsi-phy-num = <0>;
		qcom,panel-supply-entries = <&dsi_panel_pwr_supply>;
		qcom,mdss-dsi-virtual-channel-id = <0>;
		qcom,mdss-dsi-h-sync-pulse = <0>;
		qcom,mdss-dsi-bllp-eof-power-mode;
		qcom,mdss-dsi-bllp-power-mode;
		qcom,mdss-dsi-dma-schedule-line = <1>;
		qcom,mdss-dsi-bpp = <24>;
		qcom,mdss-dsi-color-order = "rgb_swap_rgb";
		qcom,mdss-dsi-underflow-color = <0xff>;
		qcom,mdss-dsi-border-color = <0>;
		qcom,mdss-dsi-traffic-mode = "burst_mode";
		qcom,mdss-dsi-lane-map = "lane_map_0123";
		qcom,mdss-dsi-lane-0-state;
		qcom,mdss-dsi-lane-1-state;
		qcom,mdss-dsi-lane-2-state;
		qcom,mdss-dsi-lane-3-state;
		qcom,mdss-dsi-mdp-trigger = "none";
		qcom,mdss-dsi-dma-trigger = "trigger_sw";
		qcom,mdss-dsi-te-pin-select = <0>;
		qcom,mdss-dsi-t-clk-post = <0x0D>;
		qcom,mdss-dsi-t-clk-pre = <0x1C>;
		qcom,mdss-dsi-tx-eot-append;
		qcom,dsi-select-clocks = "mux_byte_clk0", "mux_pixel_clk0", "src_byte_clk0", "src_pixel_clk0", "shadow_byte_clk0", "shadow_pixel_clk0";
		qcom,mdss-dsi-stream = <0>;
		qcom,mdss-dsi-lp11-init;
		qcom,sublinks-count = <2>;
		qcom,lanes-per-sublink = <2>;
		qcom,mdss-dsi-panel-hdr-color-primaries = <14500 15500 32000 17000 15500 30000 8000 3000>;
		qcom,mdss-dsi-panel-peak-brightness = <4200000>;
		qcom,mdss-dsi-panel-blackness-level = <3230>;
		qcom,dynamic-mode-switch-type = "dynamic-resolution-switch-immediate";
		qcom,mdss-dsi-bl-pmic-control-type = "bl_ctrl_i2c_ic";
		pwms = <&pm6125_pwm 0 0>;
		qcom,bl-pmic-pwm-period-usecs = <100>;
		qcom,esd-check-enabled;
		qcom,mdss-dsi-panel-status-command = [39 01 00 00 00 00 04 FF 78 07 00
			06 01 00 00 00 00 01 0A];
		qcom,mdss-dsi-panel-status-command-state = "dsi_lp_mode";
		qcom,mdss-dsi-panel-status-check-mode = "reg_read";
		qcom,mdss-dsi-panel-status-read-length = <0 1>;
		qcom,mdss-dsi-panel-status-value = <0x9C>;
		lcd-kit,power-on-stage = <11 1 0
				3 1 2
				4 1 10
				5 2 1
				5 1 5
				5 2 1
				5 1 10
				7 1 2>;
		lcd-kit,lp-on-stage = <8 1 0>;
		lcd-kit,lp-off-stage = <7 0 0>;
		lcd-kit,power-off-stage = <8 0 50
				4 0 1
				3 0 2
				11 0 5>;
		lcd-kit,only-power-off-stage = <15 0 80
				4 0 0
				3 0 6>;
		lcd-kit,pt-support = <1>;
		lcd-kit,panel-on-always-reset = <1>;
		lcd-kit,lcd-vsp = <2 65 5500000>;
		lcd-kit,lcd-vsn = <2 26 5500000>;
		lcd-kit,lcd-reset = <2 82 0>;
		lcd-kit,project-id-support = <1>;
		lcd-kit,default-project-id = "P327AQ1110";
		lcd-kit,sn-code-support = <1>;
		lcd-kit,oem-info-support = <1>;
		lcd-kit,oem-barcode-2d-support = <1>;
		lcd-kit,oem-barcode-2d-num-offset = <0>;
		lcd-kit,barcode-2d-cmds = <0x39 0x01 0x00 0x00 0x00 0x00 0x04 0xFF 0x78 0x07 0x0B
		0x06 0x01 0x00 0x00 0x00 0x00 0x01 0x10
		0x06 0x01 0x00 0x00 0x00 0x00 0x01 0x11
		0x06 0x01 0x00 0x00 0x00 0x00 0x01 0x12
		0x06 0x01 0x00 0x00 0x00 0x00 0x01 0x13
		0x06 0x01 0x00 0x00 0x00 0x00 0x01 0x14
		0x06 0x01 0x00 0x00 0x00 0x00 0x01 0x15
		0x06 0x01 0x00 0x00 0x00 0x00 0x01 0x16
		0x06 0x01 0x00 0x00 0x00 0x00 0x01 0x17
		0x06 0x01 0x00 0x00 0x00 0x00 0x01 0x18
		0x06 0x01 0x00 0x00 0x00 0x00 0x01 0x19
		0x06 0x01 0x00 0x00 0x00 0x00 0x01 0x1A
		0x06 0x01 0x00 0x00 0x00 0x00 0x01 0x1B
		0x06 0x01 0x00 0x00 0x00 0x00 0x01 0x1C
		0x06 0x01 0x00 0x00 0x00 0x00 0x01 0x1D
		0x06 0x01 0x00 0x00 0x00 0x00 0x01 0x1E
		0x06 0x01 0x00 0x00 0x00 0x00 0x01 0x1F
		0x06 0x01 0x00 0x00 0x00 0x00 0x01 0x20
		0x06 0x01 0x00 0x00 0x00 0x00 0x01 0x21
		0x06 0x01 0x00 0x00 0x00 0x00 0x01 0x22
		0x06 0x01 0x00 0x00 0x00 0x00 0x01 0x23
		0x06 0x01 0x00 0x00 0x00 0x00 0x01 0x24
		0x39 0x01 0x00 0x00 0x00 0x00 0x04 0xFF 0x78 0x07 0x00>;
		lcd-kit,barcode-2d-cmds-state = "dsi_lp_mode";
		lcd-kit,panel-getblmaxnit-type = <0>;
		lcd-kit,panel-blmaxnit-min-value = <370>;
		lcd-kit,panel-bl-maxnit-command = <0x06 0x01 0x00 0x00 0x0a 0x00 0x01 0xdb>;
		lcd-kit,panel-bl-maxnit-command-state = "dsi_lp_mode";
		lcd-kit,inversion-support = <1>;
		lcd-kit,inversion-dot-cmds = <0x39 0x01 0x00 0x00 0x00 0x00 0x04 0xFF 0x78 0x07 0x02
		0x15 0x01 0x00 0x00 0x00 0x00 0x02 0x5F 0x24
		0x39 0x01 0x00 0x00 0x00 0x00 0x04 0xFF 0x78 0x07 0x00>;
		lcd-kit,inversion-column-cmds-state = "dsi_lp_mode";
		lcd-kit,inversion-column-cmds = <0x39 0x01 0x00 0x00 0x00 0x00 0x04 0xFF 0x78 0x07 0x02
		0x15 0x01 0x00 0x00 0x00 0x00 0x02 0x5F 0x20
		0x39 0x01 0x00 0x00 0x00 0x00 0x04 0xFF 0x78 0x07 0x00>;
		lcd-kit,inversion-dot-cmds-state = "dsi_lp_mode";
		lcd-kit,panel-gpio-offset = <1167>;
		lcd-kit,panel-bl-max-nit = <450>;
		lcd-kit,panel-bl-min = <18>;
		lcd-kit,panel-bl-max = <7005>;
		lcd-kit,panel-bl-def = <7005>;
		lcd-kit,check-reg-support = <0>;
		lcd-kit,check-reg-cmds = <0x39 0x01 0x00 0x00 0x00 0x00 0x04 0xFF 0x78 0x07 0x00
		0x06 0x01 0x00 0x00 0x0a 0x00 0x01 0x0a>;
		lcd-kit,check-reg-value = <0x9c>;
		lcd-kit,check-reg-cmds-state = "dsi_lp_mode";
		lcd-kit,thp-proximity-support = <1>;
		lcd-kit,proximity-reset-delay-min = <65>;
		lcd-kit,proximity-power-off-delay-min = <210>;
		lcd-kit,lcd-power-down-vsp = <2 65 4700000>;
		lcd-kit,lcd-power-down-vsn = <2 26 4700000>;
		lcd-kit,backlight-order = <0>;
		lcd-kit,quickly-sleep-out-support = <0>;
		lcd-kit,quickly-sleep-out-interval = <102>;
		lcd-kit,fps-support = <1>;
		lcd-kit,default-fps = <60>;
		lcd-kit,panel-support-fps-list = <60 90>;
		qcom,mdss-dsi-display-timings {
			timing@0 {
				qcom,mdss-dsi-panel-width = <1080>;
				qcom,mdss-dsi-panel-height = <2388>;
				qcom,mdss-dsi-h-front-porch = <31>;
				qcom,mdss-dsi-h-back-porch = <20>;
				qcom,mdss-dsi-h-pulse-width = <4>;
				qcom,mdss-dsi-h-sync-skew = <0>;
				qcom,mdss-dsi-v-front-porch = <40>;
				qcom,mdss-dsi-v-back-porch = <40>;
				qcom,mdss-dsi-v-pulse-width = <2>;
				qcom,mdss-dsi-panel-framerate = <90>;
				qcom,mdss-dsi-panel-phy-timings= [00 14 05 05 13 1F 05
				05 06 02 04 00 12 0A];
				qcom,display-topology  = <1 1 1>;
				qcom,default-topology-index  = <0>;
				qcom,mdss-dsi-on-command = [39 01 00 00 00 00 04 FF 78 07 06
		15 01 00 00 00 00 02 3E E2
		15 01 00 00 00 00 02 12 BD
		39 01 00 00 00 00 04 FF 78 07 08
		39 01 00 00 00 00 03 FD 00 9F
		15 01 00 00 00 00 02 E1 E1
		39 01 00 00 00 00 03 FD 00 00
		39 01 00 00 00 00 04 FF 78 07 07
		15 01 00 00 00 00 02 29 CF
		39 01 00 00 00 00 04 FF 78 07 02
		15 01 00 00 00 00 02 1B 01
		39 01 00 00 00 00 04 FF 78 07 00
		05 01 00 00 50 00 01 11
		05 01 00 00 14 00 01 29
		39 01 00 00 00 00 04 FF 78 07 06
		15 01 00 00 00 00 02 4D 80
		15 01 00 00 00 00 02 4E 64
		15 01 00 00 00 00 02 C7 05
		15 01 00 00 00 00 02 48 09
		39 01 00 00 00 00 04 FF 78 07 00];
				qcom,mdss-dsi-on-command-state = "dsi_lp_mode";
				qcom,mdss-dsi-off-command = [05 01 00 00 14 00 01 28
		05 01 00 00 50 00 01 10];
				qcom,mdss-dsi-off-command-state = "dsi_lp_mode";
				qcom,compression-mode = "dsc";
				qcom,mdss-dsc-slice-height = <12>;
				qcom,mdss-dsc-slice-width = <540>;
				qcom,mdss-dsc-slice-per-pkt = <2>;
				qcom,mdss-dsc-bit-per-component = <8>;
				qcom,mdss-dsc-bit-per-pixel = <8>;
				qcom,mdss-dsc-block-prediction-enable;
			};
		};
    };
};