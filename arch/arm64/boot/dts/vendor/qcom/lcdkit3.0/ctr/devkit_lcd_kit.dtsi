/*---------------------------------------------------------------------------
 * This file is autogenerated file using huawei LCD parser. Please do not edit it.
 * Update input XML file to add a new entry or update variable in this file
 * Parser location: vendor/huawei/chipset_common/devkit/lcdkit/tools 
 *---------------------------------------------------------------------------*/


#include "ctr_110_a07_6p7_qcom.dtsi"
#include "ctr_290_105_6p7_qcom.dtsi"
#include "ctr_330_105_6p7_qcom.dtsi"
#include "ctr_auo_otm1901a_5p2_1080p_video_default.dtsi"