/*---------------------------------------------------------------------------
 * This file is autogenerated file using huawei LCD parser. Please do not edit it.
 * Update input XML file to add a new entry or update variable in this file
 * Parser location: vendor/huawei/chipset_common/devkit/lcdkit/tools 
 *---------------------------------------------------------------------------*/


#include "nen_110_20c_6p6_qcom.dtsi"
#include "nen_190_20c_6p6_qcom.dtsi"
#include "nen_290_20c_6p6_qcom.dtsi"
#include "nen_auo_otm1901a_5p2_1080p_video_default.dtsi"