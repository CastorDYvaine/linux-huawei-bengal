/*---------------------------------------------------------------------------
 * This file is autogenerated file using huawei LCD parser. Please do not edit it.
 * Update input XML file to add a new entry or update variable in this file
 * Parser location: vendor/huawei/chipset_common/devkit/lcdkit/tools 
 *---------------------------------------------------------------------------*/


#include "gfy_250_107_1_6p7_qcom.dtsi"
#include "gfy_250_107_6p7_qcom.dtsi"
#include "gfy_380_a0a_1_6p7_qcom.dtsi"
#include "gfy_380_a0a_6p7_qcom.dtsi"
#include "gfy_auo_otm1901a_5p2_1080p_video_default.dtsi"