/* Copyright (c) 2013, The Linux Foundation. All rights reserved.
 *
 * This program is free software; you can redistribute it and/or modify
 * it under the terms of the GNU General Public License version 2 and
 * only version 2 as published by the Free Software Foundation.
 *
 * This program is distributed in the hope that it will be useful,
 * but WITHOUT ANY WARRANTY; without even the implied warranty of
 * MERCHANTABILITY or FITNESS FOR A PARTICULAR PURPOSE.  See the
 * GNU General Public License for more details.
 */

/*-------------------------------------------------------------------------
 * This file is autogenerated file using gcdb parser. Please do not edit it.
 * Update input XML file to add a new entry or update variable in this file
 * VERSION = 1.1
 *-----------------------------------------------------------------------*/
&mdss_mdp {
	dsi_gfy_380_a0a_1_6p7_qcom: lcd_kit_gfy_380_a0a_1_6p7_qcom {
		compatible = "380_a0a_6p7";
		lcd-kit,panel-name = "380_a0a 6.7' VIDEO 720 x 1600";
		lcd-kit,panel-type = <0x01>;
		lcd-kit,panel-ldi-dsi-mode = <1>;
		lcd-kit,bl-after-frame = <0>;
		lcd-kit,ap-aod-support = <1>;
		lcd-kit,aod-noprox-support = <1>;
		lcd-kit,vtc-line-no-reset = <0>;
		qcom,mdss-dsi-panel-type = "dsi_video_mode";
		qcom,mdss-dsi-panel-name = "380_a0a_6p7";
		qcom,mdss-pan-physical-width-dimension = <70>;
		qcom,mdss-pan-physical-height-dimension = <155>;
		qcom,dsi-ctrl-num = <0>;
		qcom,dsi-phy-num = <0>;
		qcom,panel-supply-entries = <&dsi_panel_pwr_supply>;
		qcom,mdss-dsi-virtual-channel-id = <0>;
		qcom,mdss-dsi-h-sync-pulse = <0>;
		qcom,mdss-dsi-bllp-eof-power-mode;
		qcom,mdss-dsi-bllp-power-mode;
		qcom,mdss-dsi-dma-schedule-line = <1>;
		qcom,mdss-dsi-bpp = <24>;
		qcom,mdss-dsi-color-order = "rgb_swap_rgb";
		qcom,mdss-dsi-underflow-color = <0xff>;
		qcom,mdss-dsi-border-color = <0>;
		qcom,mdss-dsi-traffic-mode = "burst_mode";
		qcom,mdss-dsi-lane-map = "lane_map_0123";
		qcom,mdss-dsi-lane-0-state;
		qcom,mdss-dsi-lane-1-state;
		qcom,mdss-dsi-lane-2-state;
		qcom,mdss-dsi-lane-3-state;
		qcom,mdss-dsi-mdp-trigger = "none";
		qcom,mdss-dsi-dma-trigger = "trigger_sw";
		qcom,mdss-dsi-te-pin-select = <0>;
		qcom,mdss-dsi-t-clk-post = <0x0F>;
		qcom,mdss-dsi-t-clk-pre = <0x1E>;
		qcom,mdss-dsi-tx-eot-append;
		qcom,dsi-select-clocks = "mux_byte_clk0", "mux_pixel_clk0", "src_byte_clk0", "src_pixel_clk0", "shadow_byte_clk0", "shadow_pixel_clk0";
		qcom,mdss-dsi-stream = <0>;
		qcom,mdss-dsi-lp11-init;
		lcd-kit,tddi-aod-support = <1>;
		lcd-kit,tddi-aod-high-light = <3 153>;
		lcd-kit,tddi-aod-middle-light = <3 97>;
		lcd-kit,tddi-aod-low-light = <4 33>;
		lcd-kit,tddi-aod-no-light = <0 0>;
		qcom,sublinks-count = <2>;
		qcom,lanes-per-sublink = <2>;
		qcom,mdss-dsi-panel-hdr-color-primaries = <14500 15500 32000 17000 15500 30000 8000 3000>;
		qcom,mdss-dsi-panel-peak-brightness = <4200000>;
		qcom,mdss-dsi-panel-blackness-level = <3230>;
		qcom,dynamic-mode-switch-type = "dynamic-resolution-switch-immediate";
		qcom,mdss-dsi-bl-pmic-control-type = "bl_ctrl_i2c_ic";
		pwms = <&pm6125_pwm 0 0>;
		qcom,bl-pmic-pwm-period-usecs = <100>;
		qcom,esd-check-enabled;
		qcom,mdss-dsi-panel-status-command = [39 01 00 00 00 00 04 FF 98 83 00
			06 01 00 00 00 00 01 0A];
		qcom,mdss-dsi-panel-status-command-state = "dsi_lp_mode";
		qcom,mdss-dsi-panel-status-check-mode = "reg_read";
		qcom,mdss-dsi-panel-status-read-length = <0 1>;
		qcom,mdss-dsi-panel-status-value = <0x9C>;
		lcd-kit,power-on-stage = <11 1 0
				3 1 2
				4 1 10
				5 2 1
				5 1 5
				5 2 1
				5 1 10
				7 1 2>;
		lcd-kit,lp-on-stage = <8 1 0>;
		lcd-kit,lp-off-stage = <7 0 0>;
		lcd-kit,power-off-stage = <8 0 50
				4 0 1
				3 0 2
				11 0 5>;
		lcd-kit,only-power-off-stage = <15 0 80
				4 0 0
				3 0 6>;
		lcd-kit,pt-support = <1>;
		lcd-kit,panel-on-always-reset = <1>;
		lcd-kit,lcd-vsp = <3 0 6000000>;
		lcd-kit,lcd-vsn = <3 0 6000000>;
		lcd-kit,lcd-reset = <2 82 0>;
		lcd-kit,project-id-support = <1>;
		lcd-kit,default-project-id = "G319C33701";
		lcd-kit,sn-code-support = <1>;
		lcd-kit,oem-info-support = <1>;
		lcd-kit,oem-barcode-2d-support = <1>;
		lcd-kit,oem-barcode-2d-num-offset = <0>;
		lcd-kit,barcode-2d-cmds = <0x39 0x01 0x00 0x00 0x0a 0x00 0x04 0xFF 0x98 0x83 0x0B
                       0x06 0x01 0x00 0x00 0x0a 0x00 0x01 0x00
                       0x06 0x01 0x00 0x00 0x0a 0x00 0x01 0x01
                       0x06 0x01 0x00 0x00 0x0a 0x00 0x01 0x02
                       0x06 0x01 0x00 0x00 0x0a 0x00 0x01 0x03
                       0x06 0x01 0x00 0x00 0x0a 0x00 0x01 0x04
                       0x06 0x01 0x00 0x00 0x0a 0x00 0x01 0x05
                       0x06 0x01 0x00 0x00 0x0a 0x00 0x01 0x06
                       0x06 0x01 0x00 0x00 0x0a 0x00 0x01 0x07
                       0x06 0x01 0x00 0x00 0x0a 0x00 0x01 0x08
                       0x06 0x01 0x00 0x00 0x0a 0x00 0x01 0x09
                       0x06 0x01 0x00 0x00 0x0a 0x00 0x01 0x0A
                       0x06 0x01 0x00 0x00 0x0a 0x00 0x01 0x0B
                       0x06 0x01 0x00 0x00 0x0a 0x00 0x01 0x0C
                       0x06 0x01 0x00 0x00 0x0a 0x00 0x01 0x0D
                       0x06 0x01 0x00 0x00 0x0a 0x00 0x01 0x0E
                       0x06 0x01 0x00 0x00 0x0a 0x00 0x01 0x0F
                       0x06 0x01 0x00 0x00 0x0a 0x00 0x01 0x10
                       0x06 0x01 0x00 0x00 0x0a 0x00 0x01 0x11
                       0x06 0x01 0x00 0x00 0x0a 0x00 0x01 0x12
                       0x06 0x01 0x00 0x00 0x0a 0x00 0x01 0x13
                       0x06 0x01 0x00 0x00 0x0a 0x00 0x01 0x14
                       0x39 0x01 0x00 0x00 0x0a 0x00 0x04 0xFF 0x98 0x83 0x00>;
		lcd-kit,barcode-2d-cmds-state = "dsi_lp_mode";
		lcd-kit,panel-getblmaxnit-type = <0>;
		lcd-kit,panel-blmaxnit-min-value = <420>;
		lcd-kit,panel-bl-maxnit-command = <0x06 0x01 0x00 0x00 0x0a 0x00 0x01 0xdb>;
		lcd-kit,panel-bl-maxnit-command-state = "dsi_lp_mode";
		lcd-kit,inversion-support = <1>;
		lcd-kit,inversion-dot-cmds = <0x39 0x01 0x00 0x00 0x00 0x00 0x04 0xFF 0x98 0x83 0x02
		0x15 0x01 0x00 0x00 0x00 0x00 0x02 0x5F 0x24
		0x39 0x01 0x00 0x00 0x00 0x00 0x04 0xFF 0x98 0x83 0x00>;
		lcd-kit,inversion-column-cmds-state = "dsi_lp_mode";
		lcd-kit,inversion-column-cmds = <0x39 0x01 0x00 0x00 0x00 0x00 0x04 0xFF 0x98 0x83 0x02
		0x15 0x01 0x00 0x00 0x00 0x00 0x02 0x5F 0x20
		0x39 0x01 0x00 0x00 0x00 0x00 0x04 0xFF 0x98 0x83 0x00>;
		lcd-kit,inversion-dot-cmds-state = "dsi_lp_mode";
		lcd-kit,panel-gpio-offset = <1167>;
		lcd-kit,panel-bl-max-nit = <450>;
		lcd-kit,panel-bl-min = <18>;
		lcd-kit,panel-bl-max = <6000>;
		lcd-kit,panel-bl-def = <6000>;
		lcd-kit,check-reg-support = <0>;
		lcd-kit,check-reg-cmds = <0x39 0x01 0x00 0x00 0x00 0x00 0x04 0xFF 0x98 0x83 0x00
		0x06 0x01 0x00 0x00 0x0a 0x00 0x01 0x0a>;
		lcd-kit,check-reg-value = <0x9c>;
		lcd-kit,check-reg-cmds-state = "dsi_lp_mode";
		lcd-kit,thp-proximity-support = <1>;
		lcd-kit,proximity-reset-delay-min = <65>;
		lcd-kit,proximity-power-off-delay-min = <210>;
		lcd-kit,lcd-power-down-vsp = <3 0 4700000>;
		lcd-kit,lcd-power-down-vsn = <3 0 4700000>;
		lcd-kit,backlight-order = <0>;
		lcd-kit,quickly-sleep-out-support = <0>;
		lcd-kit,quickly-sleep-out-interval = <102>;
		lcd-kit,fps-support = <1>;
		lcd-kit,default-fps = <60>;
		lcd-kit,panel-support-fps-list = <60 90>;
		qcom,mdss-dsi-display-timings {
			timing@0 {
				qcom,mdss-dsi-panel-width = <720>;
				qcom,mdss-dsi-panel-height = <1600>;
				qcom,mdss-dsi-h-front-porch = <140>;
				qcom,mdss-dsi-h-back-porch = <152>;
				qcom,mdss-dsi-h-pulse-width = <8>;
				qcom,mdss-dsi-h-sync-skew = <0>;
				qcom,mdss-dsi-v-front-porch = <46>;
				qcom,mdss-dsi-v-back-porch = <360>;
				qcom,mdss-dsi-v-pulse-width = <2>;
				qcom,mdss-dsi-panel-framerate = <90>;
				qcom,mdss-dsi-panel-phy-timings= [00 24 0A 0A 1A 24 0A
				0A 09 02 04 00 1E 0F];
				qcom,display-topology  = <1 0 1>;
				qcom,default-topology-index  = <0>;
				qcom,mdss-dsi-on-command = [39 01 00 00 00 00 04 ff 98 83 02
			39 01 00 00 00 00 02 0d 6a
			39 01 00 00 00 00 02 0e 30
			39 01 00 00 00 00 02 3a 6a
			39 01 00 00 00 00 02 3b 30
			39 01 00 00 00 00 02 f0 04
			39 01 00 00 00 00 02 f1 15
			39 01 00 00 00 00 04 ff 98 83 06
			39 01 00 00 00 00 02 3e e2
			39 01 00 00 00 00 02 93 10
			39 01 00 00 00 00 04 ff 98 83 0b
			39 01 00 00 00 00 02 9b 8b
			39 01 00 00 00 00 04 ff 98 83 0e
			39 01 00 00 00 00 02 11 45
			39 01 00 00 00 00 02 14 0d
			39 01 00 00 00 00 04 ff 98 83 00
			39 01 00 00 00 00 02 35 00
			05 01 00 00 5a 00 01 11
			05 01 00 00 14 00 01 29];
				qcom,mdss-dsi-on-command-state = "dsi_lp_mode";
				qcom,mdss-dsi-off-command = [39 01 00 00 01 00 04 ff 98 83 00
			05 01 00 00 14 00 01 28
			05 01 00 00 55 00 01 10];
				qcom,mdss-dsi-off-command-state = "dsi_lp_mode";
			};
		};
    };
};