## drivers/huawei_platform/hwpower/Kconfig
```kconfig
# SPDX-License-Identifier: GPL-2.0
config HUAWEI_BATTERY_BENGAL_ISCD
	bool "huawei battery bengal iscd"
	default n
	help
	  Say Y here if you want to use the huawei battery bengal iscd.
	  If unsure, say N here.

source "drivers/huawei_platform/hwpower/proxy/Kconfig"
source "drivers/huawei_platform/hwpower/glink/Kconfig"
source "drivers/huawei_platform/hwpower/hardware_ic/Kconfig"
```

## drivers/huawei_platform/usb/pd/Kconfig
```kconfig
source "drivers/huawei_platform/usb/pd/richtek/Kconfig"
source "drivers/huawei_platform/usb/pd/rt1715/Kconfig"
config HUAWEI_PD
        bool "huawei_pd"
        default n

config HUAWEI_PD_THIRDPARTY
        bool "huawei_pd_thirdparty"
        default n

config SUPPORT_USB_PD30
        bool "support_pd30_rt1715"
        default n
```

## sound/hw_audio/Kconfig
```kconfig
config HW_AUDIO_INFO
    tristate "set audio info for self adapt"
	default n
	help
	  This is used to some audio self adatper configuration.

config SUPPORT_AUDIO_TDM
    tristate "AUDIO TDM feature"
	default n
	help
	  This is used to audio TDM feature.
```
